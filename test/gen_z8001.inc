### AUTO GENERATED FILE
### generated by: gen_z8000 -c -C z8001 -o gen_z8001.inc -l gen_z8001.lst
      addb   rh1,#3
      addb   rl0,#10
      addb   rh0,@rr2
      addb   rl0,@rr2
      add    r0,#0x0102
      add    r0,@rr2
      subb   rh0,#2
      subb   rl0,#10
      subb   rh0,@rr2
      subb   rl0,@rr2
      sub    r0,#0x0102
      sub    r0,@rr2
      orb    rh0,#2
      orb    rl0,#10
      orb    rh0,@rr2
      orb    rl0,@rr2
      or     r0,#0x0102
      or     r0,@rr2
      andb   rh0,#2
      andb   rl0,#10
      andb   rh0,@rr2
      andb   rl0,@rr2
      and    r0,#0x0102
      and    r0,@rr2
      xorb   rh0,#2
      xorb   rl0,#10
      xorb   rh0,@rr2
      xorb   rl0,@rr2
      xor    r0,#0x0102
      xor    r0,@rr2
      cpb    rh0,#2
      cpb    rl0,#10
      cpb    rh0,@rr2
      cpb    rl0,@rr2
      cp     r0,#0x0102
      cp     r0,@rr2
      comb   @rr2
      cpb    @rr2,#0x23
      negb   @rr2
      testb  @rr2
      ldb    @rr2,#0x27
      tsetb  @rr2
      clrb   @rr2
      com    @rr2
      cp     @rr2,#0x2223
      neg    @rr2
      test   @rr2
      ld     @rr2,#0x2627
      tset   @rr2
      clr    @rr2
      push   @rr2,#0x2a2b
      cpl    rr0,#0x01020304
      cpl    rr0,@rr2
      pushl  @rr2,@rr2
      subl   rr0,#0x01020304
      subl   rr0,@rr2
      push   @rr2,@rr2
      ldl    rr0,#0x01020304
      ldl    rr0,@rr2
      popl   @rr2,@rr2
      addl   rr0,#0x01020304
      addl   rr0,@rr2
      pop    @rr2,@rr2
      multl  rq0,#0x01020304
      multl  rq0,@rr2
      mult   rr0,#0x0102
      mult   rr0,@rr2
      divl   rq0,#0x01020304
      divl   rq0,@rr2
      div    rr0,#0x0102
      div    rr0,@rr2
      testl  @rr2
      ldl    @rr2,rr0
      jp     f,@rr2
      jp     lt,@rr2
      jp     le,@rr2
      jp     ule,@rr2
      jp     ov,@rr2
      jp     mi,@rr2
      jp     z,@rr2
      jp     c,@rr2
      jp     @rr2
      jp     ge,@rr2
      jp     gt,@rr2
      jp     ugt,@rr2
      jp     nov,@rr2
      jp     pl,@rr2
      jp     nz,@rr2
      jp     nc,@rr2
      call   @rr2
      ldb    rh0,#2
      ldb    rl0,#10
      ldb    rh0,@rr2
      ldb    rl0,@rr2
      ld     r0,#0x0102
      ld     r0,@rr2
      resb   @rr2,#0
      res    @rr2,#0
      setb   @rr2,#0
      set    @rr2,#0
      bitb   @rr2,#0
      bit    @rr2,#0
      incb   @rr2,#1
      inc    @rr2,#1
      decb   @rr2,#1
      dec    @rr2,#1
      exb    rh0,@rr2
      exb    rl0,@rr2
      ex     r0,@rr2
      ldb    @rr2,rh0
      ldb    @rr2,rl0
      ld     @rr2,r0
      ldrb   rh0,.+0x0106
      ldrb   rh0,.-0x7ffa
      ldrb   rl0,.+0x090e
      ldrb   rl0,.-0x7ff2
      ldb    rh0,rr2(#0x2122)
      ldb    rh0,rr2(#-0x7fde)
      ldb    rl0,rr2(#0x292a)
      ldb    rl0,rr2(#-0x7fd6)
      ldr    r0,.+0x0106
      ldr    r0,.-0x7ffa
      ld     r0,rr2(#0x2122)
      ld     r0,rr2(#-0x7fde)
      ldrb   .+0x0106,rh0
      ldrb   .-0x7ffa,rh0
      ldrb   .+0x090e,rl0
      ldrb   .-0x7ff2,rl0
      ldb    rr2(#0x2122),rh0
      ldb    rr2(#-0x7fde),rh0
      ldb    rr2(#0x292a),rl0
      ldb    rr2(#-0x7fd6),rl0
      ldr    .+0x0106,r0
      ldr    .-0x7ffa,r0
      ld     rr2(#0x2122),r0
      ld     rr2(#-0x7fde),r0
      ldar   rr0,.+0x0106
      ldar   rr0,.-0x7ffa
      lda    rr0,rr2(#0x2122)
      lda    rr0,rr2(#-0x7fde)
      ldrl   rr0,.+0x0106
      ldrl   rr0,.-0x7ffa
      ldl    rr0,rr2(#0x2122)
      ldl    rr0,rr2(#-0x7fde)
      ldrl   .+0x0106,rr0
      ldrl   .-0x7ffa,rr0
      ldl    rr2(#0x2122),rr0
      ldl    rr2(#-0x7fde),rr0
      ldps   @rr2
      inb    rh0,#0x0506
      sinb   rh0,#0x0607
      outb   #0x0708,rh0
      soutb  #0x0809,rh0
      inb    rl0,#0x8586
      sinb   rl0,#0x8687
      outb   #0x8788,rl0
      soutb  #0x8889,rl0
      in     r0,#0x0506
      sin    r0,#0x0607
      out    #0x0708,r0
      sout   #0x0809,r0
      inb    rh0,@r1
      inb    rl0,@r1
      in     r0,@r1
      outb   @r1,rh0
      outb   @r1,rl0
      out    @r1,r0
      addb   rh0,0x010002
      addb   rh0,0x000304
      addb   rl0,0x09000a
      addb   rl0,0x000b0c
      addb   rh0,0x110012(r1)
      addb   rh0,0x001314(r1)
      addb   rl0,0x19001a(r1)
      addb   rl0,0x001b1c(r1)
      add    r0,0x010002
      add    r0,0x000304
      add    r0,0x110012(r1)
      add    r0,0x001314(r1)
      subb   rh0,0x010002
      subb   rh0,0x000304
      subb   rl0,0x09000a
      subb   rl0,0x000b0c
      subb   rh0,0x110012(r1)
      subb   rh0,0x001314(r1)
      subb   rl0,0x19001a(r1)
      subb   rl0,0x001b1c(r1)
      sub    r0,0x010002
      sub    r0,0x000304
      sub    r0,0x110012(r1)
      sub    r0,0x001314(r1)
      orb    rh0,0x010002
      orb    rh0,0x000304
      orb    rl0,0x09000a
      orb    rl0,0x000b0c
      orb    rh0,0x110012(r1)
      orb    rh0,0x001314(r1)
      orb    rl0,0x19001a(r1)
      orb    rl0,0x001b1c(r1)
      or     r0,0x010002
      or     r0,0x000304
      or     r0,0x110012(r1)
      or     r0,0x001314(r1)
      andb   rh0,0x010002
      andb   rh0,0x000304
      andb   rl0,0x09000a
      andb   rl0,0x000b0c
      andb   rh0,0x110012(r1)
      andb   rh0,0x001314(r1)
      andb   rl0,0x19001a(r1)
      andb   rl0,0x001b1c(r1)
      and    r0,0x010002
      and    r0,0x000304
      and    r0,0x110012(r1)
      and    r0,0x001314(r1)
      xorb   rh0,0x010002
      xorb   rh0,0x000304
      xorb   rl0,0x09000a
      xorb   rl0,0x000b0c
      xorb   rh0,0x110012(r1)
      xorb   rh0,0x001314(r1)
      xorb   rl0,0x19001a(r1)
      xorb   rl0,0x001b1c(r1)
      xor    r0,0x010002
      xor    r0,0x000304
      xor    r0,0x110012(r1)
      xor    r0,0x001314(r1)
      cpb    rh0,0x010002
      cpb    rh0,0x000304
      cpb    rl0,0x09000a
      cpb    rl0,0x000b0c
      cpb    rh0,0x110012(r1)
      cpb    rh0,0x001314(r1)
      cpb    rl0,0x19001a(r1)
      cpb    rl0,0x001b1c(r1)
      cp     r0,0x010002
      cp     r0,0x000304
      cp     r0,0x110012(r1)
      cp     r0,0x001314(r1)
      comb   0x010002
      comb   0x000304
      cpb    0x020003,#5
      cpb    0x000405,#7
      negb   0x030004
      negb   0x000506
      testb  0x050006
      testb  0x000708
      ldb    0x060007,#9
      ldb    0x000809,#11
      tsetb  0x070008
      tsetb  0x00090a
      clrb   0x09000a
      clrb   0x000b0c
      comb   0x110012(r1)
      comb   0x001314(r1)
      cpb    0x120013(r1),#21
      cpb    0x001415(r1),#23
      negb   0x130014(r1)
      negb   0x001516(r1)
      testb  0x150016(r1)
      testb  0x001718(r1)
      ldb    0x160017(r1),#25
      ldb    0x001819(r1),#27
      tsetb  0x170018(r1)
      tsetb  0x00191a(r1)
      clrb   0x19001a(r1)
      clrb   0x001b1c(r1)
      com    0x010002
      com    0x000304
      cp     0x020003,#0x0405
      cp     0x000405,#0x0607
      neg    0x030004
      neg    0x000506
      test   0x050006
      test   0x000708
      ld     0x060007,#0x0809
      ld     0x000809,#0x0a0b
      tset   0x070008
      tset   0x00090a
      clr    0x09000a
      clr    0x000b0c
      com    0x110012(r1)
      com    0x001314(r1)
      cp     0x120013(r1),#0x1415
      cp     0x001415(r1),#0x1617
      neg    0x130014(r1)
      neg    0x001516(r1)
      test   0x150016(r1)
      test   0x001718(r1)
      ld     0x160017(r1),#0x1819
      ld     0x001819(r1),#0x1a1b
      tset   0x170018(r1)
      tset   0x00191a(r1)
      clr    0x19001a(r1)
      clr    0x001b1c(r1)
      cpl    rr0,0x010002
      cpl    rr0,0x000304
      cpl    rr0,0x110012(r1)
      cpl    rr0,0x001314(r1)
      pushl  @rr2,0x210022
      pushl  @rr2,0x002324
      pushl  @rr2,0x220023(r1)
      pushl  @rr2,0x002425(r1)
      subl   rr0,0x010002
      subl   rr0,0x000304
      subl   rr0,0x110012(r1)
      subl   rr0,0x001314(r1)
      push   @rr2,0x210022
      push   @rr2,0x002324
      push   @rr2,0x220023(r1)
      push   @rr2,0x002425(r1)
      ldl    rr0,0x010002
      ldl    rr0,0x000304
      ldl    rr0,0x110012(r1)
      ldl    rr0,0x001314(r1)
      popl   0x210022,@rr2
      popl   0x002324,@rr2
      popl   0x220023(r1),@rr2
      popl   0x002425(r1),@rr2
      addl   rr0,0x010002
      addl   rr0,0x000304
      addl   rr0,0x110012(r1)
      addl   rr0,0x001314(r1)
      pop    0x210022,@rr2
      pop    0x002324,@rr2
      pop    0x220023(r1),@rr2
      pop    0x002425(r1),@rr2
      multl  rq0,0x010002
      multl  rq0,0x000304
      multl  rq0,0x110012(r1)
      multl  rq0,0x001314(r1)
      mult   rr0,0x010002
      mult   rr0,0x000304
      mult   rr0,0x110012(r1)
      mult   rr0,0x001314(r1)
      divl   rq0,0x010002
      divl   rq0,0x000304
      divl   rq0,0x110012(r1)
      divl   rq0,0x001314(r1)
      div    rr0,0x010002
      div    rr0,0x000304
      div    rr0,0x110012(r1)
      div    rr0,0x001314(r1)
      ldm    r2,0x040005,#4
      ldm    r1,0x000607,#2
      testl  0x09000a
      testl  0x000b0c
      ldm    0x0c000d,r10,#12
      ldm    0x000e0f,r9,#10
      testl  0x19001a(r1)
      testl  0x001b1c(r1)
      ldl    0x010002,rr0
      ldl    0x000304,rr0
      ldl    0x110012(r1),rr0
      ldl    0x001314(r1),rr0
      jp     f,0x010002
      jp     f,0x000304
      jp     lt,0x020003
      jp     lt,0x000405
      jp     le,0x030004
      jp     le,0x000506
      jp     ule,0x040005
      jp     ule,0x000607
      jp     ov,0x050006
      jp     ov,0x000708
      jp     mi,0x060007
      jp     mi,0x000809
      jp     z,0x070008
      jp     z,0x00090a
      jp     c,0x080009
      jp     c,0x000a0b
      jp     0x09000a
      jp     0x000b0c
      jp     ge,0x0a000b
      jp     ge,0x000c0d
      jp     gt,0x0b000c
      jp     gt,0x000d0e
      jp     ugt,0x0c000d
      jp     ugt,0x000e0f
      jp     nov,0x0d000e
      jp     nov,0x000f10
      jp     pl,0x0e000f
      jp     pl,0x001011
      jp     nz,0x0f0010
      jp     nz,0x001112
      jp     nc,0x100011
      jp     nc,0x001213
      jp     f,0x110012(r1)
      jp     f,0x001314(r1)
      jp     lt,0x120013(r1)
      jp     lt,0x001415(r1)
      jp     le,0x130014(r1)
      jp     le,0x001516(r1)
      jp     ule,0x140015(r1)
      jp     ule,0x001617(r1)
      jp     ov,0x150016(r1)
      jp     ov,0x001718(r1)
      jp     mi,0x160017(r1)
      jp     mi,0x001819(r1)
      jp     z,0x170018(r1)
      jp     z,0x00191a(r1)
      jp     c,0x180019(r1)
      jp     c,0x001a1b(r1)
      jp     0x19001a(r1)
      jp     0x001b1c(r1)
      jp     ge,0x1a001b(r1)
      jp     ge,0x001c1d(r1)
      jp     gt,0x1b001c(r1)
      jp     gt,0x001d1e(r1)
      jp     ugt,0x1c001d(r1)
      jp     ugt,0x001e1f(r1)
      jp     nov,0x1d001e(r1)
      jp     nov,0x001f20(r1)
      jp     pl,0x1e001f(r1)
      jp     pl,0x002021(r1)
      jp     nz,0x1f0020(r1)
      jp     nz,0x002122(r1)
      jp     nc,0x200021(r1)
      jp     nc,0x002223(r1)
      call   0x010002
      call   0x000304
      call   0x110012(r1)
      call   0x001314(r1)
      ldb    rh0,0x010002
      ldb    rh0,0x000304
      ldb    rl0,0x09000a
      ldb    rl0,0x000b0c
      ldb    rh0,0x110012(r1)
      ldb    rh0,0x001314(r1)
      ldb    rl0,0x19001a(r1)
      ldb    rl0,0x001b1c(r1)
      ld     r0,0x010002
      ld     r0,0x000304
      ld     r0,0x110012(r1)
      ld     r0,0x001314(r1)
      resb   0x010002,#0
      resb   0x000304,#0
      resb   0x110012(r1),#0
      resb   0x001314(r1),#0
      res    0x010002,#0
      res    0x000304,#0
      res    0x110012(r1),#0
      res    0x001314(r1),#0
      setb   0x010002,#0
      setb   0x000304,#0
      setb   0x110012(r1),#0
      setb   0x001314(r1),#0
      set    0x010002,#0
      set    0x000304,#0
      set    0x110012(r1),#0
      set    0x001314(r1),#0
      bitb   0x010002,#0
      bitb   0x000304,#0
      bitb   0x110012(r1),#0
      bitb   0x001314(r1),#0
      bit    0x010002,#0
      bit    0x000304,#0
      bit    0x110012(r1),#0
      bit    0x001314(r1),#0
      incb   0x010002,#1
      incb   0x000304,#1
      incb   0x110012(r1),#1
      incb   0x001314(r1),#1
      inc    0x010002,#1
      inc    0x000304,#1
      inc    0x110012(r1),#1
      inc    0x001314(r1),#1
      decb   0x010002,#1
      decb   0x000304,#1
      decb   0x110012(r1),#1
      decb   0x001314(r1),#1
      dec    0x010002,#1
      dec    0x000304,#1
      dec    0x110012(r1),#1
      dec    0x001314(r1),#1
      exb    rh0,0x010002
      exb    rh0,0x000304
      exb    rl0,0x09000a
      exb    rl0,0x000b0c
      exb    rh0,0x110012(r1)
      exb    rh0,0x001314(r1)
      exb    rl0,0x19001a(r1)
      exb    rl0,0x001b1c(r1)
      ex     r0,0x010002
      ex     r0,0x000304
      ex     r0,0x110012(r1)
      ex     r0,0x001314(r1)
      ldb    0x010002,rh0
      ldb    0x000304,rh0
      ldb    0x09000a,rl0
      ldb    0x000b0c,rl0
      ldb    0x110012(r1),rh0
      ldb    0x001314(r1),rh0
      ldb    0x19001a(r1),rl0
      ldb    0x001b1c(r1),rl0
      ld     0x010002,r0
      ld     0x000304,r0
      ld     0x110012(r1),r0
      ld     0x001314(r1),r0
      lda    rr0,0x010002
      lda    rr0,0x000304
      lda    rr0,0x110012(r1)
      lda    rr0,0x001314(r1)
      ldps   0x010002
      ldps   0x000304
      ldps   0x110012(r1)
      ldps   0x001314(r1)
      halt
      iret
      mset
      mres
      mbit
      mreq   r0
      di     vi,nvi
      di     vi
      di     nvi
      ei     vi,nvi
      ei     vi
      ei     nvi
      ldctl  r0,fcw
      ldctl  r0,refresh
      ldctl  r0,psapseg
      ldctl  r0,psapoff
      ldctl  r0,nspseg
      ldctl  r0,nspoff
      ldctl  fcw,r0
      ldctl  refresh,r0
      ldctl  psapseg,r0
      ldctl  psapoff,r0
      ldctl  nspseg,r0
      ldctl  nspoff,r0
      sc     #0
      addb   rh0,rh1
      addb   rl0,rh1
      addb   rh0,rl0
      addb   rl0,rl0
      add    r0,r1
      subb   rh0,rh1
      subb   rl0,rh1
      subb   rh0,rl0
      subb   rl0,rl0
      sub    r0,r1
      orb    rh0,rh1
      orb    rl0,rh1
      orb    rh0,rl0
      orb    rl0,rl0
      or     r0,r1
      andb   rh0,rh1
      andb   rl0,rh1
      andb   rh0,rl0
      andb   rl0,rl0
      and    r0,r1
      xorb   rh0,rh1
      xorb   rl0,rh1
      xorb   rh0,rl0
      xorb   rl0,rl0
      xor    r0,r1
      cpb    rh0,rh1
      cpb    rl0,rh1
      cpb    rh0,rl0
      cpb    rl0,rl0
      cp     r0,r1
      ldctlb rh0,flags
      ldctlb flags,rh0
      comb   rh1
      negb   rh1
      testb  rh1
      tsetb  rh1
      clrb   rh1
      comb   rl0
      ldctlb rl0,flags
      negb   rl0
      testb  rl0
      tsetb  rl0
      clrb   rl0
      ldctlb flags,rl0
      nop
      com    r1
      setflg p
      neg    r1
      resflg p
      test   r1
      comflg p
      tset   r1
      clr    r1
      setflg s
      resflg s
      comflg s
      setflg s,p
      resflg s,p
      comflg s,p
      setflg z
      resflg z
      comflg z
      setflg z,p
      resflg z,p
      comflg z,p
      setflg z,s
      resflg z,s
      comflg z,s
      setflg z,s,p
      resflg z,s,p
      comflg z,s,p
      setflg c
      resflg c
      comflg c
      setflg c,p
      resflg c,p
      comflg c,p
      setflg c,s
      resflg c,s
      comflg c,s
      setflg c,s,p
      resflg c,s,p
      comflg c,s,p
      setflg c,z
      resflg c,z
      comflg c,z
      setflg c,z,p
      resflg c,z,p
      comflg c,z,p
      setflg c,z,s
      resflg c,z,s
      comflg c,z,s
      setflg c,z,s,p
      resflg c,z,s,p
      comflg c,z,s,p
      cpl    rr0,rr2
      pushl  @rr2,rr2
      subl   rr0,rr2
      push   @rr2,r1
      ldl    rr0,rr2
      popl   rr2,@rr2
      addl   rr0,rr2
      pop    r1,@rr2
      multl  rq0,rr2
      mult   rr0,r1
      divl   rq0,rr2
      div    rr0,r1
      testl  rr2
      ret    f
      ret    lt
      ret    le
      ret    ule
      ret    ov
      ret    mi
      ret    z
      ret    c
      ret
      ret    ge
      ret    gt
      ret    ugt
      ret    nov
      ret    pl
      ret    nz
      ret    nc
      ldb    rh0,rh1
      ldb    rl0,rh1
      ldb    rh0,rl0
      ldb    rl0,rl0
      ld     r0,r1
      resb   rh1,#0
      resb   rl0,#0
      res    r1,#0
      setb   rh1,#0
      setb   rl0,#0
      set    r1,#0
      bitb   rh1,#0
      bitb   rl0,#0
      bit    r1,#0
      incb   rh1,#1
      incb   rl0,#1
      inc    r1,#1
      decb   rh1,#1
      decb   rl0,#1
      dec    r1,#1
      exb    rh0,rh1
      exb    rl0,rh1
      exb    rh0,rl0
      exb    rl0,rl0
      ex     r0,r1
      tccb   f,rh0
      tccb   lt,rh0
      tccb   le,rh0
      tccb   ule,rh0
      tccb   ov,rh0
      tccb   mi,rh0
      tccb   z,rh0
      tccb   c,rh0
      tccb   rh0
      tccb   ge,rh0
      tccb   gt,rh0
      tccb   ugt,rh0
      tccb   nov,rh0
      tccb   pl,rh0
      tccb   nz,rh0
      tccb   nc,rh0
      tccb   f,rl0
      tccb   lt,rl0
      tccb   le,rl0
      tccb   ule,rl0
      tccb   ov,rl0
      tccb   mi,rl0
      tccb   z,rl0
      tccb   c,rl0
      tccb   rl0
      tccb   ge,rl0
      tccb   gt,rl0
      tccb   ugt,rl0
      tccb   nov,rl0
      tccb   pl,rl0
      tccb   nz,rl0
      tccb   nc,rl0
      tcc    f,r0
      tcc    lt,r0
      tcc    le,r0
      tcc    ule,r0
      tcc    ov,r0
      tcc    mi,r0
      tcc    z,r0
      tcc    c,r0
      tcc    r0
      tcc    ge,r0
      tcc    gt,r0
      tcc    ugt,r0
      tcc    nov,r0
      tcc    pl,r0
      tcc    nz,r0
      tcc    nc,r0
      dab    rh0
      dab    rl0
      extsb  r0
      extsl  rq0
      exts   rr0
      rlb    rh0,#1
      rrb    rh0,#1
      rlcb   rh0,#1
      rrcb   rh0,#1
      rlb    rl0,#1
      rrb    rl0,#1
      rlcb   rl0,#1
      rrcb   rl0,#1
      rl     r0,#1
      rr     r0,#1
      rlc    r0,#1
      rrc    r0,#1
      adcb   rh0,rh0
      adcb   rl0,rh0
      adcb   rh0,rl0
      adcb   rl0,rl0
      adc    r0,r0
      sbcb   rh0,rh0
      sbcb   rl0,rh0
      sbcb   rh0,rl0
      sbcb   rl0,rl0
      sbc    r0,r0
      rrdb   rh0,rh0
      rrdb   rl0,rh0
      rrdb   rh0,rl0
      rrdb   rl0,rl0
      ldk    r0,#0
      rldb   rh0,rh0
      rldb   rl0,rh0
      rldb   rh0,rl0
      rldb   rl0,rl0
      ldb    rh0,#0
      ldb    rl0,#0
      calr   .+2
      calr   .-4094
      calr   .
      jr     f,.+2
      jr     f,.-254
      jr     f,.
      jr     lt,.+2
      jr     lt,.-254
      jr     lt,.
      jr     le,.+2
      jr     le,.-254
      jr     le,.
      jr     ule,.+2
      jr     ule,.-254
      jr     ule,.
      jr     ov,.+2
      jr     ov,.-254
      jr     ov,.
      jr     mi,.+2
      jr     mi,.-254
      jr     mi,.
      jr     z,.+2
      jr     z,.-254
      jr     z,.
      jr     c,.+2
      jr     c,.-254
      jr     c,.
      jr     .+2
      jr     .-254
      jr     .
      jr     ge,.+2
      jr     ge,.-254
      jr     ge,.
      jr     gt,.+2
      jr     gt,.-254
      jr     gt,.
      jr     ugt,.+2
      jr     ugt,.-254
      jr     ugt,.
      jr     nov,.+2
      jr     nov,.-254
      jr     nov,.
      jr     pl,.+2
      jr     pl,.-254
      jr     pl,.
      jr     nz,.+2
      jr     nz,.-254
      jr     nz,.
      jr     nc,.+2
      jr     nc,.-254
      jr     nc,.
      dbjnz  rh0,.+2
      dbjnz  rh0,.
      dbjnz  rh0,.-2
      djnz   r0,.+2
      djnz   r0,.
      djnz   r0,.-2
      dbjnz  rl0,.+2
      dbjnz  rl0,.
      dbjnz  rl0,.-2
