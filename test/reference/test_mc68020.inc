;# Copyright 2025 Tadashi G. Takaoka
;#
;# Licensed under the Apache License, Version 2.0 (the "License");
;# you may not use this file except in compliance with the License.
;# You may obtain a copy of the License at
;#
;#     http://www.apache.org/licenses/LICENSE-2.0
;#
;# Unless required by applicable law or agreed to in writing, software
;# distributed under the License is distributed on an "AS IS" BASIS,
;# WITHOUT WARRANTIES OR CONDITIONS OF ANY KIND, either express or implied.
;# See the License for the specific language governing permissions and
;# limitations under the License.

        link.l  a3,#$1234
        link.l  a3,#-16
        move.b  (-$8001,a2),d7
        move.b  ($8000,a2),d7
        move.b  (-$81,a2,d3.l),d7
        move.b  ($80,a2,d3.l),d7
        move.b  (*-$7fff,pc),d7
        move.b  (*+$8002,pc),d7
        move.b  (*-$7f,pc,d3),d7
        move.b  (*+$82,pc,d3),d7
        bftst   d1{31:32}
        bftst   (a2){0:4}
        bftst   (a2){d1:3}
        bftst   (a2){1:d3}
        bftst   (a2){d2:d3}
        bftst   ($1234,a2){0:4}
        bftst   (18,a2,d3.w){0:4}
        bftst   ($1234).w{1:2}
        bftst   ($12345678).l{0:16}
        bftst   (*+$1234,pc){0:4}
        bftst   (*+35,pc,d3.l){0:4}
        bfextu  d1{31:32},d4
        bfextu  (a2){0:4},d4
        bfextu  (a2){d1:3},d4
        bfextu  (a2){1:d3},d4
        bfextu  (a2){d2:d3},d4
        bfextu  ($1234,a2){0:4},d4
        bfextu  (18,a2,d3.w){0:4},d4
        bfextu  ($1234).w{1:2},d4
        bfextu  ($12345678).l{0:16},d4
        bfextu  (*+$1234,pc){0:4},d4
        bfextu  (*+35,pc,d3.l){0:4},d4
        bfchg   d1{31:32}
        bfchg   (a2){0:4}
        bfchg   (a2){d1:3}
        bfchg   (a2){1:d3}
        bfchg   (a2){d2:d3}
        bfchg   ($1234,a2){0:4}
        bfchg   (18,a2,d3.w){0:4}
        bfchg   ($1234).w{1:2}
        bfchg   ($12345678).l{0:16}
        bfexts  d1{31:32},d4
        bfexts  (a2){0:4},d4
        bfexts  (a2){d1:3},d4
        bfexts  (a2){1:d3},d4
        bfexts  (a2){d2:d3},d4
        bfexts  ($1234,a2){0:4},d4
        bfexts  (18,a2,d3.w){0:4},d4
        bfexts  ($1234).w{1:2},d4
        bfexts  ($12345678).l{0:16},d4
        bfexts  (*+$1234,pc){0:4},d4
        bfexts  (*+35,pc,d3.l){0:4},d4
        bfclr   d1{31:32}
        bfclr   (a2){0:4}
        bfclr   (a2){d1:3}
        bfclr   (a2){1:d3}
        bfclr   (a2){d2:d3}
        bfclr   ($1234,a2){0:4}
        bfclr   (18,a2,d3.w){0:4}
        bfclr   ($1234).w{1:2}
        bfclr   ($12345678).l{0:16}
        bfffo   d1{31:32},d4
        bfffo   (a2){0:4},d4
        bfffo   (a2){d1:3},d4
        bfffo   (a2){1:d3},d4
        bfffo   (a2){d2:d3},d4
        bfffo   ($1234,a2){0:4},d4
        bfffo   (18,a2,d3.w){0:4},d4
        bfffo   ($1234).w{1:2},d4
        bfffo   ($12345678).l{0:16},d4
        bfffo   (*+$1234,pc){0:4},d4
        bfffo   (*+35,pc,d3.l){0:4},d4
        bfset   d1{31:32}
        bfset   (a2){0:4}
        bfset   (a2){d1:3}
        bfset   (a2){1:d3}
        bfset   (a2){d2:d3}
        bfset   ($1234,a2){0:4}
        bfset   (18,a2,d3.w){0:4}
        bfset   ($1234).w{1:2}
        bfset   ($12345678).l{0:16}
        bfins   d4,d1{31:32}
        bfins   d4,(a2){0:4}
        bfins   d4,(a2){d1:3}
        bfins   d4,(a2){1:d3}
        bfins   d4,(a2){d2:d3}
        bfins   d4,($1234,a2){0:4}
        bfins   d4,(18,a2,d3.w){0:4}
        bfins   d4,($1234).w{1:2}
        bfins   d4,($12345678).l{0:16}
        cmp2.b  (a2),d7
        cmp2.b  ($1234,a2),a6
        cmp2.b  (18,a2,d3.l),d7
        cmp2.b  ($fffffffe).w,a0
        cmp2.b  ($12345678).l,d0
        cmp2.b  (*+$1234,pc),a1
        cmp2.b  (*+18,pc,d3.w),d2
        cmp2.w  (a2),d3
        cmp2.w  ($1234,a2),a6
        cmp2.w  (18,a2,d3.l),d7
        cmp2.w  ($fffffffe).w,a0
        cmp2.w  ($12345678).l,d0
        cmp2.w  (*+$1234,pc),a1
        cmp2.w  (*+18,pc,d3.w),d2
        cmp2.l  (a2),d3
        cmp2.l  ($1234,a2),a6
        cmp2.l  (18,a2,d3.l),d7
        cmp2.l  ($fffffffe).w,a0
        cmp2.l  ($12345678).l,d0
        cmp2.l  (*+$1234,pc),a1
        cmp2.l  (*+18,pc,d3.w),d2
        divs.l  d2,d7
        divs.l  (a2),d7
        divs.l  (a2)+,d7
        divs.l  -(a2),d7
        divs.l  ($1234,a2),d7
        divs.l  (18,a2,d3.l),d7
        divs.l  ($fffffffe).w,d7
        divs.l  ($12345678).l,d7
        divs.l  (*+$1234,pc),d7
        divs.l  (*+18,pc,d3.w),d7
        divsl.l d2,d6:d7
        divsl.l (a2),d6:d7
        divsl.l (a2)+,d6:d7
        divsl.l -(a2),d6:d7
        divsl.l ($1234,a2),d6:d7
        divsl.l (18,a2,d3.l),d6:d7
        divsl.l ($fffffffe).w,d6:d7
        divsl.l ($12345678).l,d6:d7
        divsl.l (*+$1234,pc),d6:d7
        divsl.l (*+18,pc,d3.w),d6:d7
        divs.l  d2,d6:d7
        divs.l  (a2),d6:d7
        divs.l  (a2)+,d6:d7
        divs.l  -(a2),d6:d7
        divs.l  ($1234,a2),d6:d7
        divs.l  (18,a2,d3.l),d6:d7
        divs.l  ($fffffffe).w,d6:d7
        divs.l  ($12345678).l,d6:d7
        divs.l  (*+$1234,pc),d6:d7
        divs.l  (*+18,pc,d3.w),d6:d7
        divu.l  d2,d7
        divu.l  (a2),d7
        divu.l  (a2)+,d7
        divu.l  -(a2),d7
        divu.l  ($1234,a2),d7
        divu.l  (18,a2,d3.l),d7
        divu.l  ($fffffffe).w,d7
        divu.l  ($12345678).l,d7
        divu.l  (*+$1234,pc),d7
        divu.l  (*+18,pc,d3.w),d7
        divul.l d2,d6:d7
        divul.l (a2),d6:d7
        divul.l (a2)+,d6:d7
        divul.l -(a2),d6:d7
        divul.l ($1234,a2),d6:d7
        divul.l (18,a2,d3.l),d6:d7
        divul.l ($fffffffe).w,d6:d7
        divul.l ($12345678).l,d6:d7
        divul.l (*+$1234,pc),d6:d7
        divul.l (*+18,pc,d3.w),d6:d7
        divu.l  d2,d6:d7
        divu.l  (a2),d6:d7
        divu.l  (a2)+,d6:d7
        divu.l  -(a2),d6:d7
        divu.l  ($1234,a2),d6:d7
        divu.l  (18,a2,d3.l),d6:d7
        divu.l  ($fffffffe).w,d6:d7
        divu.l  ($12345678).l,d6:d7
        divu.l  (*+$1234,pc),d6:d7
        divu.l  (*+18,pc,d3.w),d6:d7
        muls.l  d2,d7
        muls.l  (a2),d7
        muls.l  (a2)+,d7
        muls.l  -(a2),d7
        muls.l  ($1234,a2),d7
        muls.l  (18,a2,d3.l),d7
        muls.l  ($fffffffe).w,d7
        muls.l  ($12345678).l,d7
        muls.l  (*+$1234,pc),d7
        muls.l  (*+18,pc,d3.w),d7
        muls.l  d2,d6:d7
        muls.l  (a2),d6:d7
        muls.l  (a2)+,d6:d7
        muls.l  -(a2),d6:d7
        muls.l  ($1234,a2),d6:d7
        muls.l  (18,a2,d3.l),d6:d7
        muls.l  ($fffffffe).w,d6:d7
        muls.l  ($12345678).l,d6:d7
        muls.l  (*+$1234,pc),d6:d7
        muls.l  (*+18,pc,d3.w),d6:d7
        mulu.l  d2,d7
        mulu.l  (a2),d7
        mulu.l  (a2)+,d7
        mulu.l  -(a2),d7
        mulu.l  ($1234,a2),d7
        mulu.l  (18,a2,d3.l),d7
        mulu.l  ($fffffffe).w,d7
        mulu.l  ($12345678).l,d7
        mulu.l  (*+$1234,pc),d7
        mulu.l  (*+18,pc,d3.w),d7
        mulu.l  d2,d6:d7
        mulu.l  (a2),d6:d7
        mulu.l  (a2)+,d6:d7
        mulu.l  -(a2),d6:d7
        mulu.l  ($1234,a2),d6:d7
        mulu.l  (18,a2,d3.l),d6:d7
        mulu.l  ($fffffffe).w,d6:d7
        mulu.l  ($12345678).l,d6:d7
        mulu.l  (*+$1234,pc),d6:d7
        mulu.l  (*+18,pc,d3.w),d6:d7
        pack    d2,d7,#$234
        pack    -(a2),-(a7),#$1234
        unpk    d2,d7,#$1234
        unpk    -(a2),-(a7),#$1234
        bra.x   *+2
        bra.x   *+$80
        bra.x   *-$8000
        bra.x   *+$8002
        bsr.x   *+2
        bsr.x   *+$80
        bsr.x   *-$8000
        bsr.x   *+$8002
        chk.l   d2,d7
        chk.l   (a2),d7
        chk.l   (a2)+,d7
        chk.l   -(a2),d7
        chk.l   ($1234,a2),d7
        chk.l   (18,a2,d3.l),d7
        chk.l   ($fffffffe).w,d7
        chk.l   ($12345678).l,d7
        chk.l   (*+$1234,pc),d7
        chk.l   (*+18,pc,d3.w),d7
        chk2.b  (a2),d7
        chk2.b  ($1234,a2),d7
        chk2.b  (18,a2,d3.l),d7
        chk2.b  ($fffffffe).w,d7
        chk2.b  ($12345678).l,d7
        chk2.b  (*+$1234,pc),d7
        chk2.b  (*+18,pc,d3.w),d7
        chk2.w  (a2),d7
        chk2.w  ($1234,a2),d7
        chk2.w  (18,a2,d3.l),d7
        chk2.w  ($fffffffe).w,d7
        chk2.w  ($12345678).l,d7
        chk2.w  (*+$1234,pc),d7
        chk2.w  (*+18,pc,d3.w),d7
        chk2.l  (a2),d7
        chk2.l  ($1234,a2),d7
        chk2.l  (18,a2,d3.l),d7
        chk2.l  ($fffffffe).w,d7
        chk2.l  ($12345678).l,d7
        chk2.l  (*+$1234,pc),d7
        chk2.l  (*+18,pc,d3.w),d7
        cas.b   d2,d3,(a4)
        cas.b   d2,d3,(a4)+
        cas.b   d2,d3,-(a4)
        cas.b   d2,d3,($1234,a4)
        cas.b   d2,d3,(18,a4,d5.w)
        cas.b   d2,d3,($1234).w
        cas.b   d2,d3,($12345678).l
        cas.w   d2,d3,(a4)
        cas.w   d2,d3,(a4)+
        cas.w   d2,d3,-(a4)
        cas.w   d2,d3,($1234,a4)
        cas.w   d2,d3,(18,a4,d5.w)
        cas.w   d2,d3,($1234).w
        cas.w   d2,d3,($12345678).l
        cas.l   d2,d3,(a4)
        cas.l   d2,d3,(a4)+
        cas.l   d2,d3,-(a4)
        cas.l   d2,d3,($1234,a4)
        cas.l   d2,d3,(18,a4,d5.w)
        cas.l   d2,d3,($1234).w
        cas.l   d2,d3,($12345678).l
        cas2.w  d1:d2,d3:d4,(d5):(d6)
        cas2.w  d1:d2,d3:d4,(a5):(d6)
        cas2.w  d1:d2,d3:d4,(d5):(a6)
        cas2.w  d1:d2,d3:d4,(a5):(a6)
        cas2.l  d1:d2,d3:d4,(d5):(d6)
        cas2.l  d1:d2,d3:d4,(a5):(d6)
        cas2.l  d1:d2,d3:d4,(d5):(a6)
        cas2.l  d1:d2,d3:d4,(a5):(a6)
        trapt
        trapf
        traphi
        trapls
        trapcc
        trapcs
        trapne
        trapeq
        trapvc
        trapvs
        trappl
        trapmi
        trapge
        traplt
        trapgt
        traple
        trapt.w         #$1234
        trapf.w         #$1234
        traphi.w        #$1234
        trapls.w        #$1234
        trapcc.w        #$1234
        trapcs.w        #$1234
        trapne.w        #$1234
        trapeq.w        #$1234
        trapvc.w        #$1234
        trapvs.w        #$1234
        trappl.w        #$1234
        trapmi.w        #$1234
        trapge.w        #$1234
        traplt.w        #$1234
        trapgt.w        #$1234
        traple.w        #$1234
        trapt.l         #$12345678
        trapf.l         #$12345678
        traphi.l        #$12345678
        trapls.l        #$12345678
        trapcc.l        #$12345678
        trapcs.l        #$12345678
        trapne.l        #$12345678
        trapeq.l        #$12345678
        trapvc.l        #$12345678
        trapvs.l        #$12345678
        trappl.l        #$12345678
        trapmi.l        #$12345678
        trapge.l        #$12345678
        traplt.l        #$12345678
        trapgt.l        #$12345678
        traple.l        #$12345678
        movec   cacr, d1
        movec   msp, a3
        movec   isp, a4
        movec   a5, cacr
        movec   d7, msp
        movec   d0, isp
;;; Brief extention
        ;; scaled index
        move.l  ($23,a7,d1.w*1),d2
        move.l  ($23,a7,a1.w*2),d2
        move.l  ($23,a7,d1.w*4),d2
        move.l  ($23,a7,a1.w*8),d2
        move.l  ($23,a7,a1.l*1),d2
        move.l  ($23,a7,d1.l*2),d2
        move.l  ($23,a7,a1.l*4),d2
        move.l  ($23,a7,d1.l*8),d2
        move.l  (*+54,pc,a1.w*1),d2
        move.l  (*+54,pc,d1.w*2),d2
        move.l  (*+54,pc,a1.w*4),d2
        move.l  (*+54,pc,d1.w*8),d2
        move.l  (*+54,pc,d1.l*1),d2
        move.l  (*+54,pc,a1.l*2),d2
        move.l  (*+54,pc,d1.l*4),d2
        move.l  (*+54,pc,a1.l*8),d2
        ;; no displacement
        move.l  (a7,d1.w),d2
        move.l  (a7,d1.l),d2
        move.l  (a7,a1.w),d2
        move.l  (a7,a1.l),d2
;;; Full extension
        ;; large displacement
        move.l  ($12345678,a7),d2
        move.l  ($12345678,a7,d1.w),d2
        move.l  ($12345678,a7,d1.l),d2
        move.l  ($12345678,a7,a1.w),d2
        move.l  ($12345678,a7,a1.l),d2
        ;; extended base without indirect
        move.l  (a7.w),d2
        move.l  (d1.w),d2
        move.l  (d1.l),d2
        move.l  ($1234,a7.w),d2
        move.l  ($1234,d1.w),d2
        move.l  ($1234,d1.l),d2
        move.l  ($12345678,a7.w),d2
        move.l  ($12345678,d1.w),d2
        move.l  ($12345678,d1.l),d2
        ;; indirect without base and index
        move.l  ([$1234]),d2
        move.l  ([$1234],$5678),d2
        move.l  ([$1234],$56789ABC),d2
        move.l  ([$12345678]),d2
        move.l  ([$12345678],$7654),d2
        move.l  ([$12345678],$76543210),d2
        ;; indirect without base
        move.l  ([$1234],a7.w),d2
        move.l  ([$1234],a7.w,$5678),d2
        move.l  ([$1234],a7.w,$56789ABC),d2
        move.l  ([$1234],d1.w),d2
        move.l  ([$1234],d1.w,$5678),d2
        move.l  ([$1234],d1.w,$56789ABC),d2
        move.l  ([$1234],d1.l),d2
        move.l  ([$1234],d1.l,$5678),d2
        move.l  ([$1234],d1.l,$56789ABC),d2
        move.l  ([$12345678],a7.l),d2
        move.l  ([$12345678],a7.l,$5678),d2
        move.l  ([$12345678],a7.l,$56789ABC),d2
        move.l  ([$12345678],a7.w),d2
        move.l  ([$12345678],a7.w,$5678),d2
        move.l  ([$12345678],a7.w,$56789ABC),d2
        move.l  ([$12345678],d1.w),d2
        move.l  ([$12345678],d1.w,$5678),d2
        move.l  ([$12345678],d1.w,$56789ABC),d2
        move.l  ([$12345678],d1.l),d2
        move.l  ([$12345678],d1.l,$5678),d2
        move.l  ([$12345678],d1.l,$56789ABC),d2
        ;; indirect with base and no index
        move.l  ([a7]),d2
        move.l  ([a7],$1234),d2
        move.l  ([a7],$12345678),d2
        move.l  ([a7.w]),d2
        move.l  ([a7.w],$1234),d2
        move.l  ([a7.w],$12345678),d2
        move.l  ([d1.w]),d2
        move.l  ([d1.w],$1234),d2
        move.l  ([d1.w],$12345678),d2
        move.l  ([d1.l]),d2
        move.l  ([d1.l],$1234),d2
        move.l  ([d1.l],$12345678),d2
        move.l  ([$1234,a7]),d2
        move.l  ([$1234,a7],$5678),d2
        move.l  ([$1234,a7],$56789ABC),d2
        move.l  ([$1234,a7.w]),d2
        move.l  ([$1234,a7.w],$5678),d2
        move.l  ([$1234,a7.w],$56789ABC),d2
        move.l  ([$1234,d1.w]),d2
        move.l  ([$1234,d1.w],$5678),d2
        move.l  ([$1234,d1.w],$56789ABC),d2
        move.l  ([$1234,d1.l]),d2
        move.l  ([$1234,d1.l],$5678),d2
        move.l  ([$1234,d1.l],$56789ABC),d2
        move.l  ([$12345678,a7]),d2
        move.l  ([$12345678,a7],$7654),d2
        move.l  ([$12345678,a7],$76543210),d2
        move.l  ([$12345678,a7.w]),d2
        move.l  ([$12345678,a7.w],$7654),d2
        move.l  ([$12345678,a7.w],$76543210),d2
        move.l  ([$12345678,d1.w]),d2
        move.l  ([$12345678,d1.w],$7654),d2
        move.l  ([$12345678,d1.w],$76543210),d2
        move.l  ([$12345678,d1.l]),d2
        move.l  ([$12345678,d1.l],$7654),d2
        move.l  ([$12345678,d1.l],$76543210),d2
        ;; indirect with base and inner index
        move.l  ([a7,d1.w]),d2
        move.l  ([a7,d1.w],$1234),d2
        move.l  ([a7,d1.w],$12345678),d2
        move.l  ([a7,d1.l]),d2
        move.l  ([a7,d1.l],$1234),d2
        move.l  ([a7,d1.l],$12345678),d2
        move.l  ([a7,a1.w]),d2
        move.l  ([a7,a1.w],$1234),d2
        move.l  ([a7,a1.w],$12345678),d2
        move.l  ([a7,a1.l]),d2
        move.l  ([a7,a1.l],$1234),d2
        move.l  ([a7,a1.l],$12345678),d2
        move.l  ([$1234,a7,d1.w]),d2
        move.l  ([$1234,a7,d1.w],$7654),d2
        move.l  ([$1234,a7,d1.w],$76543210),d2
        move.l  ([$1234,a7,d1.l]),d2
        move.l  ([$1234,a7,d1.l],$7654),d2
        move.l  ([$1234,a7,d1.l],$76543210),d2
        move.l  ([$1234,a7,a1.w]),d2
        move.l  ([$1234,a7,a1.w],$7654),d2
        move.l  ([$1234,a7,a1.w],$76543210),d2
        move.l  ([$1234,a7,a1.l]),d2
        move.l  ([$1234,a7,a1.l],$7654),d2
        move.l  ([$1234,a7,a1.l],$76543210),d2
        move.l  ([$12345678,a7,d1.w]),d2
        move.l  ([$12345678,a7,d1.w],$7654),d2
        move.l  ([$12345678,a7,d1.w],$76543210),d2
        move.l  ([$12345678,a7,d1.l]),d2
        move.l  ([$12345678,a7,d1.l],$7654),d2
        move.l  ([$12345678,a7,d1.l],$76543210),d2
        move.l  ([$12345678,a7,a1.w]),d2
        move.l  ([$12345678,a7,a1.w],$7654),d2
        move.l  ([$12345678,a7,a1.w],$76543210),d2
        move.l  ([$12345678,a7,a1.l]),d2
        move.l  ([$12345678,a7,a1.l],$7654),d2
        move.l  ([$12345678,a7,a1.l],$76543210),d2
        ;; indirect with base and outer index
        move.l  ([a7],d1.w),d2
        move.l  ([a7],d1.w,$1234),d2
        move.l  ([a7],d1.w,$12345678),d2
        move.l  ([a7],d1.l),d2
        move.l  ([a7],d1.l,$1234),d2
        move.l  ([a7],d1.l,$12345678),d2
        move.l  ([a7],a1.w),d2
        move.l  ([a7],a1.w,$1234),d2
        move.l  ([a7],a1.w,$12345678),d2
        move.l  ([a7],a1.l),d2
        move.l  ([a7],a1.l,$1234),d2
        move.l  ([a7],a1.l,$12345678),d2
        move.l  ([$1234,a7],d1.w),d2
        move.l  ([$1234,a7],d1.w,$7654),d2
        move.l  ([$1234,a7],d1.w,$76543210),d2
        move.l  ([$1234,a7],d1.l),d2
        move.l  ([$1234,a7],d1.l,$7654),d2
        move.l  ([$1234,a7],d1.l,$76543210),d2
        move.l  ([$1234,a7],a1.w),d2
        move.l  ([$1234,a7],a1.w,$7654),d2
        move.l  ([$1234,a7],a1.w,$76543210),d2
        move.l  ([$1234,a7],a1.l),d2
        move.l  ([$1234,a7],a1.l,$7654),d2
        move.l  ([$1234,a7],a1.l,$76543210),d2
        move.l  ([$12345678,a7],d1.w),d2
        move.l  ([$12345678,a7],d1.w,$7654),d2
        move.l  ([$12345678,a7],d1.w,$76543210),d2
        move.l  ([$12345678,a7],d1.l),d2
        move.l  ([$12345678,a7],d1.l,$7654),d2
        move.l  ([$12345678,a7],d1.l,$76543210),d2
        move.l  ([$12345678,a7],a1.w),d2
        move.l  ([$12345678,a7],a1.w,$7654),d2
        move.l  ([$12345678,a7],a1.w,$76543210),d2
        move.l  ([$12345678,a7],a1.l),d2
        move.l  ([$12345678,a7],a1.l,$7654),d2
        move.l  ([$12345678,a7],a1.l,$76543210),d2
        ;; pc-relative large displacement
        move.l  (*+$12345678,pc),d2
        move.l  (*+$12345678,pc,d1.w),d2
        move.l  (*+$12345678,pc,d1.l),d2
        move.l  (*+$12345678,pc,a1.w),d2
        move.l  (*+$12345678,pc,a1.l),d2
        ;; pc-relative indirect without index
        move.l  ([*+2,pc]),d2
        move.l  ([*+2,pc],$1234),d2
        move.l  ([*+2,pc],$12345678),d2
        move.l  ([*+$1234,pc]),d2
        move.l  ([*+$1234,pc],$7654),d2
        move.l  ([*+$1234,pc],$76543210),d2
        move.l  ([*+$12345678,pc]),d2
        move.l  ([*+$12345678,pc],$7654),d2
        move.l  ([*+$12345678,pc],$76543210),d2
        ;; pc-relative indirect with inner index
        move.l  ([*+2,pc,d1.w]),d2
        move.l  ([*+2,pc,d1.w],$1234),d2
        move.l  ([*+2,pc,d1.w],$12345678),d2
        move.l  ([*+2,pc,d1.l]),d2
        move.l  ([*+2,pc,d1.l],$1234),d2
        move.l  ([*+2,pc,d1.l],$12345678),d2
        move.l  ([*+2,pc,a1.w]),d2
        move.l  ([*+2,pc,a1.w],$1234),d2
        move.l  ([*+2,pc,a1.w],$12345678),d2
        move.l  ([*+2,pc,a1.l]),d2
        move.l  ([*+2,pc,a1.l],$1234),d2
        move.l  ([*+2,pc,a1.l],$12345678),d2
        move.l  ([*+$1234,pc,d1.w]),d2
        move.l  ([*+$1234,pc,d1.w],$7654),d2
        move.l  ([*+$1234,pc,d1.w],$76543210),d2
        move.l  ([*+$1234,pc,d1.l]),d2
        move.l  ([*+$1234,pc,d1.l],$7654),d2
        move.l  ([*+$1234,pc,d1.l],$76543210),d2
        move.l  ([*+$1234,pc,a1.w]),d2
        move.l  ([*+$1234,pc,a1.w],$7654),d2
        move.l  ([*+$1234,pc,a1.w],$76543210),d2
        move.l  ([*+$1234,pc,a1.l]),d2
        move.l  ([*+$1234,pc,a1.l],$7654),d2
        move.l  ([*+$1234,pc,a1.l],$76543210),d2
        move.l  ([*+$12345678,pc,d1.w]),d2
        move.l  ([*+$12345678,pc,d1.w],$7654),d2
        move.l  ([*+$12345678,pc,d1.w],$76543210),d2
        move.l  ([*+$12345678,pc,d1.l]),d2
        move.l  ([*+$12345678,pc,d1.l],$7654),d2
        move.l  ([*+$12345678,pc,d1.l],$76543210),d2
        move.l  ([*+$12345678,pc,a1.w]),d2
        move.l  ([*+$12345678,pc,a1.w],$7654),d2
        move.l  ([*+$12345678,pc,a1.w],$76543210),d2
        move.l  ([*+$12345678,pc,a1.l]),d2
        move.l  ([*+$12345678,pc,a1.l],$7654),d2
        move.l  ([*+$12345678,pc,a1.l],$76543210),d2
        ;; pc-relative indirect with outer index
        move.l  ([*+2,pc],d1.w),d2
        move.l  ([*+2,pc],d1.w,$1234),d2
        move.l  ([*+2,pc],d1.w,$12345678),d2
        move.l  ([*+2,pc],d1.l),d2
        move.l  ([*+2,pc],d1.l,$1234),d2
        move.l  ([*+2,pc],d1.l,$12345678),d2
        move.l  ([*+2,pc],a1.w),d2
        move.l  ([*+2,pc],a1.w,$1234),d2
        move.l  ([*+2,pc],a1.w,$12345678),d2
        move.l  ([*+2,pc],a1.l),d2
        move.l  ([*+2,pc],a1.l,$1234),d2
        move.l  ([*+2,pc],a1.l,$12345678),d2
        move.l  ([*+$1234,pc],d1.w),d2
        move.l  ([*+$1234,pc],d1.w,$7654),d2
        move.l  ([*+$1234,pc],d1.w,$76543210),d2
        move.l  ([*+$1234,pc],d1.l),d2
        move.l  ([*+$1234,pc],d1.l,$7654),d2
        move.l  ([*+$1234,pc],d1.l,$76543210),d2
        move.l  ([*+$1234,pc],a1.w),d2
        move.l  ([*+$1234,pc],a1.w,$7654),d2
        move.l  ([*+$1234,pc],a1.w,$76543210),d2
        move.l  ([*+$1234,pc],a1.l),d2
        move.l  ([*+$1234,pc],a1.l,$7654),d2
        move.l  ([*+$1234,pc],a1.l,$76543210),d2
        move.l  ([*+$12345678,pc],d1.w),d2
        move.l  ([*+$12345678,pc],d1.w,$7654),d2
        move.l  ([*+$12345678,pc],d1.w,$76543210),d2
        move.l  ([*+$12345678,pc],d1.l),d2
        move.l  ([*+$12345678,pc],d1.l,$7654),d2
        move.l  ([*+$12345678,pc],d1.l,$76543210),d2
        move.l  ([*+$12345678,pc],a1.w),d2
        move.l  ([*+$12345678,pc],a1.w,$7654),d2
        move.l  ([*+$12345678,pc],a1.w,$76543210),d2
        move.l  ([*+$12345678,pc],a1.l),d2
        move.l  ([*+$12345678,pc],a1.l,$7654),d2
        move.l  ([*+$12345678,pc],a1.l,$76543210),d2

;# Local Variables:
;# mode: asm
;# End:
;# vim: set ft=asm:
