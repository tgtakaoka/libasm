;;; Copyright 2020 Tadashi G. Takaoka
;;;
;;; Licensed under the Apache License, Version 2.0 (the "License");
;;; you may not use this file except in compliance with the License.
;;; You may obtain a copy of the License at
;;;
;;;     http://www.apache.org/licenses/LICENSE-2.0
;;;
;;; Unless required by applicable law or agreed to in writing, software
;;; distributed under the License is distributed on an "AS IS" BASIS,
;;; WITHOUT WARRANTIES OR CONDITIONS OF ANY KIND, either express or implied.
;;; See the License for the specific language governing permissions and
;;; limitations under the License.

        LD      B,B
        LD      B,C
        LD      B,D
        LD      B,E
        LD      B,H
        LD      B,L
        LD      B,A
        LD      B,34H
        LD      B,(BC)
        LD      B,(DE)
        LD      B,(HL)
        LD      B,(1234H)
        LD      B,(IX)
        LD      B,(IY)
        LD      B,(SP)
        LD      B,(0FF34H)
        LD      B,(IX+34H)
        LD      B,(IY-34H)
        LD      B,(SP+34H)
        LD      B,(HL+A)

        LD      C,B
        LD      C,C
        LD      C,D
        LD      C,E
        LD      C,H
        LD      C,L
        LD      C,A
        LD      C,34H
        LD      C,(BC)
        LD      C,(DE)
        LD      C,(HL)
        LD      C,(1234H)
        LD      C,(IX)
        LD      C,(IY)
        LD      C,(SP)
        LD      C,(0FF34H)
        LD      C,(IX+34H)
        LD      C,(IY-34H)
        LD      C,(SP+34H)
        LD      C,(HL+A)

        LD      D,B
        LD      D,C
        LD      D,D
        LD      D,E
        LD      D,H
        LD      D,L
        LD      D,A
        LD      D,34H
        LD      D,(BC)
        LD      D,(DE)
        LD      D,(HL)
        LD      D,(1234H)
        LD      D,(IX)
        LD      D,(IY)
        LD      D,(SP)
        LD      D,(0FF34H)
        LD      D,(IX+34H)
        LD      D,(IY-34H)
        LD      D,(SP+34H)
        LD      D,(HL+A)

        LD      E,B
        LD      E,C
        LD      E,D
        LD      E,E
        LD      E,H
        LD      E,L
        LD      E,A
        LD      E,34H
        LD      E,(BC)
        LD      E,(DE)
        LD      E,(HL)
        LD      E,(1234H)
        LD      E,(IX)
        LD      E,(IY)
        LD      E,(SP)
        LD      E,(0FF34H)
        LD      E,(IX+34H)
        LD      E,(IY-34H)
        LD      E,(SP+34H)
        LD      E,(HL+A)

        LD      H,B
        LD      H,C
        LD      H,D
        LD      H,E
        LD      H,H
        LD      H,L
        LD      H,A
        LD      H,34H
        LD      H,(BC)
        LD      H,(DE)
        LD      H,(HL)
        LD      H,(1234H)
        LD      H,(IX)
        LD      H,(IY)
        LD      H,(SP)
        LD      H,(0FF34H)
        LD      H,(IX+34H)
        LD      H,(IY-34H)
        LD      H,(SP+34H)
        LD      H,(HL+A)

        LD      L,B
        LD      L,C
        LD      L,D
        LD      L,E
        LD      L,H
        LD      L,L
        LD      L,A
        LD      L,34H
        LD      L,(BC)
        LD      L,(DE)
        LD      L,(HL)
        LD      L,(1234H)
        LD      L,(IX)
        LD      L,(IY)
        LD      L,(SP)
        LD      L,(0FF34H)
        LD      L,(IX+34H)
        LD      L,(IY-34H)
        LD      L,(SP+34H)
        LD      L,(HL+A)

        LD      A,B
        LD      A,C
        LD      A,D
        LD      A,E
        LD      A,H
        LD      A,L
        LD      A,A
        LD      A,34H
        LD      A,(BC)
        LD      A,(DE)
        LD      A,(HL)
        LD      A,(1234H)
        LD      A,(IX)
        LD      A,(IY)
        LD      A,(SP)
        LD      A,(0FF34H)
        LD      A,(IX+34H)
        LD      A,(IY-34H)
        LD      A,(SP+34H)
        LD      A,(HL+A)

        LD      (BC),B
        LD      (DE),B
        LD      (HL),B
        LD      (1234H),B
        LD      (IX),B
        LD      (IY),B
        LD      (SP),B
        LD      (0FF34H),B
        LD      (IX+34H),B
        LD      (IY-34H),B
        LD      (SP+34H),B
        LD      (HL+A),B

        LD      (BC),C
        LD      (DE),C
        LD      (HL),C
        LD      (1234H),C
        LD      (IX),C
        LD      (IY),C
        LD      (SP),C
        LD      (0FF34H),C
        LD      (IX+34H),C
        LD      (IY-34H),C
        LD      (SP+34H),C
        LD      (HL+A),C

        LD      (BC),D
        LD      (DE),D
        LD      (HL),D
        LD      (1234H),D
        LD      (IX),D
        LD      (IY),D
        LD      (SP),D
        LD      (0FF34H),D
        LD      (IX+34H),D
        LD      (IY-34H),D
        LD      (SP+34H),D
        LD      (HL+A),D

        LD      (BC),E
        LD      (DE),E
        LD      (HL),E
        LD      (1234H),E
        LD      (IX),E
        LD      (IY),E
        LD      (SP),E
        LD      (0FF34H),E
        LD      (IX+34H),E
        LD      (IY-34H),E
        LD      (SP+34H),E
        LD      (HL+A),E

        LD      (BC),H
        LD      (DE),H
        LD      (HL),H
        LD      (1234H),H
        LD      (IX),H
        LD      (IY),H
        LD      (SP),H
        LD      (0FF34H),H
        LD      (IX+34H),H
        LD      (IY-34H),H
        LD      (SP+34H),H
        LD      (HL+A),H

        LD      (BC),L
        LD      (DE),L
        LD      (HL),L
        LD      (1234H),L
        LD      (IX),L
        LD      (IY),L
        LD      (SP),L
        LD      (0FF34H),L
        LD      (IX+34H),L
        LD      (IY-34H),L
        LD      (SP+34H),L
        LD      (HL+A),L

        LD      (BC),A
        LD      (DE),A
        LD      (HL),A
        LD      (1234H),A
        LD      (IX),A
        LD      (IY),A
        LD      (SP),A
        LD      (0FF34H),A
        LD      (IX+34H),A
        LD      (IY-34H),A
        LD      (SP+34H),A
        LD      (HL+A),A

        LD      (BC),34H
        LD      (DE),34H
        LD      (HL),56H
        LD      (1234H),56H
        LD      (IX),78H
        LD      (IY),9AH
        LD      (SP),0BCH
        LD      (0FF34H),34H
        LD      (IX+34H),34H
        LD      (IY-34H),56H
        LD      (SP+34H),78H
        LD      (HL+A),9AH

        LD      BC,BC
        LD      BC,DE
        LD      BC,HL
        LD      BC,IX
        LD      BC,IY
        LD      BC,SP
        LD      BC,1234H
        LD      BC,(BC)
        LD      BC,(DE)
        LD      BC,(HL)
        LD      BC,(1234H)
        LD      BC,(IX)
        LD      BC,(IY)
        LD      BC,(SP)
        LD      BC,(0FF34H)
        LD      BC,(IX+34H)
        LD      BC,(IY-34H)
        LD      BC,(SP+34H)
        LD      BC,(HL+A)

        LD      DE,BC
        LD      DE,DE
        LD      DE,HL
        LD      DE,IX
        LD      DE,IY
        LD      DE,SP
        LD      DE,1234H
        LD      DE,(BC)
        LD      DE,(DE)
        LD      DE,(HL)
        LD      DE,(1234H)
        LD      DE,(IX)
        LD      DE,(IY)
        LD      DE,(SP)
        LD      DE,(0FF34H)
        LD      DE,(IX+34H)
        LD      DE,(IY-34H)
        LD      DE,(SP+34H)
        LD      DE,(HL+A)

        LD      HL,BC
        LD      HL,DE
        LD      HL,HL
        LD      HL,IX
        LD      HL,IY
        LD      HL,SP
        LD      HL,1234H
        LD      HL,(BC)
        LD      HL,(DE)
        LD      HL,(HL)
        LD      HL,(1234H)
        LD      HL,(IX)
        LD      HL,(IY)
        LD      HL,(SP)
        LD      HL,(0FF34H)
        LD      HL,(IX+34H)
        LD      HL,(IY-34H)
        LD      HL,(SP+34H)
        LD      HL,(HL+A)

        LD      IX,BC
        LD      IX,DE
        LD      IX,HL
        LD      IX,IX
        LD      IX,IY
        LD      IX,SP
        LD      IX,1234H
        LD      IX,(BC)
        LD      IX,(DE)
        LD      IX,(HL)
        LD      IX,(1234H)
        LD      IX,(IX)
        LD      IX,(IY)
        LD      IX,(SP)
        LD      IX,(0FF34H)
        LD      IX,(IX+34H)
        LD      IX,(IY-34H)
        LD      IX,(SP+34H)
        LD      IX,(HL+A)

        LD      IY,BC
        LD      IY,DE
        LD      IY,HL
        LD      IY,IX
        LD      IY,IY
        LD      IY,SP
        LD      IY,1234H
        LD      IY,(BC)
        LD      IY,(DE)
        LD      IY,(HL)
        LD      IY,(1234H)
        LD      IY,(IX)
        LD      IY,(IY)
        LD      IY,(SP)
        LD      IY,(0FF34H)
        LD      IY,(IX+34H)
        LD      IY,(IY-34H)
        LD      IY,(SP+34H)
        LD      IY,(HL+A)

        LD      SP,BC
        LD      SP,DE
        LD      SP,HL
        LD      SP,IX
        LD      SP,IY
        LD      SP,SP
        LD      SP,1234H
        LD      SP,(BC)
        LD      SP,(DE)
        LD      SP,(HL)
        LD      SP,(1234H)
        LD      SP,(IX)
        LD      SP,(IY)
        LD      SP,(SP)
        LD      SP,(0FF34H)
        LD      SP,(IX+34H)
        LD      SP,(IY-34H)
        LD      SP,(SP+34H)
        LD      SP,(HL+A)

        LD      (BC),BC
        LD      (DE),BC
        LD      (HL),BC
        LD      (1234H),BC
        LD      (IX),BC
        LD      (IY),BC
        LD      (SP),BC
        LD      (0FF34H),BC
        LD      (IX+34H),BC
        LD      (IY-34H),BC
        LD      (SP+34H),BC
        LD      (HL+A),BC

        LD      (BC),DE
        LD      (DE),DE
        LD      (HL),DE
        LD      (1234H),DE
        LD      (IX),DE
        LD      (IY),DE
        LD      (SP),DE
        LD      (0FF34H),DE
        LD      (IX+34H),DE
        LD      (IY-34H),DE
        LD      (SP+34H),DE
        LD      (HL+A),DE

        LD      (BC),HL
        LD      (DE),HL
        LD      (HL),HL
        LD      (1234H),HL
        LD      (IX),HL
        LD      (IY),HL
        LD      (SP),HL
        LD      (0FF34H),HL
        LD      (IX+34H),HL
        LD      (IY-34H),HL
        LD      (SP+34H),HL
        LD      (HL+A),HL

        LD      (BC),IX
        LD      (DE),IX
        LD      (HL),IX
        LD      (1234H),IX
        LD      (IX),IX
        LD      (IY),IX
        LD      (SP),IX
        LD      (0FF34H),IX
        LD      (IX+34H),IX
        LD      (IY-34H),IX
        LD      (SP+34H),IX
        LD      (HL+A),IX

        LD      (BC),IY
        LD      (DE),IY
        LD      (HL),IY
        LD      (1234H),IY
        LD      (IX),IY
        LD      (IY),IY
        LD      (SP),IY
        LD      (0FF34H),IY
        LD      (IX+34H),IY
        LD      (IY-34H),IY
        LD      (SP+34H),IY
        LD      (HL+A),IY

        LD      (BC),SP
        LD      (DE),SP
        LD      (HL),SP
        LD      (1234H),SP
        LD      (IX),SP
        LD      (IY),SP
        LD      (SP),SP
        LD      (0FF34H),SP
        LD      (IX+34H),SP
        LD      (IY-34H),SP
        LD      (SP+34H),SP
        LD      (HL+A),SP

        LDW     (BC),5678H
        LDW     (DE),5678H
        LDW     (HL),5678H
        LDW     (1234H),5678H
        LDW     (IX),5678H
        LDW     (IY),5678H
        LDW     (SP),5678H
        LDW     (0FF34H),5678H
        LDW     (IX+34H),5678H
        LDW     (IY-34H),5678H
        LDW     (SP+34H),5678H
        LDW     (HL+A),5678H

        PUSH    BC
        PUSH    DE
        PUSH    HL
        PUSH    IX
        PUSH    IY
        PUSH    AF

        POP     BC
        POP     DE
        POP     HL
        POP     IX
        POP     IY
        POP     AF

        LDA     BC,IX+34H
        LDA     BC,IY-34H
        LDA     BC,SP+34H
        LDA     BC,HL+A

        LDA     DE,IX+34H
        LDA     DE,IY-34H
        LDA     DE,SP+34H
        LDA     DE,HL+A

        LDA     HL,IX+34H
        LDA     HL,IY-34H
        LDA     HL,SP+34H
        LDA     HL,HL+A

        LDA     IX,IX+34H
        LDA     IX,IY-34H
        LDA     IX,SP+34H
        LDA     IX,HL+A

        LDA     IY,IX+34H
        LDA     IY,IY-34H
        LDA     IY,SP+34H
        LDA     IY,HL+A

        LDA     SP,IX+34H
        LDA     SP,IY-34H
        LDA     SP,SP+34H
        LDA     SP,HL+A

        LDAR    HL,$+3
        LDAR    HL,$
        LDAR    HL,$-4FEH
        LDAR    HL,$+401H

        EX      (BC),BC
        EX      (DE),BC
        EX      (HL),BC
        EX      (1234H),BC
        EX      (IX),BC
        EX      (IY),BC
        EX      (SP),BC
        EX      (0FF34H),BC
        EX      (IX+34H),BC
        EX      (IY-34H),BC
        EX      (SP+34H),BC
        EX      (HL+A),BC

        EX      (BC),DE
        EX      (DE),DE
        EX      (HL),DE
        EX      (1234H),DE
        EX      (IX),DE
        EX      (IY),DE
        EX      (SP),DE
        EX      (0FF34H),DE
        EX      (IX+34H),DE
        EX      (IY-34H),DE
        EX      (SP+34H),DE
        EX      (HL+A),DE

        EX      (BC),HL
        EX      (DE),HL
        EX      (HL),HL
        EX      (1234H),HL
        EX      (IX),HL
        EX      (IY),HL
        EX      (SP),HL
        EX      (0FF34H),HL
        EX      (IX+34H),HL
        EX      (IY-34H),HL
        EX      (SP+34H),HL
        EX      (HL+A),HL

        EX      (BC),IX
        EX      (DE),IX
        EX      (HL),IX
        EX      (1234H),IX
        EX      (IX),IX
        EX      (IY),IX
        EX      (SP),IX
        EX      (0FF34H),IX
        EX      (IX+34H),IX
        EX      (IY-34H),IX
        EX      (SP+34H),IX
        EX      (HL+A),IX

        EX      (BC),IY
        EX      (DE),IY
        EX      (HL),IY
        EX      (1234H),IY
        EX      (IX),IY
        EX      (IY),IY
        EX      (SP),IY
        EX      (0FF34H),IY
        EX      (IX+34H),IY
        EX      (IY-34H),IY
        EX      (SP+34H),IY
        EX      (HL+A),IY

        EX      (BC),SP
        EX      (DE),SP
        EX      (HL),SP
        EX      (1234H),SP
        EX      (IX),SP
        EX      (IY),SP
        EX      (SP),SP
        EX      (0FF34H),SP
        EX      (IX+34H),SP
        EX      (IY-34H),SP
        EX      (SP+34H),SP
        EX      (HL+A),SP

        LDI
        LDIR
        LDD
        LDDR
        CPI
        CPIR
        CPD
        CPDR

        ADD     A,B
        ADD     A,C
        ADD     A,D
        ADD     A,E
        ADD     A,H
        ADD     A,L
        ADD     A,A
        ADD     A,(BC)
        ADD     A,(DE)
        ADD     A,(HL)
        ADD     A,(1234H)
        ADD     A,(IX)
        ADD     A,(IY)
        ADD     A,(SP)
        ADD     A,(0FF34H)
        ADD     A,(IX+34H)
        ADD     A,(IY-34H)
        ADD     A,(SP+34H)
        ADD     A,(HL+A)
        ADD     B,34H
        ADD     C,34H
        ADD     D,34H
        ADD     E,34H
        ADD     H,34H
        ADD     L,34H
        ADD     A,34H
        ADD     (BC),56H
        ADD     (DE),56H
        ADD     (HL),56H
        ADD     (1234H),56H
        ADD     (IX),56H
        ADD     (IY),56H
        ADD     (SP),56H
        ADD     (0FF34H),56H
        ADD     (IX+34H),56H
        ADD     (IY-34H),56H
        ADD     (SP+34H),56H
        ADD     (HL+A),56H

        ADC     A,B
        ADC     A,C
        ADC     A,D
        ADC     A,E
        ADC     A,H
        ADC     A,L
        ADC     A,A
        ADC     A,(BC)
        ADC     A,(DE)
        ADC     A,(HL)
        ADC     A,(1234H)
        ADC     A,(IX)
        ADC     A,(IY)
        ADC     A,(SP)
        ADC     A,(0FF34H)
        ADC     A,(IX+34H)
        ADC     A,(IY-34H)
        ADC     A,(SP+34H)
        ADC     A,(HL+A)
        ADC     B,34H
        ADC     C,34H
        ADC     D,34H
        ADC     E,34H
        ADC     H,34H
        ADC     L,34H
        ADC     A,34H
        ADC     (BC),56H
        ADC     (DE),56H
        ADC     (HL),56H
        ADC     (1234H),56H
        ADC     (IX),56H
        ADC     (IY),56H
        ADC     (SP),56H
        ADC     (0FF34H),56H
        ADC     (IX+34H),56H
        ADC     (IY-34H),56H
        ADC     (SP+34H),56H
        ADC     (HL+A),56H

        SUB     A,B
        SUB     A,C
        SUB     A,D
        SUB     A,E
        SUB     A,H
        SUB     A,L
        SUB     A,A
        SUB     A,(BC)
        SUB     A,(DE)
        SUB     A,(HL)
        SUB     A,(1234H)
        SUB     A,(IX)
        SUB     A,(IY)
        SUB     A,(SP)
        SUB     A,(0FF34H)
        SUB     A,(IX+34H)
        SUB     A,(IY-34H)
        SUB     A,(SP+34H)
        SUB     A,(HL+A)
        SUB     B,34H
        SUB     C,34H
        SUB     D,34H
        SUB     E,34H
        SUB     H,34H
        SUB     L,34H
        SUB     A,34H
        SUB     (BC),56H
        SUB     (DE),56H
        SUB     (HL),56H
        SUB     (1234H),56H
        SUB     (IX),56H
        SUB     (IY),56H
        SUB     (SP),56H
        SUB     (0FF34H),56H
        SUB     (IX+34H),56H
        SUB     (IY-34H),56H
        SUB     (SP+34H),56H
        SUB     (HL+A),56H

        SBC     A,B
        SBC     A,C
        SBC     A,D
        SBC     A,E
        SBC     A,H
        SBC     A,L
        SBC     A,A
        SBC     A,(BC)
        SBC     A,(DE)
        SBC     A,(HL)
        SBC     A,(1234H)
        SBC     A,(IX)
        SBC     A,(IY)
        SBC     A,(SP)
        SBC     A,(0FF34H)
        SBC     A,(IX+34H)
        SBC     A,(IY-34H)
        SBC     A,(SP+34H)
        SBC     A,(HL+A)
        SBC     B,34H
        SBC     C,34H
        SBC     D,34H
        SBC     E,34H
        SBC     H,34H
        SBC     L,34H
        SBC     A,34H
        SBC     (BC),56H
        SBC     (DE),56H
        SBC     (HL),56H
        SBC     (1234H),56H
        SBC     (IX),56H
        SBC     (IY),56H
        SBC     (SP),56H
        SBC     (0FF34H),56H
        SBC     (IX+34H),56H
        SBC     (IY-34H),56H
        SBC     (SP+34H),56H
        SBC     (HL+A),56H

        AND     A,B
        AND     A,C
        AND     A,D
        AND     A,E
        AND     A,H
        AND     A,L
        AND     A,A
        AND     A,(BC)
        AND     A,(DE)
        AND     A,(HL)
        AND     A,(1234H)
        AND     A,(IX)
        AND     A,(IY)
        AND     A,(SP)
        AND     A,(0FF34H)
        AND     A,(IX+34H)
        AND     A,(IY-34H)
        AND     A,(SP+34H)
        AND     A,(HL+A)
        AND     B,34H
        AND     C,34H
        AND     D,34H
        AND     E,34H
        AND     H,34H
        AND     L,34H
        AND     A,34H
        AND     (BC),56H
        AND     (DE),56H
        AND     (HL),56H
        AND     (1234H),56H
        AND     (IX),56H
        AND     (IY),56H
        AND     (SP),56H
        AND     (0FF34H),56H
        AND     (IX+34H),56H
        AND     (IY-34H),56H
        AND     (SP+34H),56H
        AND     (HL+A),56H

        OR      A,B
        OR      A,C
        OR      A,D
        OR      A,E
        OR      A,H
        OR      A,L
        OR      A,A
        OR      A,(BC)
        OR      A,(DE)
        OR      A,(HL)
        OR      A,(1234H)
        OR      A,(IX)
        OR      A,(IY)
        OR      A,(SP)
        OR      A,(0FF34H)
        OR      A,(IX+34H)
        OR      A,(IY-34H)
        OR      A,(SP+34H)
        OR      A,(HL+A)
        OR      B,34H
        OR      C,34H
        OR      D,34H
        OR      E,34H
        OR      H,34H
        OR      L,34H
        OR      A,34H
        OR      (BC),56H
        OR      (DE),56H
        OR      (HL),56H
        OR      (1234H),56H
        OR      (IX),56H
        OR      (IY),56H
        OR      (SP),56H
        OR      (0FF34H),56H
        OR      (IX+34H),56H
        OR      (IY-34H),56H
        OR      (SP+34H),56H
        OR      (HL+A),56H

        XOR     A,B
        XOR     A,C
        XOR     A,D
        XOR     A,E
        XOR     A,H
        XOR     A,L
        XOR     A,A
        XOR     A,(BC)
        XOR     A,(DE)
        XOR     A,(HL)
        XOR     A,(1234H)
        XOR     A,(IX)
        XOR     A,(IY)
        XOR     A,(SP)
        XOR     A,(0FF34H)
        XOR     A,(IX+34H)
        XOR     A,(IY-34H)
        XOR     A,(SP+34H)
        XOR     A,(HL+A)
        XOR     B,34H
        XOR     C,34H
        XOR     D,34H
        XOR     E,34H
        XOR     H,34H
        XOR     L,34H
        XOR     A,34H
        XOR     (BC),56H
        XOR     (DE),56H
        XOR     (HL),56H
        XOR     (1234H),56H
        XOR     (IX),56H
        XOR     (IY),56H
        XOR     (SP),56H
        XOR     (0FF34H),56H
        XOR     (IX+34H),56H
        XOR     (IY-34H),56H
        XOR     (SP+34H),56H
        XOR     (HL+A),56H

        CP      A,B
        CP      A,C
        CP      A,D
        CP      A,E
        CP      A,H
        CP      A,L
        CP      A,A
        CP      A,(BC)
        CP      A,(DE)
        CP      A,(HL)
        CP      A,(1234H)
        CP      A,(IX)
        CP      A,(IY)
        CP      A,(SP)
        CP      A,(0FF34H)
        CP      A,(IX+34H)
        CP      A,(IY-34H)
        CP      A,(SP+34H)
        CP      A,(HL+A)
        CP      B,34H
        CP      C,34H
        CP      D,34H
        CP      E,34H
        CP      H,34H
        CP      L,34H
        CP      A,34H
        CP      (BC),56H
        CP      (DE),56H
        CP      (HL),56H
        CP      (1234H),56H
        CP      (IX),56H
        CP      (IY),56H
        CP      (SP),56H
        CP      (0FF34H),56H
        CP      (IX+34H),56H
        CP      (IY-34H),56H
        CP      (SP+34H),56H
        CP      (HL+A),56H

        INC     B
        INC     C
        INC     D
        INC     E
        INC     H
        INC     L
        INC     A
        INC     (BC)
        INC     (DE)
        INC     (HL)
        INC     (1234H)
        INC     (IX)
        INC     (IY)
        INC     (SP)
        INC     (0FF34H)
        INC     (IX+34H)
        INC     (IY-34H)
        INC     (SP+34H)
        INC     (HL+A)

        DEC     B
        DEC     C
        DEC     D
        DEC     E
        DEC     H
        DEC     L
        DEC     A
        DEC     (BC)
        DEC     (DE)
        DEC     (HL)
        DEC     (1234H)
        DEC     (IX)
        DEC     (IY)
        DEC     (SP)
        DEC     (0FF34H)
        DEC     (IX+34H)
        DEC     (IY-34H)
        DEC     (SP+34H)
        DEC     (HL+A)

        INCX    (0FF34H)
        DECX    (0FF34H)

        MUL     HL,B
        MUL     HL,C
        MUL     HL,D
        MUL     HL,E
        MUL     HL,H
        MUL     HL,L
        MUL     HL,A
        MUL     HL,34H
        MUL     HL,(BC)
        MUL     HL,(DE)
        MUL     HL,(HL)
        MUL     HL,(1234H)
        MUL     HL,(IX)
        MUL     HL,(IY)
        MUL     HL,(SP)
        MUL     HL,(0FF34H)
        MUL     HL,(IX+34H)
        MUL     HL,(IY-34H)
        MUL     HL,(SP+34H)
        MUL     HL,(HL+A)

        DIV     HL,B
        DIV     HL,C
        DIV     HL,D
        DIV     HL,E
        DIV     HL,H
        DIV     HL,L
        DIV     HL,A
        DIV     HL,34H
        DIV     HL,(BC)
        DIV     HL,(DE)
        DIV     HL,(HL)
        DIV     HL,(1234H)
        DIV     HL,(IX)
        DIV     HL,(IY)
        DIV     HL,(SP)
        DIV     HL,(0FF34H)
        DIV     HL,(IX+34H)
        DIV     HL,(IY-34H)
        DIV     HL,(SP+34H)
        DIV     HL,(HL+A)

        ADD     HL,BC
        ADD     HL,DE
        ADD     HL,HL
        ADD     HL,IX
        ADD     HL,IY
        ADD     HL,SP
        ADD     HL,1234H
        ADD     HL,(BC)
        ADD     HL,(DE)
        ADD     HL,(HL)
        ADD     HL,(1234H)
        ADD     HL,(IX)
        ADD     HL,(IY)
        ADD     HL,(SP)
        ADD     HL,(0FF34H)
        ADD     HL,(IX+34H)
        ADD     HL,(IY-34H)
        ADD     HL,(SP+34H)
        ADD     HL,(HL+A)

        ADC     HL,BC
        ADC     HL,DE
        ADC     HL,HL
        ADC     HL,IX
        ADC     HL,IY
        ADC     HL,SP
        ADC     HL,1234H
        ADC     HL,(BC)
        ADC     HL,(DE)
        ADC     HL,(HL)
        ADC     HL,(1234H)
        ADC     HL,(IX)
        ADC     HL,(IY)
        ADC     HL,(SP)
        ADC     HL,(0FF34H)
        ADC     HL,(IX+34H)
        ADC     HL,(IY-34H)
        ADC     HL,(SP+34H)
        ADC     HL,(HL+A)

        SUB     HL,BC
        SUB     HL,DE
        SUB     HL,HL
        SUB     HL,IX
        SUB     HL,IY
        SUB     HL,SP
        SUB     HL,1234H
        SUB     HL,(BC)
        SUB     HL,(DE)
        SUB     HL,(HL)
        SUB     HL,(1234H)
        SUB     HL,(IX)
        SUB     HL,(IY)
        SUB     HL,(SP)
        SUB     HL,(0FF34H)
        SUB     HL,(IX+34H)
        SUB     HL,(IY-34H)
        SUB     HL,(SP+34H)
        SUB     HL,(HL+A)

        SBC     HL,BC
        SBC     HL,DE
        SBC     HL,HL
        SBC     HL,IX
        SBC     HL,IY
        SBC     HL,SP
        SBC     HL,1234H
        SBC     HL,(BC)
        SBC     HL,(DE)
        SBC     HL,(HL)
        SBC     HL,(1234H)
        SBC     HL,(IX)
        SBC     HL,(IY)
        SBC     HL,(SP)
        SBC     HL,(0FF34H)
        SBC     HL,(IX+34H)
        SBC     HL,(IY-34H)
        SBC     HL,(SP+34H)
        SBC     HL,(HL+A)

        AND     HL,BC
        AND     HL,DE
        AND     HL,HL
        AND     HL,IX
        AND     HL,IY
        AND     HL,SP
        AND     HL,1234H
        AND     HL,(BC)
        AND     HL,(DE)
        AND     HL,(HL)
        AND     HL,(1234H)
        AND     HL,(IX)
        AND     HL,(IY)
        AND     HL,(SP)
        AND     HL,(0FF34H)
        AND     HL,(IX+34H)
        AND     HL,(IY-34H)
        AND     HL,(SP+34H)
        AND     HL,(HL+A)

        OR      HL,BC
        OR      HL,DE
        OR      HL,HL
        OR      HL,IX
        OR      HL,IY
        OR      HL,SP
        OR      HL,1234H
        OR      HL,(BC)
        OR      HL,(DE)
        OR      HL,(HL)
        OR      HL,(1234H)
        OR      HL,(IX)
        OR      HL,(IY)
        OR      HL,(SP)
        OR      HL,(0FF34H)
        OR      HL,(IX+34H)
        OR      HL,(IY-34H)
        OR      HL,(SP+34H)
        OR      HL,(HL+A)

        XOR     HL,BC
        XOR     HL,DE
        XOR     HL,HL
        XOR     HL,IX
        XOR     HL,IY
        XOR     HL,SP
        XOR     HL,1234H
        XOR     HL,(BC)
        XOR     HL,(DE)
        XOR     HL,(HL)
        XOR     HL,(1234H)
        XOR     HL,(IX)
        XOR     HL,(IY)
        XOR     HL,(SP)
        XOR     HL,(0FF34H)
        XOR     HL,(IX+34H)
        XOR     HL,(IY-34H)
        XOR     HL,(SP+34H)
        XOR     HL,(HL+A)

        CP      HL,BC
        CP      HL,DE
        CP      HL,HL
        CP      HL,IX
        CP      HL,IY
        CP      HL,SP
        CP      HL,1234H
        CP      HL,(BC)
        CP      HL,(DE)
        CP      HL,(HL)
        CP      HL,(1234H)
        CP      HL,(IX)
        CP      HL,(IY)
        CP      HL,(SP)
        CP      HL,(0FF34H)
        CP      HL,(IX+34H)
        CP      HL,(IY-34H)
        CP      HL,(SP+34H)
        CP      HL,(HL+A)

        ADD     IX,BC
        ADD     IX,DE
        ADD     IX,HL
        ADD     IX,IX
        ADD     IX,IY
        ADD     IX,SP
        ADD     IX,1234H
        ADD     IX,(BC)
        ADD     IX,(DE)
        ADD     IX,(HL)
        ADD     IX,(1234H)
        ADD     IX,(IX)
        ADD     IX,(IY)
        ADD     IX,(SP)
        ADD     IX,(0FF34H)
        ADD     IX,(IX+34H)
        ADD     IX,(IY-34H)
        ADD     IX,(SP+34H)
        ADD     IX,(HL+A)

        ADD     IY,BC
        ADD     IY,DE
        ADD     IY,HL
        ADD     IY,IX
        ADD     IY,IY
        ADD     IY,SP
        ADD     IY,1234H
        ADD     IY,(BC)
        ADD     IY,(DE)
        ADD     IY,(HL)
        ADD     IY,(1234H)
        ADD     IY,(IX)
        ADD     IY,(IY)
        ADD     IY,(SP)
        ADD     IY,(0FF34H)
        ADD     IY,(IX+34H)
        ADD     IY,(IY-34H)
        ADD     IY,(SP+34H)
        ADD     IY,(HL+A)

        ADD     SP,BC
        ADD     SP,DE
        ADD     SP,HL
        ADD     SP,IX
        ADD     SP,IY
        ADD     SP,SP
        ADD     SP,1234H
        ADD     SP,(BC)
        ADD     SP,(DE)
        ADD     SP,(HL)
        ADD     SP,(1234H)
        ADD     SP,(IX)
        ADD     SP,(IY)
        ADD     SP,(SP)
        ADD     SP,(0FF34H)
        ADD     SP,(IX+34H)
        ADD     SP,(IY-34H)
        ADD     SP,(SP+34H)
        ADD     SP,(HL+A)

        INC     BC
        INC     DE
        INC     HL
        INC     IX
        INC     IY
        INC     SP
        INCW    (BC)
        INCW    (DE)
        INCW    (HL)
        INCW    (1234H)
        INCW    (IX)
        INCW    (IY)
        INCW    (SP)
        INCW    (0FF34H)
        INCW    (IX+34H)
        INCW    (IY-34H)
        INCW    (SP+34H)
        INCW    (HL+A)

        DEC     BC
        DEC     DE
        DEC     HL
        DEC     IX
        DEC     IY
        DEC     SP
        DECW    (BC)
        DECW    (DE)
        DECW    (HL)
        DECW    (1234H)
        DECW    (IX)
        DECW    (IY)
        DECW    (SP)
        DECW    (0FF34H)
        DECW    (IX+34H)
        DECW    (IY-34H)
        DECW    (SP+34H)
        DECW    (HL+A)

        DAA     A
        CPL     A
        NEG     A

        RCF
        SCF
        CCF
        NOP
        HALT
        DI
        EI
        SWI

        RLCA
        RLC     B
        RLC     C
        RLC     D
        RLC     E
        RLC     H
        RLC     L
        RLC     A
        RLC     (BC)
        RLC     (DE)
        RLC     (HL)
        RLC     (1234H)
        RLC     (IX)
        RLC     (IY)
        RLC     (SP)
        RLC     (0FF34H)
        RLC     (IX+34H)
        RLC     (IY-34H)
        RLC     (SP+34H)
        RLC     (HL+A)

        RRCA
        RRC     B
        RRC     C
        RRC     D
        RRC     E
        RRC     H
        RRC     L
        RRC     A
        RRC     (BC)
        RRC     (DE)
        RRC     (HL)
        RRC     (1234H)
        RRC     (IX)
        RRC     (IY)
        RRC     (SP)
        RRC     (0FF34H)
        RRC     (IX+34H)
        RRC     (IY-34H)
        RRC     (SP+34H)
        RRC     (HL+A)

        RLA
        RL      B
        RL      C
        RL      D
        RL      E
        RL      H
        RL      L
        RL      A
        RL      (BC)
        RL      (DE)
        RL      (HL)
        RL      (1234H)
        RL      (IX)
        RL      (IY)
        RL      (SP)
        RL      (0FF34H)
        RL      (IX+34H)
        RL      (IY-34H)
        RL      (SP+34H)
        RL      (HL+A)

        RRA
        RR      B
        RR      C
        RR      D
        RR      E
        RR      H
        RR      L
        RR      A
        RR      (BC)
        RR      (DE)
        RR      (HL)
        RR      (1234H)
        RR      (IX)
        RR      (IY)
        RR      (SP)
        RR      (0FF34H)
        RR      (IX+34H)
        RR      (IY-34H)
        RR      (SP+34H)
        RR      (HL+A)

        SLAA
        SLA     B
        SLA     C
        SLA     D
        SLA     E
        SLA     H
        SLA     L
        SLA     A
        SLA     (BC)
        SLA     (DE)
        SLA     (HL)
        SLA     (1234H)
        SLA     (IX)
        SLA     (IY)
        SLA     (SP)
        SLA     (0FF34H)
        SLA     (IX+34H)
        SLA     (IY-34H)
        SLA     (SP+34H)
        SLA     (HL+A)

        SRAA
        SRA     B
        SRA     C
        SRA     D
        SRA     E
        SRA     H
        SRA     L
        SRA     A
        SRA     (BC)
        SRA     (DE)
        SRA     (HL)
        SRA     (1234H)
        SRA     (IX)
        SRA     (IY)
        SRA     (SP)
        SRA     (0FF34H)
        SRA     (IX+34H)
        SRA     (IY-34H)
        SRA     (SP+34H)
        SRA     (HL+A)

        SLLA
        SLL     B
        SLL     C
        SLL     D
        SLL     E
        SLL     H
        SLL     L
        SLL     A
        SLL     (BC)
        SLL     (DE)
        SLL     (HL)
        SLL     (1234H)
        SLL     (IX)
        SLL     (IY)
        SLL     (SP)
        SLL     (0FF34H)
        SLL     (IX+34H)
        SLL     (IY-34H)
        SLL     (SP+34H)
        SLL     (HL+A)

        SRLA
        SRL     B
        SRL     C
        SRL     D
        SRL     E
        SRL     H
        SRL     L
        SRL     A
        SRL     (BC)
        SRL     (DE)
        SRL     (HL)
        SRL     (1234H)
        SRL     (IX)
        SRL     (IY)
        SRL     (SP)
        SRL     (0FF34H)
        SRL     (IX+34H)
        SRL     (IY-34H)
        SRL     (SP+34H)
        SRL     (HL+A)

        RLD     (BC)
        RLD     (DE)
        RLD     (HL)
        RLD     (1234H)
        RLD     (IX)
        RLD     (IY)
        RLD     (SP)
        RLD     (0FF34H)
        RLD     (IX+34H)
        RLD     (IY-34H)
        RLD     (SP+34H)
        RLD     (HL+A)

        RRD     (BC)
        RRD     (DE)
        RRD     (HL)
        RRD     (1234H)
        RRD     (IX)
        RRD     (IY)
        RRD     (SP)
        RRD     (0FF34H)
        RRD     (IX+34H)
        RRD     (IY-34H)
        RRD     (SP+34H)
        RRD     (HL+A)

        BIT     0,B
        BIT     1,C
        BIT     2,D
        BIT     3,E
        BIT     4,H
        BIT     5,L
        BIT     6,A
        BIT     7,(BC)
        BIT     0,(DE)
        BIT     1,(HL)
        BIT     2,(1234H)
        BIT     3,(IX)
        BIT     4,(IY)
        BIT     5,(SP)
        BIT     6,(0FF34H)
        BIT     7,(IX+34H)
        BIT     0,(IY-34H)
        BIT     1,(SP+34H)
        BIT     2,(HL+A)

        SET     0,B
        SET     1,C
        SET     2,D
        SET     3,E
        SET     4,H
        SET     5,L
        SET     6,A
        SET     7,(BC)
        SET     0,(DE)
        SET     1,(HL)
        SET     2,(1234H)
        SET     3,(IX)
        SET     4,(IY)
        SET     5,(SP)
        SET     6,(0FF34H)
        SET     7,(IX+34H)
        SET     0,(IY-34H)
        SET     1,(SP+34H)
        SET     2,(HL+A)

        RES     0,B
        RES     1,C
        RES     2,D
        RES     3,E
        RES     4,H
        RES     5,L
        RES     6,A
        RES     7,(BC)
        RES     0,(DE)
        RES     1,(HL)
        RES     2,(1234H)
        RES     3,(IX)
        RES     4,(IY)
        RES     5,(SP)
        RES     6,(0FF34H)
        RES     7,(IX+34H)
        RES     0,(IY-34H)
        RES     1,(SP+34H)
        RES     2,(HL+A)

        TSET    0,B
        TSET    1,C
        TSET    2,D
        TSET    3,E
        TSET    4,H
        TSET    5,L
        TSET    6,A
        TSET    7,(BC)
        TSET    0,(DE)
        TSET    1,(HL)
        TSET    2,(1234H)
        TSET    3,(IX)
        TSET    4,(IY)
        TSET    5,(SP)
        TSET    6,(0FF34H)
        TSET    7,(IX+34H)
        TSET    0,(IY-34H)
        TSET    1,(SP+34H)
        TSET    2,(HL+A)

        JR      F,$+2
        JR      LT,$
        JR      LE,$-126
        JR      ULE,$+129
        JR      OV,$+2
        JR      MI,$
        JR      Z,$-126
        JR      C,$+129
        JR      $+2
        JR      GE,$
        JR      GT,$-126
        JR      UGT,$+129
        JR      NOV,$+2
        JR      PL,$
        JR      NZ,$-126
        JR      NC,$+129
        JR      PE,$+2
        JR      M,$
        JR      EQ,$-126
        JR      ULT,$+129
        JR      PO,$+2
        JR      P,$
        JR      NE,$-126
        JR      UGE,$+129

        JRL     $+3
        JRL     $
        JRL     $-4FEH
        JRL     $+401H

        JP      1234H

        JP      F,BC
        JP      LT,DE
        JP      LE,HL
        JP      ULE,1234H
        JP      OV,IX
        JP      MI,IY
        JP      Z,SP
        JP      C,0FF34H
        JP      IX+34H
        JP      GE,IY-34H
        JP      GT,SP+34H
        JP      UGT,HL+A
        JP      NOV,BC
        JP      PL,DE
        JP      NZ,HL
        JP      NC,1234H
        JP      PE,IX
        JP      M,IY
        JP      EQ,SP
        JP      ULT,0FF34H
        JP      PO,IX+34H
        JP      P,IY-34H
        JP      NE,SP+34H
        JP      UGE,HL+A

        CALL    1234H

        CALL    F,BC
        CALL    LT,DE
        CALL    LE,HL
        CALL    ULE,1234H
        CALL    OV,IX
        CALL    MI,IY
        CALL    Z,SP
        CALL    C,0FF34H
        CALL    IX+34H
        CALL    GE,IY-34H
        CALL    GT,SP+34H
        CALL    UGT,HL+A
        CALL    NOV,BC
        CALL    PL,DE
        CALL    NZ,HL
        CALL    NC,1234H
        CALL    PE,IX
        CALL    M,IY
        CALL    EQ,SP
        CALL    ULT,0FF34H
        CALL    PO,IX+34H
        CALL    P,IY-34H
        CALL    NE,SP+34H
        CALL    UGE,HL+A

        CALR    $+3
        CALR    $
        CALR    $-4FEH
        CALR    $+401H

        DJNZ    $+2
        DJNZ    $
        DJNZ    $-126
        DJNZ    $+129

        DJNZ    BC,$+2
        DJNZ    BC,$
        DJNZ    BC,$-126
        DJNZ    BC,$+129

        RETI

        RET     F
        RET     LT
        RET     LE
        RET     ULE
        RET     OV
        RET     MI
        RET     Z
        RET     C
        RET
        RET     GE
        RET     GT
        RET     UGT
        RET     NOV
        RET     PL
        RET     NZ
        RET     NC
        RET     PE
        RET     M
        RET     EQ
        RET     ULT
        RET     PO
        RET     P
        RET     NE
        RET     UGE

;;; Local Variables:
;;; mode: asm
;;; End:
;;; vim: set ft=asm:
