;;; AUTO GENERATED FILE
;;; generated by: gen_tms320 -i -u -C 320C5X -o gen_tms320c5x.inc -l gen_tms320c5x.lst
      LAR   AR0, 00H
      LAR   AR0, *
      LAR   AR0, *, AR0
      LAR   AR0, *-
      LAR   AR0, *-, AR0
      LAR   AR0, *+
      LAR   AR0, *+, AR0
      LAR   AR0, *BR0-
      LAR   AR0, *BR0-, AR0
      LAR   AR0, *0-
      LAR   AR0, *0-, AR0
      LAR   AR0, *0+
      LAR   AR0, *0+, AR0
      LAR   AR0, *BR0+
      LAR   AR0, *BR0+, AR0
      LAMM  00H
      LAMM  *
      LAMM  *, AR0
      LAMM  *-
      LAMM  *-, AR0
      LAMM  *+
      LAMM  *+, AR0
      LAMM  *BR0-
      LAMM  *BR0-, AR0
      LAMM  *0-
      LAMM  *0-, AR0
      LAMM  *0+
      LAMM  *0+, AR0
      LAMM  *BR0+
      LAMM  *BR0+, AR0
      SMMR  00H, #0A01H
      SMMR  *, #0A81H
      SMMR  *, #0A89H, AR0
      SMMR  *-, #0A91H
      SMMR  *-, #0A99H, AR0
      SMMR  *+, #0AA1H
      SMMR  *+, #0AA9H, AR0
      SMMR  *BR0-, #0AC1H
      SMMR  *BR0-, #0AC9H, AR0
      SMMR  *0-, #0AD1H
      SMMR  *0-, #0AD9H, AR0
      SMMR  *0+, #0AE1H
      SMMR  *0+, #0AE9H, AR0
      SMMR  *BR0+, #0AF1H
      SMMR  *BR0+, #0AF9H, AR0
      SUBC  00H
      SUBC  *
      SUBC  *, AR0
      SUBC  *-
      SUBC  *-, AR0
      SUBC  *+
      SUBC  *+, AR0
      SUBC  *BR0-
      SUBC  *BR0-, AR0
      SUBC  *0-
      SUBC  *0-, AR0
      SUBC  *0+
      SUBC  *0+, AR0
      SUBC  *BR0+
      SUBC  *BR0+, AR0
      RPT   00H
      RPT   *
      RPT   *, AR0
      RPT   *-
      RPT   *-, AR0
      RPT   *+
      RPT   *+, AR0
      RPT   *BR0-
      RPT   *BR0-, AR0
      RPT   *0-
      RPT   *0-, AR0
      RPT   *0+
      RPT   *0+, AR0
      RPT   *BR0+
      RPT   *BR0+, AR0
      OUT   00H, 0D01H
      OUT   *, 0D81H
      OUT   *, 0D89H, AR0
      OUT   *-, 0D91H
      OUT   *-, 0D99H, AR0
      OUT   *+, 0DA1H
      OUT   *+, 0DA9H, AR0
      OUT   *BR0-, 0DC1H
      OUT   *BR0-, 0DC9H, AR0
      OUT   *0-, 0DD1H
      OUT   *0-, 0DD9H, AR0
      OUT   *0+, 0DE1H
      OUT   *0+, 0DE9H, AR0
      OUT   *BR0+, 0DF1H
      OUT   *BR0+, 0DF9H, AR0
      LDP   00H
      LDP   *
      LDP   *, AR0
      LDP   *-
      LDP   *-, AR0
      LDP   *+
      LDP   *+, AR0
      LDP   *BR0-
      LDP   *BR0-, AR0
      LDP   *0-
      LDP   *0-, AR0
      LDP   *0+
      LDP   *0+, AR0
      LDP   *BR0+
      LDP   *BR0+, AR0
      LST   #0, 00H
      LST   #0, *
      LST   #0, *, AR0
      LST   #0, *-
      LST   #0, *-, AR0
      LST   #0, *+
      LST   #0, *+, AR0
      LST   #0, *BR0-
      LST   #0, *BR0-, AR0
      LST   #0, *0-
      LST   #0, *0-, AR0
      LST   #0, *0+
      LST   #0, *0+, AR0
      LST   #0, *BR0+
      LST   #0, *BR0+, AR0
      LACC  00H
      LACC  *
      LACC  *, 0, AR0
      LACC  *-
      LACC  *-, 0, AR0
      LACC  *+
      LACC  *+, 0, AR0
      LACC  *BR0-
      LACC  *BR0-, 0, AR0
      LACC  *0-
      LACC  *0-, 0, AR0
      LACC  *0+
      LACC  *0+, 0, AR0
      LACC  *BR0+
      LACC  *BR0+, 0, AR0
      LACC  00H, 1
      LACC  *, 1
      LACC  *-, 1
      LACC  *+, 1
      LACC  *BR0-, 1
      LACC  *0-, 1
      LACC  *0+, 1
      LACC  *BR0+, 1
      ADD   00H
      ADD   *
      ADD   *, 0, AR0
      ADD   *-
      ADD   *-, 0, AR0
      ADD   *+
      ADD   *+, 0, AR0
      ADD   *BR0-
      ADD   *BR0-, 0, AR0
      ADD   *0-
      ADD   *0-, 0, AR0
      ADD   *0+
      ADD   *0+, 0, AR0
      ADD   *BR0+
      ADD   *BR0+, 0, AR0
      ADD   00H, 1
      ADD   *, 1
      ADD   *-, 1
      ADD   *+, 1
      ADD   *BR0-, 1
      ADD   *0-, 1
      ADD   *0+, 1
      ADD   *BR0+, 1
      SUB   00H
      SUB   *
      SUB   *, 0, AR0
      SUB   *-
      SUB   *-, 0, AR0
      SUB   *+
      SUB   *+, 0, AR0
      SUB   *BR0-
      SUB   *BR0-, 0, AR0
      SUB   *0-
      SUB   *0-, 0, AR0
      SUB   *0+
      SUB   *0+, 0, AR0
      SUB   *BR0+
      SUB   *BR0+, 0, AR0
      SUB   00H, 1
      SUB   *, 1
      SUB   *-, 1
      SUB   *+, 1
      SUB   *BR0-, 1
      SUB   *0-, 1
      SUB   *0+, 1
      SUB   *BR0+, 1
      BIT   00H, 0
      BIT   *, 0
      BIT   *, 0, AR0
      BIT   *-, 0
      BIT   *-, 0, AR0
      BIT   *+, 0
      BIT   *+, 0, AR0
      BIT   *BR0-, 0
      BIT   *BR0-, 0, AR0
      BIT   *0-, 0
      BIT   *0-, 0, AR0
      BIT   *0+, 0
      BIT   *0+, 0, AR0
      BIT   *BR0+, 0
      BIT   *BR0+, 0, AR0
      MPYA  00H
      MPYA  *
      MPYA  *, AR0
      MPYA  *-
      MPYA  *-, AR0
      MPYA  *+
      MPYA  *+, AR0
      MPYA  *BR0-
      MPYA  *BR0-, AR0
      MPYA  *0-
      MPYA  *0-, AR0
      MPYA  *0+
      MPYA  *0+, AR0
      MPYA  *BR0+
      MPYA  *BR0+, AR0
      MPYS  00H
      MPYS  *
      MPYS  *, AR0
      MPYS  *-
      MPYS  *-, AR0
      MPYS  *+
      MPYS  *+, AR0
      MPYS  *BR0-
      MPYS  *BR0-, AR0
      MPYS  *0-
      MPYS  *0-, AR0
      MPYS  *0+
      MPYS  *0+, AR0
      MPYS  *BR0+
      MPYS  *BR0+, AR0
      SQRA  00H
      SQRA  *
      SQRA  *, AR0
      SQRA  *-
      SQRA  *-, AR0
      SQRA  *+
      SQRA  *+, AR0
      SQRA  *BR0-
      SQRA  *BR0-, AR0
      SQRA  *0-
      SQRA  *0-, AR0
      SQRA  *0+
      SQRA  *0+, AR0
      SQRA  *BR0+
      SQRA  *BR0+, AR0
      SQRS  00H
      SQRS  *
      SQRS  *, AR0
      SQRS  *-
      SQRS  *-, AR0
      SQRS  *+
      SQRS  *+, AR0
      SQRS  *BR0-
      SQRS  *BR0-, AR0
      SQRS  *0-
      SQRS  *0-, AR0
      SQRS  *0+
      SQRS  *0+, AR0
      SQRS  *BR0+
      SQRS  *BR0+, AR0
      MPY   00H
      MPY   *
      MPY   *, AR0
      MPY   *-
      MPY   *-, AR0
      MPY   *+
      MPY   *+, AR0
      MPY   *BR0-
      MPY   *BR0-, AR0
      MPY   *0-
      MPY   *0-, AR0
      MPY   *0+
      MPY   *0+, AR0
      MPY   *BR0+
      MPY   *BR0+, AR0
      MPYU  00H
      MPYU  *
      MPYU  *, AR0
      MPYU  *-
      MPYU  *-, AR0
      MPYU  *+
      MPYU  *+, AR0
      MPYU  *BR0-
      MPYU  *BR0-, AR0
      MPYU  *0-
      MPYU  *0-, AR0
      MPYU  *0+
      MPYU  *0+, AR0
      MPYU  *BR0+
      MPYU  *BR0+, AR0
      BLDP  00H
      BLDP  *
      BLDP  *, AR0
      BLDP  *-
      BLDP  *-, AR0
      BLDP  *+
      BLDP  *+, AR0
      BLDP  *BR0-
      BLDP  *BR0-, AR0
      BLDP  *0-
      BLDP  *0-, AR0
      BLDP  *0+
      BLDP  *0+, AR0
      BLDP  *BR0+
      BLDP  *BR0+, AR0
      XPL   00H
      XPL   *
      XPL   *, AR0
      XPL   *-
      XPL   *-, AR0
      XPL   *+
      XPL   *+, AR0
      XPL   *BR0-
      XPL   *BR0-, AR0
      XPL   *0-
      XPL   *0-, AR0
      XPL   *0+
      XPL   *0+, AR0
      XPL   *BR0+
      XPL   *BR0+, AR0
      OPL   00H
      OPL   *
      OPL   *, AR0
      OPL   *-
      OPL   *-, AR0
      OPL   *+
      OPL   *+, AR0
      OPL   *BR0-
      OPL   *BR0-, AR0
      OPL   *0-
      OPL   *0-, AR0
      OPL   *0+
      OPL   *0+, AR0
      OPL   *BR0+
      OPL   *BR0+, AR0
      APL   00H
      APL   *
      APL   *, AR0
      APL   *-
      APL   *-, AR0
      APL   *+
      APL   *+, AR0
      APL   *BR0-
      APL   *BR0-, AR0
      APL   *0-
      APL   *0-, AR0
      APL   *0+
      APL   *0+, AR0
      APL   *BR0+
      APL   *BR0+, AR0
      CPL   00H
      CPL   *
      CPL   *, AR0
      CPL   *-
      CPL   *-, AR0
      CPL   *+
      CPL   *+, AR0
      CPL   *BR0-
      CPL   *BR0-, AR0
      CPL   *0-
      CPL   *0-, AR0
      CPL   *0+
      CPL   *0+, AR0
      CPL   *BR0+
      CPL   *BR0+, AR0
      XPL   #5D01H, 00H
      XPL   #5D81H, *
      XPL   #5D89H, *, AR0
      XPL   #5D91H, *-
      XPL   #5D99H, *-, AR0
      XPL   #5DA1H, *+
      XPL   #5DA9H, *+, AR0
      XPL   #5DC1H, *BR0-
      XPL   #5DC9H, *BR0-, AR0
      XPL   #5DD1H, *0-
      XPL   #5DD9H, *0-, AR0
      XPL   #5DE1H, *0+
      XPL   #5DE9H, *0+, AR0
      XPL   #5DF1H, *BR0+
      XPL   #5DF9H, *BR0+, AR0
      OPL   #5E01H, 00H
      OPL   #5E81H, *
      OPL   #5E89H, *, AR0
      OPL   #5E91H, *-
      OPL   #5E99H, *-, AR0
      OPL   #5EA1H, *+
      OPL   #5EA9H, *+, AR0
      OPL   #5EC1H, *BR0-
      OPL   #5EC9H, *BR0-, AR0
      OPL   #5ED1H, *0-
      OPL   #5ED9H, *0-, AR0
      OPL   #5EE1H, *0+
      OPL   #5EE9H, *0+, AR0
      OPL   #5EF1H, *BR0+
      OPL   #5EF9H, *BR0+, AR0
      APL   #5F01H, 00H
      APL   #5F81H, *
      APL   #5F89H, *, AR0
      APL   #5F91H, *-
      APL   #5F99H, *-, AR0
      APL   #5FA1H, *+
      APL   #5FA9H, *+, AR0
      APL   #5FC1H, *BR0-
      APL   #5FC9H, *BR0-, AR0
      APL   #5FD1H, *0-
      APL   #5FD9H, *0-, AR0
      APL   #5FE1H, *0+
      APL   #5FE9H, *0+, AR0
      APL   #5FF1H, *BR0+
      APL   #5FF9H, *BR0+, AR0
      CPL   #6001H, 00H
      CPL   #6081H, *
      CPL   #6089H, *, AR0
      CPL   #6091H, *-
      CPL   #6099H, *-, AR0
      CPL   #60A1H, *+
      CPL   #60A9H, *+, AR0
      CPL   #60C1H, *BR0-
      CPL   #60C9H, *BR0-, AR0
      CPL   #60D1H, *0-
      CPL   #60D9H, *0-, AR0
      CPL   #60E1H, *0+
      CPL   #60E9H, *0+, AR0
      CPL   #60F1H, *BR0+
      CPL   #60F9H, *BR0+, AR0
      ADDC  00H
      ADDC  *
      ADDC  *, AR0
      ADDC  *-
      ADDC  *-, AR0
      ADDC  *+
      ADDC  *+, AR0
      ADDC  *BR0-
      ADDC  *BR0-, AR0
      ADDC  *0-
      ADDC  *0-, AR0
      ADDC  *0+
      ADDC  *0+, AR0
      ADDC  *BR0+
      ADDC  *BR0+, AR0
      ADDS  00H
      ADDS  *
      ADDS  *, AR0
      ADDS  *-
      ADDS  *-, AR0
      ADDS  *+
      ADDS  *+, AR0
      ADDS  *BR0-
      ADDS  *BR0-, AR0
      ADDS  *0-
      ADDS  *0-, AR0
      ADDS  *0+
      ADDS  *0+, AR0
      ADDS  *BR0+
      ADDS  *BR0+, AR0
      ADDT  00H
      ADDT  *
      ADDT  *, AR0
      ADDT  *-
      ADDT  *-, AR0
      ADDT  *+
      ADDT  *+, AR0
      ADDT  *BR0-
      ADDT  *BR0-, AR0
      ADDT  *0-
      ADDT  *0-, AR0
      ADDT  *0+
      ADDT  *0+, AR0
      ADDT  *BR0+
      ADDT  *BR0+, AR0
      SUBB  00H
      SUBB  *
      SUBB  *, AR0
      SUBB  *-
      SUBB  *-, AR0
      SUBB  *+
      SUBB  *+, AR0
      SUBB  *BR0-
      SUBB  *BR0-, AR0
      SUBB  *0-
      SUBB  *0-, AR0
      SUBB  *0+
      SUBB  *0+, AR0
      SUBB  *BR0+
      SUBB  *BR0+, AR0
      SUBS  00H
      SUBS  *
      SUBS  *, AR0
      SUBS  *-
      SUBS  *-, AR0
      SUBS  *+
      SUBS  *+, AR0
      SUBS  *BR0-
      SUBS  *BR0-, AR0
      SUBS  *0-
      SUBS  *0-, AR0
      SUBS  *0+
      SUBS  *0+, AR0
      SUBS  *BR0+
      SUBS  *BR0+, AR0
      SUBT  00H
      SUBT  *
      SUBT  *, AR0
      SUBT  *-
      SUBT  *-, AR0
      SUBT  *+
      SUBT  *+, AR0
      SUBT  *BR0-
      SUBT  *BR0-, AR0
      SUBT  *0-
      SUBT  *0-, AR0
      SUBT  *0+
      SUBT  *0+, AR0
      SUBT  *BR0+
      SUBT  *BR0+, AR0
      ZALR  00H
      ZALR  *
      ZALR  *, AR0
      ZALR  *-
      ZALR  *-, AR0
      ZALR  *+
      ZALR  *+, AR0
      ZALR  *BR0-
      ZALR  *BR0-, AR0
      ZALR  *0-
      ZALR  *0-, AR0
      ZALR  *0+
      ZALR  *0+, AR0
      ZALR  *BR0+
      ZALR  *BR0+, AR0
      LACL  00H
      LACL  *
      LACL  *, AR0
      LACL  *-
      LACL  *-, AR0
      LACL  *+
      LACL  *+, AR0
      LACL  *BR0-
      LACL  *BR0-, AR0
      LACL  *0-
      LACL  *0-, AR0
      LACL  *0+
      LACL  *0+, AR0
      LACL  *BR0+
      LACL  *BR0+, AR0
      LACT  00H
      LACT  *
      LACT  *, AR0
      LACT  *-
      LACT  *-, AR0
      LACT  *+
      LACT  *+, AR0
      LACT  *BR0-
      LACT  *BR0-, AR0
      LACT  *0-
      LACT  *0-, AR0
      LACT  *0+
      LACT  *0+, AR0
      LACT  *BR0+
      LACT  *BR0+, AR0
      XOR   00H
      XOR   *
      XOR   *, AR0
      XOR   *-
      XOR   *-, AR0
      XOR   *+
      XOR   *+, AR0
      XOR   *BR0-
      XOR   *BR0-, AR0
      XOR   *0-
      XOR   *0-, AR0
      XOR   *0+
      XOR   *0+, AR0
      XOR   *BR0+
      XOR   *BR0+, AR0
      OR    00H
      OR    *
      OR    *, AR0
      OR    *-
      OR    *-, AR0
      OR    *+
      OR    *+, AR0
      OR    *BR0-
      OR    *BR0-, AR0
      OR    *0-
      OR    *0-, AR0
      OR    *0+
      OR    *0+, AR0
      OR    *BR0+
      OR    *BR0+, AR0
      AND   00H
      AND   *
      AND   *, AR0
      AND   *-
      AND   *-, AR0
      AND   *+
      AND   *+, AR0
      AND   *BR0-
      AND   *BR0-, AR0
      AND   *0-
      AND   *0-, AR0
      AND   *0+
      AND   *0+, AR0
      AND   *BR0+
      AND   *BR0+, AR0
      BITT  00H
      BITT  *
      BITT  *, AR0
      BITT  *-
      BITT  *-, AR0
      BITT  *+
      BITT  *+, AR0
      BITT  *BR0-
      BITT  *BR0-, AR0
      BITT  *0-
      BITT  *0-, AR0
      BITT  *0+
      BITT  *0+, AR0
      BITT  *BR0+
      BITT  *BR0+, AR0
      LTA   00H
      LTA   *
      LTA   *, AR0
      LTA   *-
      LTA   *-, AR0
      LTA   *+
      LTA   *+, AR0
      LTA   *BR0-
      LTA   *BR0-, AR0
      LTA   *0-
      LTA   *0-, AR0
      LTA   *0+
      LTA   *0+, AR0
      LTA   *BR0+
      LTA   *BR0+, AR0
      LTP   00H
      LTP   *
      LTP   *, AR0
      LTP   *-
      LTP   *-, AR0
      LTP   *+
      LTP   *+, AR0
      LTP   *BR0-
      LTP   *BR0-, AR0
      LTP   *0-
      LTP   *0-, AR0
      LTP   *0+
      LTP   *0+, AR0
      LTP   *BR0+
      LTP   *BR0+, AR0
      LTD   00H
      LTD   *
      LTD   *, AR0
      LTD   *-
      LTD   *-, AR0
      LTD   *+
      LTD   *+, AR0
      LTD   *BR0-
      LTD   *BR0-, AR0
      LTD   *0-
      LTD   *0-, AR0
      LTD   *0+
      LTD   *0+, AR0
      LTD   *BR0+
      LTD   *BR0+, AR0
      LT    00H
      LT    *
      LT    *, AR0
      LT    *-
      LT    *-, AR0
      LT    *+
      LT    *+, AR0
      LT    *BR0-
      LT    *BR0-, AR0
      LT    *0-
      LT    *0-, AR0
      LT    *0+
      LT    *0+, AR0
      LT    *BR0+
      LT    *BR0+, AR0
      LTS   00H
      LTS   *
      LTS   *, AR0
      LTS   *-
      LTS   *-, AR0
      LTS   *+
      LTS   *+, AR0
      LTS   *BR0-
      LTS   *BR0-, AR0
      LTS   *0-
      LTS   *0-, AR0
      LTS   *0+
      LTS   *0+, AR0
      LTS   *BR0+
      LTS   *BR0+, AR0
      LPH   00H
      LPH   *
      LPH   *, AR0
      LPH   *-
      LPH   *-, AR0
      LPH   *+
      LPH   *+, AR0
      LPH   *BR0-
      LPH   *BR0-, AR0
      LPH   *0-
      LPH   *0-, AR0
      LPH   *0+
      LPH   *0+, AR0
      LPH   *BR0+
      LPH   *BR0+, AR0
      PSHD  00H
      PSHD  *
      PSHD  *, AR0
      PSHD  *-
      PSHD  *-, AR0
      PSHD  *+
      PSHD  *+, AR0
      PSHD  *BR0-
      PSHD  *BR0-, AR0
      PSHD  *0-
      PSHD  *0-, AR0
      PSHD  *0+
      PSHD  *0+, AR0
      PSHD  *BR0+
      PSHD  *BR0+, AR0
      DMOV  00H
      DMOV  *
      DMOV  *, AR0
      DMOV  *-
      DMOV  *-, AR0
      DMOV  *+
      DMOV  *+, AR0
      DMOV  *BR0-
      DMOV  *BR0-, AR0
      DMOV  *0-
      DMOV  *0-, AR0
      DMOV  *0+
      DMOV  *0+, AR0
      DMOV  *BR0+
      DMOV  *BR0+, AR0
      ADRK  #0
      B     7A81H
      B     7A89H, *, AR0
      B     7A91H, *-
      B     7A99H, *-, AR0
      B     7AA1H, *+
      B     7AA9H, *+, AR0
      B     7AC1H, *BR0-
      B     7AC9H, *BR0-, AR0
      B     7AD1H, *0-
      B     7AD9H, *0-, AR0
      B     7AE1H, *0+
      B     7AE9H, *0+, AR0
      B     7AF1H, *BR0+
      B     7AF9H, *BR0+, AR0
      CALL  7B81H
      CALL  7B89H, *, AR0
      CALL  7B91H, *-
      CALL  7B99H, *-, AR0
      CALL  7BA1H, *+
      CALL  7BA9H, *+, AR0
      CALL  7BC1H, *BR0-
      CALL  7BC9H, *BR0-, AR0
      CALL  7BD1H, *0-
      CALL  7BD9H, *0-, AR0
      CALL  7BE1H, *0+
      CALL  7BE9H, *0+, AR0
      CALL  7BF1H, *BR0+
      CALL  7BF9H, *BR0+, AR0
      BANZ  7C81H
      BANZ  7C89H, *, AR0
      BANZ  7C91H, *-
      BANZ  7C99H, *-, AR0
      BANZ  7CA1H, *+
      BANZ  7CA9H, *+, AR0
      BANZ  7CC1H, *BR0-
      BANZ  7CC9H, *BR0-, AR0
      BANZ  7CD1H, *0-
      BANZ  7CD9H, *0-, AR0
      BANZ  7CE1H, *0+
      BANZ  7CE9H, *0+, AR0
      BANZ  7CF1H, *BR0+
      BANZ  7CF9H, *BR0+, AR0
      SBRK  #0
      BD    7E81H
      BD    7E89H, *, AR0
      BD    7E91H, *-
      BD    7E99H, *-, AR0
      BD    7EA1H, *+
      BD    7EA9H, *+, AR0
      BD    7EC1H, *BR0-
      BD    7EC9H, *BR0-, AR0
      BD    7ED1H, *0-
      BD    7ED9H, *0-, AR0
      BD    7EE1H, *0+
      BD    7EE9H, *0+, AR0
      BD    7EF1H, *BR0+
      BD    7EF9H, *BR0+, AR0
      CALLD 7F81H
      CALLD 7F89H, *, AR0
      CALLD 7F91H, *-
      CALLD 7F99H, *-, AR0
      CALLD 7FA1H, *+
      CALLD 7FA9H, *+, AR0
      CALLD 7FC1H, *BR0-
      CALLD 7FC9H, *BR0-, AR0
      CALLD 7FD1H, *0-
      CALLD 7FD9H, *0-, AR0
      CALLD 7FE1H, *0+
      CALLD 7FE9H, *0+, AR0
      CALLD 7FF1H, *BR0+
      CALLD 7FF9H, *BR0+, AR0
      BANZD 8081H
      BANZD 8089H, *, AR0
      BANZD 8091H, *-
      BANZD 8099H, *-, AR0
      BANZD 80A1H, *+
      BANZD 80A9H, *+, AR0
      BANZD 80C1H, *BR0-
      BANZD 80C9H, *BR0-, AR0
      BANZD 80D1H, *0-
      BANZD 80D9H, *0-, AR0
      BANZD 80E1H, *0+
      BANZD 80E9H, *0+, AR0
      BANZD 80F1H, *BR0+
      BANZD 80F9H, *BR0+, AR0
      SAR   AR0, 00H
      SAR   AR0, *
      SAR   AR0, *, AR0
      SAR   AR0, *-
      SAR   AR0, *-, AR0
      SAR   AR0, *+
      SAR   AR0, *+, AR0
      SAR   AR0, *BR0-
      SAR   AR0, *BR0-, AR0
      SAR   AR0, *0-
      SAR   AR0, *0-, AR0
      SAR   AR0, *0+
      SAR   AR0, *0+, AR0
      SAR   AR0, *BR0+
      SAR   AR0, *BR0+, AR0
      SAMM  00H
      SAMM  *
      SAMM  *, AR0
      SAMM  *-
      SAMM  *-, AR0
      SAMM  *+
      SAMM  *+, AR0
      SAMM  *BR0-
      SAMM  *BR0-, AR0
      SAMM  *0-
      SAMM  *0-, AR0
      SAMM  *0+
      SAMM  *0+, AR0
      SAMM  *BR0+
      SAMM  *BR0+, AR0
      LMMR  00H, #8A01H
      LMMR  *, #8A81H
      LMMR  *, #8A89H, AR0
      LMMR  *-, #8A91H
      LMMR  *-, #8A99H, AR0
      LMMR  *+, #8AA1H
      LMMR  *+, #8AA9H, AR0
      LMMR  *BR0-, #8AC1H
      LMMR  *BR0-, #8AC9H, AR0
      LMMR  *0-, #8AD1H
      LMMR  *0-, #8AD9H, AR0
      LMMR  *0+, #8AE1H
      LMMR  *0+, #8AE9H, AR0
      LMMR  *BR0+, #8AF1H
      LMMR  *BR0+, #8AF9H, AR0
      POPD  00H
      POPD  *
      POPD  *, AR0
      POPD  *-
      POPD  *-, AR0
      POPD  *+
      POPD  *+, AR0
      POPD  *BR0-
      POPD  *BR0-, AR0
      POPD  *0-
      POPD  *0-, AR0
      POPD  *0+
      POPD  *0+, AR0
      POPD  *BR0+
      POPD  *BR0+, AR0
      NOP
      MAR   01H
      MAR   *
      MAR   *, AR0
      MAR   *-
      MAR   *-, AR0
      MAR   *+
      MAR   *+, AR0
      MAR   *BR0-
      MAR   *BR0-, AR0
      MAR   *0-
      MAR   *0-, AR0
      MAR   *0+
      MAR   *0+, AR0
      MAR   *BR0+
      MAR   *BR0+, AR0
      SPL   00H
      SPL   *
      SPL   *, AR0
      SPL   *-
      SPL   *-, AR0
      SPL   *+
      SPL   *+, AR0
      SPL   *BR0-
      SPL   *BR0-, AR0
      SPL   *0-
      SPL   *0-, AR0
      SPL   *0+
      SPL   *0+, AR0
      SPL   *BR0+
      SPL   *BR0+, AR0
      SPH   00H
      SPH   *
      SPH   *, AR0
      SPH   *-
      SPH   *-, AR0
      SPH   *+
      SPH   *+, AR0
      SPH   *BR0-
      SPH   *BR0-, AR0
      SPH   *0-
      SPH   *0-, AR0
      SPH   *0+
      SPH   *0+, AR0
      SPH   *BR0+
      SPH   *BR0+, AR0
      SST   #0, 00H
      SST   #0, *
      SST   #0, *, AR0
      SST   #0, *-
      SST   #0, *-, AR0
      SST   #0, *+
      SST   #0, *+, AR0
      SST   #0, *BR0-
      SST   #0, *BR0-, AR0
      SST   #0, *0-
      SST   #0, *0-, AR0
      SST   #0, *0+
      SST   #0, *0+, AR0
      SST   #0, *BR0+
      SST   #0, *BR0+, AR0
      SACL  00H
      SACL  *
      SACL  *, 0, AR0
      SACL  *-
      SACL  *-, 0, AR0
      SACL  *+
      SACL  *+, 0, AR0
      SACL  *BR0-
      SACL  *BR0-, 0, AR0
      SACL  *0-
      SACL  *0-, 0, AR0
      SACL  *0+
      SACL  *0+, 0, AR0
      SACL  *BR0+
      SACL  *BR0+, 0, AR0
      SACL  00H, 1
      SACL  *, 1
      SACL  *-, 1
      SACL  *+, 1
      SACL  *BR0-, 1
      SACL  *0-, 1
      SACL  *0+, 1
      SACL  *BR0+, 1
      SACH  00H
      SACH  *
      SACH  *, 0, AR0
      SACH  *-
      SACH  *-, 0, AR0
      SACH  *+
      SACH  *+, 0, AR0
      SACH  *BR0-
      SACH  *BR0-, 0, AR0
      SACH  *0-
      SACH  *0-, 0, AR0
      SACH  *0+
      SACH  *0+, 0, AR0
      SACH  *BR0+
      SACH  *BR0+, 0, AR0
      SACH  00H, 1
      SACH  *, 1
      SACH  *-, 1
      SACH  *+, 1
      SACH  *BR0-, 1
      SACH  *0-, 1
      SACH  *0+, 1
      SACH  *BR0+, 1
      NORM  *
      NORM  *-
      NORM  *+
      NORM  *BR0-
      NORM  *0-
      NORM  *0+
      NORM  *BR0+
      MAC   0A301H, 00H
      MAC   0A381H, *
      MAC   0A389H, *, AR0
      MAC   0A391H, *-
      MAC   0A399H, *-, AR0
      MAC   0A3A1H, *+
      MAC   0A3A9H, *+, AR0
      MAC   0A3C1H, *BR0-
      MAC   0A3C9H, *BR0-, AR0
      MAC   0A3D1H, *0-
      MAC   0A3D9H, *0-, AR0
      MAC   0A3E1H, *0+
      MAC   0A3E9H, *0+, AR0
      MAC   0A3F1H, *BR0+
      MAC   0A3F9H, *BR0+, AR0
      MACD  0A401H, 00H
      MACD  0A481H, *
      MACD  0A489H, *, AR0
      MACD  0A491H, *-
      MACD  0A499H, *-, AR0
      MACD  0A4A1H, *+
      MACD  0A4A9H, *+, AR0
      MACD  0A4C1H, *BR0-
      MACD  0A4C9H, *BR0-, AR0
      MACD  0A4D1H, *0-
      MACD  0A4D9H, *0-, AR0
      MACD  0A4E1H, *0+
      MACD  0A4E9H, *0+, AR0
      MACD  0A4F1H, *BR0+
      MACD  0A4F9H, *BR0+, AR0
      BLPD  BMAR, 00H
      BLPD  BMAR, *
      BLPD  BMAR, *, AR0
      BLPD  BMAR, *-
      BLPD  BMAR, *-, AR0
      BLPD  BMAR, *+
      BLPD  BMAR, *+, AR0
      BLPD  BMAR, *BR0-
      BLPD  BMAR, *BR0-, AR0
      BLPD  BMAR, *0-
      BLPD  BMAR, *0-, AR0
      BLPD  BMAR, *0+
      BLPD  BMAR, *0+, AR0
      BLPD  BMAR, *BR0+
      BLPD  BMAR, *BR0+, AR0
      BLPD  #0A601H, 00H
      BLPD  #0A681H, *
      BLPD  #0A689H, *, AR0
      BLPD  #0A691H, *-
      BLPD  #0A699H, *-, AR0
      BLPD  #0A6A1H, *+
      BLPD  #0A6A9H, *+, AR0
      BLPD  #0A6C1H, *BR0-
      BLPD  #0A6C9H, *BR0-, AR0
      BLPD  #0A6D1H, *0-
      BLPD  #0A6D9H, *0-, AR0
      BLPD  #0A6E1H, *0+
      BLPD  #0A6E9H, *0+, AR0
      BLPD  #0A6F1H, *BR0+
      BLPD  #0A6F9H, *BR0+, AR0
      TBLR  00H
      TBLR  *
      TBLR  *, AR0
      TBLR  *-
      TBLR  *-, AR0
      TBLR  *+
      TBLR  *+, AR0
      TBLR  *BR0-
      TBLR  *BR0-, AR0
      TBLR  *0-
      TBLR  *0-, AR0
      TBLR  *0+
      TBLR  *0+, AR0
      TBLR  *BR0+
      TBLR  *BR0+, AR0
      TBLW  00H
      TBLW  *
      TBLW  *, AR0
      TBLW  *-
      TBLW  *-, AR0
      TBLW  *+
      TBLW  *+, AR0
      TBLW  *BR0-
      TBLW  *BR0-, AR0
      TBLW  *0-
      TBLW  *0-, AR0
      TBLW  *0+
      TBLW  *0+, AR0
      TBLW  *BR0+
      TBLW  *BR0+, AR0
      BLDD  #0A901H, 00H
      BLDD  #0A981H, *
      BLDD  #0A989H, *, AR0
      BLDD  #0A991H, *-
      BLDD  #0A999H, *-, AR0
      BLDD  #0A9A1H, *+
      BLDD  #0A9A9H, *+, AR0
      BLDD  #0A9C1H, *BR0-
      BLDD  #0A9C9H, *BR0-, AR0
      BLDD  #0A9D1H, *0-
      BLDD  #0A9D9H, *0-, AR0
      BLDD  #0A9E1H, *0+
      BLDD  #0A9E9H, *0+, AR0
      BLDD  #0A9F1H, *BR0+
      BLDD  #0A9F9H, *BR0+, AR0
      BLDD  00H, #0AA01H
      BLDD  *, #0AA81H
      BLDD  *, #0AA89H, AR0
      BLDD  *-, #0AA91H
      BLDD  *-, #0AA99H, AR0
      BLDD  *+, #0AAA1H
      BLDD  *+, #0AAA9H, AR0
      BLDD  *BR0-, #0AAC1H
      BLDD  *BR0-, #0AAC9H, AR0
      BLDD  *0-, #0AAD1H
      BLDD  *0-, #0AAD9H, AR0
      BLDD  *0+, #0AAE1H
      BLDD  *0+, #0AAE9H, AR0
      BLDD  *BR0+, #0AAF1H
      BLDD  *BR0+, #0AAF9H, AR0
      MADS  00H
      MADS  *
      MADS  *, AR0
      MADS  *-
      MADS  *-, AR0
      MADS  *+
      MADS  *+, AR0
      MADS  *BR0-
      MADS  *BR0-, AR0
      MADS  *0-
      MADS  *0-, AR0
      MADS  *0+
      MADS  *0+, AR0
      MADS  *BR0+
      MADS  *BR0+, AR0
      MADD  00H
      MADD  *
      MADD  *, AR0
      MADD  *-
      MADD  *-, AR0
      MADD  *+
      MADD  *+, AR0
      MADD  *BR0-
      MADD  *BR0-, AR0
      MADD  *0-
      MADD  *0-, AR0
      MADD  *0+
      MADD  *0+, AR0
      MADD  *BR0+
      MADD  *BR0+, AR0
      BLDD  BMAR, 00H
      BLDD  BMAR, *
      BLDD  BMAR, *, AR0
      BLDD  BMAR, *-
      BLDD  BMAR, *-, AR0
      BLDD  BMAR, *+
      BLDD  BMAR, *+, AR0
      BLDD  BMAR, *BR0-
      BLDD  BMAR, *BR0-, AR0
      BLDD  BMAR, *0-
      BLDD  BMAR, *0-, AR0
      BLDD  BMAR, *0+
      BLDD  BMAR, *0+, AR0
      BLDD  BMAR, *BR0+
      BLDD  BMAR, *BR0+, AR0
      BLDD  00H, BMAR
      BLDD  *, BMAR
      BLDD  *, BMAR, AR0
      BLDD  *-, BMAR
      BLDD  *-, BMAR, AR0
      BLDD  *+, BMAR
      BLDD  *+, BMAR, AR0
      BLDD  *BR0-, BMAR
      BLDD  *BR0-, BMAR, AR0
      BLDD  *0-, BMAR
      BLDD  *0-, BMAR, AR0
      BLDD  *0+, BMAR
      BLDD  *0+, BMAR, AR0
      BLDD  *BR0+, BMAR
      BLDD  *BR0+, BMAR, AR0
      SPLK  #0AF01H, 00H
      SPLK  #0AF81H, *
      SPLK  #0AF89H, *, AR0
      SPLK  #0AF91H, *-
      SPLK  #0AF99H, *-, AR0
      SPLK  #0AFA1H, *+
      SPLK  #0AFA9H, *+, AR0
      SPLK  #0AFC1H, *BR0-
      SPLK  #0AFC9H, *BR0-, AR0
      SPLK  #0AFD1H, *0-
      SPLK  #0AFD9H, *0-, AR0
      SPLK  #0AFE1H, *0+
      SPLK  #0AFE9H, *0+, AR0
      SPLK  #0AFF1H, *BR0+
      SPLK  #0AFF9H, *BR0+, AR0
      IN    00H, 0B001H
      IN    *, 0B081H
      IN    *, 0B089H, AR0
      IN    *-, 0B091H
      IN    *-, 0B099H, AR0
      IN    *+, 0B0A1H
      IN    *+, 0B0A9H, AR0
      IN    *BR0-, 0B0C1H
      IN    *BR0-, 0B0C9H, AR0
      IN    *0-, 0B0D1H
      IN    *0-, 0B0D9H, AR0
      IN    *0+, 0B0E1H
      IN    *0+, 0B0E9H, AR0
      IN    *BR0+, 0B0F1H
      IN    *BR0+, 0B0F9H, AR0
      LAR   AR0, #0
      ADD   #0
      LACL  #0
      SUB   #0
      RPT   #0
      LDP   #000H
      ABS
      CMPL
      NEG
      PAC
      APAC
      SPAC
      SFL
      SFR
      ROL
      ROR
      ADDB
      ADCB
      ANDB
      ORB
      ROLB
      RORB
      SFLB
      SFRB
      SBB
      SBBB
      XORB
      CRGT
      CRLT
      EXAR
      SACB
      LACB
      BACC
      BACCD
      IDLE
      IDLE2
      CALA
      POP
      RETI
      RETE
      PUSH
      CALAD
      CLRC  INTM
      SETC  INTM
      CLRC  OVM
      SETC  OVM
      CLRC  CNF
      SETC  CNF
      CLRC  SXM
      SETC  SXM
      CLRC  HM
      SETC  HM
      CLRC  TC
      SETC  TC
      CLRC  XF
      SETC  XF
      CLRC  C
      SETC  C
      TRAP
      NMI
      ZPR
      ZAP
      SATH
      SATL
      INTR  0
      AND   #0BF82H, 16
      OR    #0BF83H, 16
      XOR   #0BF84H, 16
      RPTZ  #0BFC6H
      RPTB  0BFC7H
      SPM   0
      LAR   AR0, #0C009H
      CMPR  0
      LACC  #0C081H
      LACC  #0C082H, 1
      ADD   #0C091H
      ADD   #0C092H, 1
      SUB   #0C0A1H
      SUB   #0C0A2H, 1
      AND   #0C0B1H
      OR    #0C0C1H
      XOR   #0C0D1H
      BSAR  1
      MPY   #0
      BCND  0E101H, BIO
      BCND  0E102H, BIO,NC
      BCND  0E103H, BIO,NOV
      BCND  0E104H, BIO,NOV,NC
      BCND  0E105H, BIO,GEQ
      BCND  0E106H, BIO,GEQ,NC
      BCND  0E107H, BIO,GEQ,NOV
      BCND  0E108H, BIO,GEQ,NOV,NC
      BCND  0E109H, BIO,NEQ
      BCND  0E10AH, BIO,NEQ,NC
      BCND  0E10BH, BIO,NEQ,NOV
      BCND  0E10CH, BIO,NEQ,NOV,NC
      BCND  0E10DH, BIO,GT
      BCND  0E10EH, BIO,GT,NC
      BCND  0E10FH, BIO,GT,NOV
      BCND  0E110H, BIO,GT,NOV,NC
      BCND  0E112H, BIO,C
      BCND  0E114H, BIO,NOV,C
      BCND  0E116H, BIO,GEQ,C
      BCND  0E118H, BIO,GEQ,NOV,C
      BCND  0E11AH, BIO,NEQ,C
      BCND  0E11CH, BIO,NEQ,NOV,C
      BCND  0E11EH, BIO,GT,C
      BCND  0E120H, BIO,GT,NOV,C
      BCND  0E123H, BIO,OV
      BCND  0E124H, BIO,OV,NC
      BCND  0E127H, BIO,GEQ,OV
      BCND  0E128H, BIO,GEQ,OV,NC
      BCND  0E12BH, BIO,NEQ,OV
      BCND  0E12CH, BIO,NEQ,OV,NC
      BCND  0E12FH, BIO,GT,OV
      BCND  0E130H, BIO,GT,OV,NC
      BCND  0E134H, BIO,OV,C
      BCND  0E138H, BIO,GEQ,OV,C
      BCND  0E13CH, BIO,NEQ,OV,C
      BCND  0E140H, BIO,GT,OV,C
      BCND  0E145H, BIO,LT
      BCND  0E146H, BIO,LT,NC
      BCND  0E147H, BIO,LT,NOV
      BCND  0E148H, BIO,LT,NOV,NC
      BCND  0E156H, BIO,LT,C
      BCND  0E158H, BIO,LT,NOV,C
      BCND  0E167H, BIO,LT,OV
      BCND  0E168H, BIO,LT,OV,NC
      BCND  0E178H, BIO,LT,OV,C
      BCND  0E189H, BIO,EQ
      BCND  0E18AH, BIO,EQ,NC
      BCND  0E18BH, BIO,EQ,NOV
      BCND  0E18CH, BIO,EQ,NOV,NC
      BCND  0E19AH, BIO,EQ,C
      BCND  0E19CH, BIO,EQ,NOV,C
      BCND  0E1ABH, BIO,EQ,OV
      BCND  0E1ACH, BIO,EQ,OV,NC
      BCND  0E1BCH, BIO,EQ,OV,C
      BCND  0E1CDH, BIO,LEQ
      BCND  0E1CEH, BIO,LEQ,NC
      BCND  0E1CFH, BIO,LEQ,NOV
      BCND  0E1D0H, BIO,LEQ,NOV,NC
      BCND  0E1DEH, BIO,LEQ,C
      BCND  0E1E0H, BIO,LEQ,NOV,C
      BCND  0E1EFH, BIO,LEQ,OV
      BCND  0E1F0H, BIO,LEQ,OV,NC
      BCND  0E200H, BIO,LEQ,OV,C
      BCND  0E201H, TC
      BCND  0E202H, TC,NC
      BCND  0E203H, TC,NOV
      BCND  0E204H, TC,NOV,NC
      BCND  0E205H, TC,GEQ
      BCND  0E206H, TC,GEQ,NC
      BCND  0E207H, TC,GEQ,NOV
      BCND  0E208H, TC,GEQ,NOV,NC
      BCND  0E209H, TC,NEQ
      BCND  0E20AH, TC,NEQ,NC
      BCND  0E20BH, TC,NEQ,NOV
      BCND  0E20CH, TC,NEQ,NOV,NC
      BCND  0E20DH, TC,GT
      BCND  0E20EH, TC,GT,NC
      BCND  0E20FH, TC,GT,NOV
      BCND  0E210H, TC,GT,NOV,NC
      BCND  0E212H, TC,C
      BCND  0E214H, TC,NOV,C
      BCND  0E216H, TC,GEQ,C
      BCND  0E218H, TC,GEQ,NOV,C
      BCND  0E21AH, TC,NEQ,C
      BCND  0E21CH, TC,NEQ,NOV,C
      BCND  0E21EH, TC,GT,C
      BCND  0E220H, TC,GT,NOV,C
      BCND  0E223H, TC,OV
      BCND  0E224H, TC,OV,NC
      BCND  0E227H, TC,GEQ,OV
      BCND  0E228H, TC,GEQ,OV,NC
      BCND  0E22BH, TC,NEQ,OV
      BCND  0E22CH, TC,NEQ,OV,NC
      BCND  0E22FH, TC,GT,OV
      BCND  0E230H, TC,GT,OV,NC
      BCND  0E234H, TC,OV,C
      BCND  0E238H, TC,GEQ,OV,C
      BCND  0E23CH, TC,NEQ,OV,C
      BCND  0E240H, TC,GT,OV,C
      BCND  0E245H, TC,LT
      BCND  0E246H, TC,LT,NC
      BCND  0E247H, TC,LT,NOV
      BCND  0E248H, TC,LT,NOV,NC
      BCND  0E256H, TC,LT,C
      BCND  0E258H, TC,LT,NOV,C
      BCND  0E267H, TC,LT,OV
      BCND  0E268H, TC,LT,OV,NC
      BCND  0E278H, TC,LT,OV,C
      BCND  0E289H, TC,EQ
      BCND  0E28AH, TC,EQ,NC
      BCND  0E28BH, TC,EQ,NOV
      BCND  0E28CH, TC,EQ,NOV,NC
      BCND  0E29AH, TC,EQ,C
      BCND  0E29CH, TC,EQ,NOV,C
      BCND  0E2ABH, TC,EQ,OV
      BCND  0E2ACH, TC,EQ,OV,NC
      BCND  0E2BCH, TC,EQ,OV,C
      BCND  0E2CDH, TC,LEQ
      BCND  0E2CEH, TC,LEQ,NC
      BCND  0E2CFH, TC,LEQ,NOV
      BCND  0E2D0H, TC,LEQ,NOV,NC
      BCND  0E2DEH, TC,LEQ,C
      BCND  0E2E0H, TC,LEQ,NOV,C
      BCND  0E2EFH, TC,LEQ,OV
      BCND  0E2F0H, TC,LEQ,OV,NC
      BCND  0E300H, TC,LEQ,OV,C
      BCND  0E301H, NTC
      BCND  0E302H, NTC,NC
      BCND  0E303H, NTC,NOV
      BCND  0E304H, NTC,NOV,NC
      BCND  0E305H, NTC,GEQ
      BCND  0E306H, NTC,GEQ,NC
      BCND  0E307H, NTC,GEQ,NOV
      BCND  0E308H, NTC,GEQ,NOV,NC
      BCND  0E309H, NTC,NEQ
      BCND  0E30AH, NTC,NEQ,NC
      BCND  0E30BH, NTC,NEQ,NOV
      BCND  0E30CH, NTC,NEQ,NOV,NC
      BCND  0E30DH, NTC,GT
      BCND  0E30EH, NTC,GT,NC
      BCND  0E30FH, NTC,GT,NOV
      BCND  0E310H, NTC,GT,NOV,NC
      BCND  0E312H, NTC,C
      BCND  0E314H, NTC,NOV,C
      BCND  0E316H, NTC,GEQ,C
      BCND  0E318H, NTC,GEQ,NOV,C
      BCND  0E31AH, NTC,NEQ,C
      BCND  0E31CH, NTC,NEQ,NOV,C
      BCND  0E31EH, NTC,GT,C
      BCND  0E320H, NTC,GT,NOV,C
      BCND  0E323H, NTC,OV
      BCND  0E324H, NTC,OV,NC
      BCND  0E327H, NTC,GEQ,OV
      BCND  0E328H, NTC,GEQ,OV,NC
      BCND  0E32BH, NTC,NEQ,OV
      BCND  0E32CH, NTC,NEQ,OV,NC
      BCND  0E32FH, NTC,GT,OV
      BCND  0E330H, NTC,GT,OV,NC
      BCND  0E334H, NTC,OV,C
      BCND  0E338H, NTC,GEQ,OV,C
      BCND  0E33CH, NTC,NEQ,OV,C
      BCND  0E340H, NTC,GT,OV,C
      BCND  0E345H, NTC,LT
      BCND  0E346H, NTC,LT,NC
      BCND  0E347H, NTC,LT,NOV
      BCND  0E348H, NTC,LT,NOV,NC
      BCND  0E356H, NTC,LT,C
      BCND  0E358H, NTC,LT,NOV,C
      BCND  0E367H, NTC,LT,OV
      BCND  0E368H, NTC,LT,OV,NC
      BCND  0E378H, NTC,LT,OV,C
      BCND  0E389H, NTC,EQ
      BCND  0E38AH, NTC,EQ,NC
      BCND  0E38BH, NTC,EQ,NOV
      BCND  0E38CH, NTC,EQ,NOV,NC
      BCND  0E39AH, NTC,EQ,C
      BCND  0E39CH, NTC,EQ,NOV,C
      BCND  0E3ABH, NTC,EQ,OV
      BCND  0E3ACH, NTC,EQ,OV,NC
      BCND  0E3BCH, NTC,EQ,OV,C
      BCND  0E3CDH, NTC,LEQ
      BCND  0E3CEH, NTC,LEQ,NC
      BCND  0E3CFH, NTC,LEQ,NOV
      BCND  0E3D0H, NTC,LEQ,NOV,NC
      BCND  0E3DEH, NTC,LEQ,C
      BCND  0E3E0H, NTC,LEQ,NOV,C
      BCND  0E3EFH, NTC,LEQ,OV
      BCND  0E3F0H, NTC,LEQ,OV,NC
      BCND  0E400H, NTC,LEQ,OV,C
      BCND  0E401H, UNC
      BCND  0E402H, NC
      BCND  0E403H, NOV
      BCND  0E404H, NOV,NC
      BCND  0E405H, GEQ
      BCND  0E406H, GEQ,NC
      BCND  0E407H, GEQ,NOV
      BCND  0E408H, GEQ,NOV,NC
      BCND  0E409H, NEQ
      BCND  0E40AH, NEQ,NC
      BCND  0E40BH, NEQ,NOV
      BCND  0E40CH, NEQ,NOV,NC
      BCND  0E40DH, GT
      BCND  0E40EH, GT,NC
      BCND  0E40FH, GT,NOV
      BCND  0E410H, GT,NOV,NC
      BCND  0E412H, C
      BCND  0E414H, NOV,C
      BCND  0E416H, GEQ,C
      BCND  0E418H, GEQ,NOV,C
      BCND  0E41AH, NEQ,C
      BCND  0E41CH, NEQ,NOV,C
      BCND  0E41EH, GT,C
      BCND  0E420H, GT,NOV,C
      BCND  0E423H, OV
      BCND  0E424H, OV,NC
      BCND  0E427H, GEQ,OV
      BCND  0E428H, GEQ,OV,NC
      BCND  0E42BH, NEQ,OV
      BCND  0E42CH, NEQ,OV,NC
      BCND  0E42FH, GT,OV
      BCND  0E430H, GT,OV,NC
      BCND  0E434H, OV,C
      BCND  0E438H, GEQ,OV,C
      BCND  0E43CH, NEQ,OV,C
      BCND  0E440H, GT,OV,C
      BCND  0E445H, LT
      BCND  0E446H, LT,NC
      BCND  0E447H, LT,NOV
      BCND  0E448H, LT,NOV,NC
      BCND  0E456H, LT,C
      BCND  0E458H, LT,NOV,C
      BCND  0E467H, LT,OV
      BCND  0E468H, LT,OV,NC
      BCND  0E478H, LT,OV,C
      BCND  0E489H, EQ
      BCND  0E48AH, EQ,NC
      BCND  0E48BH, EQ,NOV
      BCND  0E48CH, EQ,NOV,NC
      BCND  0E49AH, EQ,C
      BCND  0E49CH, EQ,NOV,C
      BCND  0E4ABH, EQ,OV
      BCND  0E4ACH, EQ,OV,NC
      BCND  0E4BCH, EQ,OV,C
      BCND  0E4CDH, LEQ
      BCND  0E4CEH, LEQ,NC
      BCND  0E4CFH, LEQ,NOV
      BCND  0E4D0H, LEQ,NOV,NC
      BCND  0E4DEH, LEQ,C
      BCND  0E4E0H, LEQ,NOV,C
      BCND  0E4EFH, LEQ,OV
      BCND  0E4F0H, LEQ,OV,NC
      BCND  0E500H, LEQ,OV,C
      XC    1, BIO
      XC    1, BIO,NC
      XC    1, BIO,NOV
      XC    1, BIO,NOV,NC
      XC    1, BIO,GEQ
      XC    1, BIO,GEQ,NC
      XC    1, BIO,GEQ,NOV
      XC    1, BIO,GEQ,NOV,NC
      XC    1, BIO,NEQ
      XC    1, BIO,NEQ,NC
      XC    1, BIO,NEQ,NOV
      XC    1, BIO,NEQ,NOV,NC
      XC    1, BIO,GT
      XC    1, BIO,GT,NC
      XC    1, BIO,GT,NOV
      XC    1, BIO,GT,NOV,NC
      XC    1, BIO,C
      XC    1, BIO,NOV,C
      XC    1, BIO,GEQ,C
      XC    1, BIO,GEQ,NOV,C
      XC    1, BIO,NEQ,C
      XC    1, BIO,NEQ,NOV,C
      XC    1, BIO,GT,C
      XC    1, BIO,GT,NOV,C
      XC    1, BIO,OV
      XC    1, BIO,OV,NC
      XC    1, BIO,GEQ,OV
      XC    1, BIO,GEQ,OV,NC
      XC    1, BIO,NEQ,OV
      XC    1, BIO,NEQ,OV,NC
      XC    1, BIO,GT,OV
      XC    1, BIO,GT,OV,NC
      XC    1, BIO,OV,C
      XC    1, BIO,GEQ,OV,C
      XC    1, BIO,NEQ,OV,C
      XC    1, BIO,GT,OV,C
      XC    1, BIO,LT
      XC    1, BIO,LT,NC
      XC    1, BIO,LT,NOV
      XC    1, BIO,LT,NOV,NC
      XC    1, BIO,LT,C
      XC    1, BIO,LT,NOV,C
      XC    1, BIO,LT,OV
      XC    1, BIO,LT,OV,NC
      XC    1, BIO,LT,OV,C
      XC    1, BIO,EQ
      XC    1, BIO,EQ,NC
      XC    1, BIO,EQ,NOV
      XC    1, BIO,EQ,NOV,NC
      XC    1, BIO,EQ,C
      XC    1, BIO,EQ,NOV,C
      XC    1, BIO,EQ,OV
      XC    1, BIO,EQ,OV,NC
      XC    1, BIO,EQ,OV,C
      XC    1, BIO,LEQ
      XC    1, BIO,LEQ,NC
      XC    1, BIO,LEQ,NOV
      XC    1, BIO,LEQ,NOV,NC
      XC    1, BIO,LEQ,C
      XC    1, BIO,LEQ,NOV,C
      XC    1, BIO,LEQ,OV
      XC    1, BIO,LEQ,OV,NC
      XC    1, BIO,LEQ,OV,C
      XC    1, TC
      XC    1, TC,NC
      XC    1, TC,NOV
      XC    1, TC,NOV,NC
      XC    1, TC,GEQ
      XC    1, TC,GEQ,NC
      XC    1, TC,GEQ,NOV
      XC    1, TC,GEQ,NOV,NC
      XC    1, TC,NEQ
      XC    1, TC,NEQ,NC
      XC    1, TC,NEQ,NOV
      XC    1, TC,NEQ,NOV,NC
      XC    1, TC,GT
      XC    1, TC,GT,NC
      XC    1, TC,GT,NOV
      XC    1, TC,GT,NOV,NC
      XC    1, TC,C
      XC    1, TC,NOV,C
      XC    1, TC,GEQ,C
      XC    1, TC,GEQ,NOV,C
      XC    1, TC,NEQ,C
      XC    1, TC,NEQ,NOV,C
      XC    1, TC,GT,C
      XC    1, TC,GT,NOV,C
      XC    1, TC,OV
      XC    1, TC,OV,NC
      XC    1, TC,GEQ,OV
      XC    1, TC,GEQ,OV,NC
      XC    1, TC,NEQ,OV
      XC    1, TC,NEQ,OV,NC
      XC    1, TC,GT,OV
      XC    1, TC,GT,OV,NC
      XC    1, TC,OV,C
      XC    1, TC,GEQ,OV,C
      XC    1, TC,NEQ,OV,C
      XC    1, TC,GT,OV,C
      XC    1, TC,LT
      XC    1, TC,LT,NC
      XC    1, TC,LT,NOV
      XC    1, TC,LT,NOV,NC
      XC    1, TC,LT,C
      XC    1, TC,LT,NOV,C
      XC    1, TC,LT,OV
      XC    1, TC,LT,OV,NC
      XC    1, TC,LT,OV,C
      XC    1, TC,EQ
      XC    1, TC,EQ,NC
      XC    1, TC,EQ,NOV
      XC    1, TC,EQ,NOV,NC
      XC    1, TC,EQ,C
      XC    1, TC,EQ,NOV,C
      XC    1, TC,EQ,OV
      XC    1, TC,EQ,OV,NC
      XC    1, TC,EQ,OV,C
      XC    1, TC,LEQ
      XC    1, TC,LEQ,NC
      XC    1, TC,LEQ,NOV
      XC    1, TC,LEQ,NOV,NC
      XC    1, TC,LEQ,C
      XC    1, TC,LEQ,NOV,C
      XC    1, TC,LEQ,OV
      XC    1, TC,LEQ,OV,NC
      XC    1, TC,LEQ,OV,C
      XC    1, NTC
      XC    1, NTC,NC
      XC    1, NTC,NOV
      XC    1, NTC,NOV,NC
      XC    1, NTC,GEQ
      XC    1, NTC,GEQ,NC
      XC    1, NTC,GEQ,NOV
      XC    1, NTC,GEQ,NOV,NC
      XC    1, NTC,NEQ
      XC    1, NTC,NEQ,NC
      XC    1, NTC,NEQ,NOV
      XC    1, NTC,NEQ,NOV,NC
      XC    1, NTC,GT
      XC    1, NTC,GT,NC
      XC    1, NTC,GT,NOV
      XC    1, NTC,GT,NOV,NC
      XC    1, NTC,C
      XC    1, NTC,NOV,C
      XC    1, NTC,GEQ,C
      XC    1, NTC,GEQ,NOV,C
      XC    1, NTC,NEQ,C
      XC    1, NTC,NEQ,NOV,C
      XC    1, NTC,GT,C
      XC    1, NTC,GT,NOV,C
      XC    1, NTC,OV
      XC    1, NTC,OV,NC
      XC    1, NTC,GEQ,OV
      XC    1, NTC,GEQ,OV,NC
      XC    1, NTC,NEQ,OV
      XC    1, NTC,NEQ,OV,NC
      XC    1, NTC,GT,OV
      XC    1, NTC,GT,OV,NC
      XC    1, NTC,OV,C
      XC    1, NTC,GEQ,OV,C
      XC    1, NTC,NEQ,OV,C
      XC    1, NTC,GT,OV,C
      XC    1, NTC,LT
      XC    1, NTC,LT,NC
      XC    1, NTC,LT,NOV
      XC    1, NTC,LT,NOV,NC
      XC    1, NTC,LT,C
      XC    1, NTC,LT,NOV,C
      XC    1, NTC,LT,OV
      XC    1, NTC,LT,OV,NC
      XC    1, NTC,LT,OV,C
      XC    1, NTC,EQ
      XC    1, NTC,EQ,NC
      XC    1, NTC,EQ,NOV
      XC    1, NTC,EQ,NOV,NC
      XC    1, NTC,EQ,C
      XC    1, NTC,EQ,NOV,C
      XC    1, NTC,EQ,OV
      XC    1, NTC,EQ,OV,NC
      XC    1, NTC,EQ,OV,C
      XC    1, NTC,LEQ
      XC    1, NTC,LEQ,NC
      XC    1, NTC,LEQ,NOV
      XC    1, NTC,LEQ,NOV,NC
      XC    1, NTC,LEQ,C
      XC    1, NTC,LEQ,NOV,C
      XC    1, NTC,LEQ,OV
      XC    1, NTC,LEQ,OV,NC
      XC    1, NTC,LEQ,OV,C
      XC    1, UNC
      XC    1, NC
      XC    1, NOV
      XC    1, NOV,NC
      XC    1, GEQ
      XC    1, GEQ,NC
      XC    1, GEQ,NOV
      XC    1, GEQ,NOV,NC
      XC    1, NEQ
      XC    1, NEQ,NC
      XC    1, NEQ,NOV
      XC    1, NEQ,NOV,NC
      XC    1, GT
      XC    1, GT,NC
      XC    1, GT,NOV
      XC    1, GT,NOV,NC
      XC    1, C
      XC    1, NOV,C
      XC    1, GEQ,C
      XC    1, GEQ,NOV,C
      XC    1, NEQ,C
      XC    1, NEQ,NOV,C
      XC    1, GT,C
      XC    1, GT,NOV,C
      XC    1, OV
      XC    1, OV,NC
      XC    1, GEQ,OV
      XC    1, GEQ,OV,NC
      XC    1, NEQ,OV
      XC    1, NEQ,OV,NC
      XC    1, GT,OV
      XC    1, GT,OV,NC
      XC    1, OV,C
      XC    1, GEQ,OV,C
      XC    1, NEQ,OV,C
      XC    1, GT,OV,C
      XC    1, LT
      XC    1, LT,NC
      XC    1, LT,NOV
      XC    1, LT,NOV,NC
      XC    1, LT,C
      XC    1, LT,NOV,C
      XC    1, LT,OV
      XC    1, LT,OV,NC
      XC    1, LT,OV,C
      XC    1, EQ
      XC    1, EQ,NC
      XC    1, EQ,NOV
      XC    1, EQ,NOV,NC
      XC    1, EQ,C
      XC    1, EQ,NOV,C
      XC    1, EQ,OV
      XC    1, EQ,OV,NC
      XC    1, EQ,OV,C
      XC    1, LEQ
      XC    1, LEQ,NC
      XC    1, LEQ,NOV
      XC    1, LEQ,NOV,NC
      XC    1, LEQ,C
      XC    1, LEQ,NOV,C
      XC    1, LEQ,OV
      XC    1, LEQ,OV,NC
      XC    1, LEQ,OV,C
      CC    0E901H, BIO
      CC    0E902H, BIO,NC
      CC    0E903H, BIO,NOV
      CC    0E904H, BIO,NOV,NC
      CC    0E905H, BIO,GEQ
      CC    0E906H, BIO,GEQ,NC
      CC    0E907H, BIO,GEQ,NOV
      CC    0E908H, BIO,GEQ,NOV,NC
      CC    0E909H, BIO,NEQ
      CC    0E90AH, BIO,NEQ,NC
      CC    0E90BH, BIO,NEQ,NOV
      CC    0E90CH, BIO,NEQ,NOV,NC
      CC    0E90DH, BIO,GT
      CC    0E90EH, BIO,GT,NC
      CC    0E90FH, BIO,GT,NOV
      CC    0E910H, BIO,GT,NOV,NC
      CC    0E912H, BIO,C
      CC    0E914H, BIO,NOV,C
      CC    0E916H, BIO,GEQ,C
      CC    0E918H, BIO,GEQ,NOV,C
      CC    0E91AH, BIO,NEQ,C
      CC    0E91CH, BIO,NEQ,NOV,C
      CC    0E91EH, BIO,GT,C
      CC    0E920H, BIO,GT,NOV,C
      CC    0E923H, BIO,OV
      CC    0E924H, BIO,OV,NC
      CC    0E927H, BIO,GEQ,OV
      CC    0E928H, BIO,GEQ,OV,NC
      CC    0E92BH, BIO,NEQ,OV
      CC    0E92CH, BIO,NEQ,OV,NC
      CC    0E92FH, BIO,GT,OV
      CC    0E930H, BIO,GT,OV,NC
      CC    0E934H, BIO,OV,C
      CC    0E938H, BIO,GEQ,OV,C
      CC    0E93CH, BIO,NEQ,OV,C
      CC    0E940H, BIO,GT,OV,C
      CC    0E945H, BIO,LT
      CC    0E946H, BIO,LT,NC
      CC    0E947H, BIO,LT,NOV
      CC    0E948H, BIO,LT,NOV,NC
      CC    0E956H, BIO,LT,C
      CC    0E958H, BIO,LT,NOV,C
      CC    0E967H, BIO,LT,OV
      CC    0E968H, BIO,LT,OV,NC
      CC    0E978H, BIO,LT,OV,C
      CC    0E989H, BIO,EQ
      CC    0E98AH, BIO,EQ,NC
      CC    0E98BH, BIO,EQ,NOV
      CC    0E98CH, BIO,EQ,NOV,NC
      CC    0E99AH, BIO,EQ,C
      CC    0E99CH, BIO,EQ,NOV,C
      CC    0E9ABH, BIO,EQ,OV
      CC    0E9ACH, BIO,EQ,OV,NC
      CC    0E9BCH, BIO,EQ,OV,C
      CC    0E9CDH, BIO,LEQ
      CC    0E9CEH, BIO,LEQ,NC
      CC    0E9CFH, BIO,LEQ,NOV
      CC    0E9D0H, BIO,LEQ,NOV,NC
      CC    0E9DEH, BIO,LEQ,C
      CC    0E9E0H, BIO,LEQ,NOV,C
      CC    0E9EFH, BIO,LEQ,OV
      CC    0E9F0H, BIO,LEQ,OV,NC
      CC    0EA00H, BIO,LEQ,OV,C
      CC    0EA01H, TC
      CC    0EA02H, TC,NC
      CC    0EA03H, TC,NOV
      CC    0EA04H, TC,NOV,NC
      CC    0EA05H, TC,GEQ
      CC    0EA06H, TC,GEQ,NC
      CC    0EA07H, TC,GEQ,NOV
      CC    0EA08H, TC,GEQ,NOV,NC
      CC    0EA09H, TC,NEQ
      CC    0EA0AH, TC,NEQ,NC
      CC    0EA0BH, TC,NEQ,NOV
      CC    0EA0CH, TC,NEQ,NOV,NC
      CC    0EA0DH, TC,GT
      CC    0EA0EH, TC,GT,NC
      CC    0EA0FH, TC,GT,NOV
      CC    0EA10H, TC,GT,NOV,NC
      CC    0EA12H, TC,C
      CC    0EA14H, TC,NOV,C
      CC    0EA16H, TC,GEQ,C
      CC    0EA18H, TC,GEQ,NOV,C
      CC    0EA1AH, TC,NEQ,C
      CC    0EA1CH, TC,NEQ,NOV,C
      CC    0EA1EH, TC,GT,C
      CC    0EA20H, TC,GT,NOV,C
      CC    0EA23H, TC,OV
      CC    0EA24H, TC,OV,NC
      CC    0EA27H, TC,GEQ,OV
      CC    0EA28H, TC,GEQ,OV,NC
      CC    0EA2BH, TC,NEQ,OV
      CC    0EA2CH, TC,NEQ,OV,NC
      CC    0EA2FH, TC,GT,OV
      CC    0EA30H, TC,GT,OV,NC
      CC    0EA34H, TC,OV,C
      CC    0EA38H, TC,GEQ,OV,C
      CC    0EA3CH, TC,NEQ,OV,C
      CC    0EA40H, TC,GT,OV,C
      CC    0EA45H, TC,LT
      CC    0EA46H, TC,LT,NC
      CC    0EA47H, TC,LT,NOV
      CC    0EA48H, TC,LT,NOV,NC
      CC    0EA56H, TC,LT,C
      CC    0EA58H, TC,LT,NOV,C
      CC    0EA67H, TC,LT,OV
      CC    0EA68H, TC,LT,OV,NC
      CC    0EA78H, TC,LT,OV,C
      CC    0EA89H, TC,EQ
      CC    0EA8AH, TC,EQ,NC
      CC    0EA8BH, TC,EQ,NOV
      CC    0EA8CH, TC,EQ,NOV,NC
      CC    0EA9AH, TC,EQ,C
      CC    0EA9CH, TC,EQ,NOV,C
      CC    0EAABH, TC,EQ,OV
      CC    0EAACH, TC,EQ,OV,NC
      CC    0EABCH, TC,EQ,OV,C
      CC    0EACDH, TC,LEQ
      CC    0EACEH, TC,LEQ,NC
      CC    0EACFH, TC,LEQ,NOV
      CC    0EAD0H, TC,LEQ,NOV,NC
      CC    0EADEH, TC,LEQ,C
      CC    0EAE0H, TC,LEQ,NOV,C
      CC    0EAEFH, TC,LEQ,OV
      CC    0EAF0H, TC,LEQ,OV,NC
      CC    0EB00H, TC,LEQ,OV,C
      CC    0EB01H, NTC
      CC    0EB02H, NTC,NC
      CC    0EB03H, NTC,NOV
      CC    0EB04H, NTC,NOV,NC
      CC    0EB05H, NTC,GEQ
      CC    0EB06H, NTC,GEQ,NC
      CC    0EB07H, NTC,GEQ,NOV
      CC    0EB08H, NTC,GEQ,NOV,NC
      CC    0EB09H, NTC,NEQ
      CC    0EB0AH, NTC,NEQ,NC
      CC    0EB0BH, NTC,NEQ,NOV
      CC    0EB0CH, NTC,NEQ,NOV,NC
      CC    0EB0DH, NTC,GT
      CC    0EB0EH, NTC,GT,NC
      CC    0EB0FH, NTC,GT,NOV
      CC    0EB10H, NTC,GT,NOV,NC
      CC    0EB12H, NTC,C
      CC    0EB14H, NTC,NOV,C
      CC    0EB16H, NTC,GEQ,C
      CC    0EB18H, NTC,GEQ,NOV,C
      CC    0EB1AH, NTC,NEQ,C
      CC    0EB1CH, NTC,NEQ,NOV,C
      CC    0EB1EH, NTC,GT,C
      CC    0EB20H, NTC,GT,NOV,C
      CC    0EB23H, NTC,OV
      CC    0EB24H, NTC,OV,NC
      CC    0EB27H, NTC,GEQ,OV
      CC    0EB28H, NTC,GEQ,OV,NC
      CC    0EB2BH, NTC,NEQ,OV
      CC    0EB2CH, NTC,NEQ,OV,NC
      CC    0EB2FH, NTC,GT,OV
      CC    0EB30H, NTC,GT,OV,NC
      CC    0EB34H, NTC,OV,C
      CC    0EB38H, NTC,GEQ,OV,C
      CC    0EB3CH, NTC,NEQ,OV,C
      CC    0EB40H, NTC,GT,OV,C
      CC    0EB45H, NTC,LT
      CC    0EB46H, NTC,LT,NC
      CC    0EB47H, NTC,LT,NOV
      CC    0EB48H, NTC,LT,NOV,NC
      CC    0EB56H, NTC,LT,C
      CC    0EB58H, NTC,LT,NOV,C
      CC    0EB67H, NTC,LT,OV
      CC    0EB68H, NTC,LT,OV,NC
      CC    0EB78H, NTC,LT,OV,C
      CC    0EB89H, NTC,EQ
      CC    0EB8AH, NTC,EQ,NC
      CC    0EB8BH, NTC,EQ,NOV
      CC    0EB8CH, NTC,EQ,NOV,NC
      CC    0EB9AH, NTC,EQ,C
      CC    0EB9CH, NTC,EQ,NOV,C
      CC    0EBABH, NTC,EQ,OV
      CC    0EBACH, NTC,EQ,OV,NC
      CC    0EBBCH, NTC,EQ,OV,C
      CC    0EBCDH, NTC,LEQ
      CC    0EBCEH, NTC,LEQ,NC
      CC    0EBCFH, NTC,LEQ,NOV
      CC    0EBD0H, NTC,LEQ,NOV,NC
      CC    0EBDEH, NTC,LEQ,C
      CC    0EBE0H, NTC,LEQ,NOV,C
      CC    0EBEFH, NTC,LEQ,OV
      CC    0EBF0H, NTC,LEQ,OV,NC
      CC    0EC00H, NTC,LEQ,OV,C
      CC    0EC01H, UNC
      CC    0EC02H, NC
      CC    0EC03H, NOV
      CC    0EC04H, NOV,NC
      CC    0EC05H, GEQ
      CC    0EC06H, GEQ,NC
      CC    0EC07H, GEQ,NOV
      CC    0EC08H, GEQ,NOV,NC
      CC    0EC09H, NEQ
      CC    0EC0AH, NEQ,NC
      CC    0EC0BH, NEQ,NOV
      CC    0EC0CH, NEQ,NOV,NC
      CC    0EC0DH, GT
      CC    0EC0EH, GT,NC
      CC    0EC0FH, GT,NOV
      CC    0EC10H, GT,NOV,NC
      CC    0EC12H, C
      CC    0EC14H, NOV,C
      CC    0EC16H, GEQ,C
      CC    0EC18H, GEQ,NOV,C
      CC    0EC1AH, NEQ,C
      CC    0EC1CH, NEQ,NOV,C
      CC    0EC1EH, GT,C
      CC    0EC20H, GT,NOV,C
      CC    0EC23H, OV
      CC    0EC24H, OV,NC
      CC    0EC27H, GEQ,OV
      CC    0EC28H, GEQ,OV,NC
      CC    0EC2BH, NEQ,OV
      CC    0EC2CH, NEQ,OV,NC
      CC    0EC2FH, GT,OV
      CC    0EC30H, GT,OV,NC
      CC    0EC34H, OV,C
      CC    0EC38H, GEQ,OV,C
      CC    0EC3CH, NEQ,OV,C
      CC    0EC40H, GT,OV,C
      CC    0EC45H, LT
      CC    0EC46H, LT,NC
      CC    0EC47H, LT,NOV
      CC    0EC48H, LT,NOV,NC
      CC    0EC56H, LT,C
      CC    0EC58H, LT,NOV,C
      CC    0EC67H, LT,OV
      CC    0EC68H, LT,OV,NC
      CC    0EC78H, LT,OV,C
      CC    0EC89H, EQ
      CC    0EC8AH, EQ,NC
      CC    0EC8BH, EQ,NOV
      CC    0EC8CH, EQ,NOV,NC
      CC    0EC9AH, EQ,C
      CC    0EC9CH, EQ,NOV,C
      CC    0ECABH, EQ,OV
      CC    0ECACH, EQ,OV,NC
      CC    0ECBCH, EQ,OV,C
      CC    0ECCDH, LEQ
      CC    0ECCEH, LEQ,NC
      CC    0ECCFH, LEQ,NOV
      CC    0ECD0H, LEQ,NOV,NC
      CC    0ECDEH, LEQ,C
      CC    0ECE0H, LEQ,NOV,C
      CC    0ECEFH, LEQ,OV
      CC    0ECF0H, LEQ,OV,NC
      CC    0ED00H, LEQ,OV,C
      RETC  BIO
      RETC  BIO,NC
      RETC  BIO,NOV
      RETC  BIO,NOV,NC
      RETC  BIO,GEQ
      RETC  BIO,GEQ,NC
      RETC  BIO,GEQ,NOV
      RETC  BIO,GEQ,NOV,NC
      RETC  BIO,NEQ
      RETC  BIO,NEQ,NC
      RETC  BIO,NEQ,NOV
      RETC  BIO,NEQ,NOV,NC
      RETC  BIO,GT
      RETC  BIO,GT,NC
      RETC  BIO,GT,NOV
      RETC  BIO,GT,NOV,NC
      RETC  BIO,C
      RETC  BIO,NOV,C
      RETC  BIO,GEQ,C
      RETC  BIO,GEQ,NOV,C
      RETC  BIO,NEQ,C
      RETC  BIO,NEQ,NOV,C
      RETC  BIO,GT,C
      RETC  BIO,GT,NOV,C
      RETC  BIO,OV
      RETC  BIO,OV,NC
      RETC  BIO,GEQ,OV
      RETC  BIO,GEQ,OV,NC
      RETC  BIO,NEQ,OV
      RETC  BIO,NEQ,OV,NC
      RETC  BIO,GT,OV
      RETC  BIO,GT,OV,NC
      RETC  BIO,OV,C
      RETC  BIO,GEQ,OV,C
      RETC  BIO,NEQ,OV,C
      RETC  BIO,GT,OV,C
      RETC  BIO,LT
      RETC  BIO,LT,NC
      RETC  BIO,LT,NOV
      RETC  BIO,LT,NOV,NC
      RETC  BIO,LT,C
      RETC  BIO,LT,NOV,C
      RETC  BIO,LT,OV
      RETC  BIO,LT,OV,NC
      RETC  BIO,LT,OV,C
      RETC  BIO,EQ
      RETC  BIO,EQ,NC
      RETC  BIO,EQ,NOV
      RETC  BIO,EQ,NOV,NC
      RETC  BIO,EQ,C
      RETC  BIO,EQ,NOV,C
      RETC  BIO,EQ,OV
      RETC  BIO,EQ,OV,NC
      RETC  BIO,EQ,OV,C
      RETC  BIO,LEQ
      RETC  BIO,LEQ,NC
      RETC  BIO,LEQ,NOV
      RETC  BIO,LEQ,NOV,NC
      RETC  BIO,LEQ,C
      RETC  BIO,LEQ,NOV,C
      RETC  BIO,LEQ,OV
      RETC  BIO,LEQ,OV,NC
      RETC  BIO,LEQ,OV,C
      RETC  TC
      RETC  TC,NC
      RETC  TC,NOV
      RETC  TC,NOV,NC
      RETC  TC,GEQ
      RETC  TC,GEQ,NC
      RETC  TC,GEQ,NOV
      RETC  TC,GEQ,NOV,NC
      RETC  TC,NEQ
      RETC  TC,NEQ,NC
      RETC  TC,NEQ,NOV
      RETC  TC,NEQ,NOV,NC
      RETC  TC,GT
      RETC  TC,GT,NC
      RETC  TC,GT,NOV
      RETC  TC,GT,NOV,NC
      RETC  TC,C
      RETC  TC,NOV,C
      RETC  TC,GEQ,C
      RETC  TC,GEQ,NOV,C
      RETC  TC,NEQ,C
      RETC  TC,NEQ,NOV,C
      RETC  TC,GT,C
      RETC  TC,GT,NOV,C
      RETC  TC,OV
      RETC  TC,OV,NC
      RETC  TC,GEQ,OV
      RETC  TC,GEQ,OV,NC
      RETC  TC,NEQ,OV
      RETC  TC,NEQ,OV,NC
      RETC  TC,GT,OV
      RETC  TC,GT,OV,NC
      RETC  TC,OV,C
      RETC  TC,GEQ,OV,C
      RETC  TC,NEQ,OV,C
      RETC  TC,GT,OV,C
      RETC  TC,LT
      RETC  TC,LT,NC
      RETC  TC,LT,NOV
      RETC  TC,LT,NOV,NC
      RETC  TC,LT,C
      RETC  TC,LT,NOV,C
      RETC  TC,LT,OV
      RETC  TC,LT,OV,NC
      RETC  TC,LT,OV,C
      RETC  TC,EQ
      RETC  TC,EQ,NC
      RETC  TC,EQ,NOV
      RETC  TC,EQ,NOV,NC
      RETC  TC,EQ,C
      RETC  TC,EQ,NOV,C
      RETC  TC,EQ,OV
      RETC  TC,EQ,OV,NC
      RETC  TC,EQ,OV,C
      RETC  TC,LEQ
      RETC  TC,LEQ,NC
      RETC  TC,LEQ,NOV
      RETC  TC,LEQ,NOV,NC
      RETC  TC,LEQ,C
      RETC  TC,LEQ,NOV,C
      RETC  TC,LEQ,OV
      RETC  TC,LEQ,OV,NC
      RETC  TC,LEQ,OV,C
      RETC  NTC
      RETC  NTC,NC
      RETC  NTC,NOV
      RETC  NTC,NOV,NC
      RETC  NTC,GEQ
      RETC  NTC,GEQ,NC
      RETC  NTC,GEQ,NOV
      RETC  NTC,GEQ,NOV,NC
      RETC  NTC,NEQ
      RETC  NTC,NEQ,NC
      RETC  NTC,NEQ,NOV
      RETC  NTC,NEQ,NOV,NC
      RETC  NTC,GT
      RETC  NTC,GT,NC
      RETC  NTC,GT,NOV
      RETC  NTC,GT,NOV,NC
      RETC  NTC,C
      RETC  NTC,NOV,C
      RETC  NTC,GEQ,C
      RETC  NTC,GEQ,NOV,C
      RETC  NTC,NEQ,C
      RETC  NTC,NEQ,NOV,C
      RETC  NTC,GT,C
      RETC  NTC,GT,NOV,C
      RETC  NTC,OV
      RETC  NTC,OV,NC
      RETC  NTC,GEQ,OV
      RETC  NTC,GEQ,OV,NC
      RETC  NTC,NEQ,OV
      RETC  NTC,NEQ,OV,NC
      RETC  NTC,GT,OV
      RETC  NTC,GT,OV,NC
      RETC  NTC,OV,C
      RETC  NTC,GEQ,OV,C
      RETC  NTC,NEQ,OV,C
      RETC  NTC,GT,OV,C
      RETC  NTC,LT
      RETC  NTC,LT,NC
      RETC  NTC,LT,NOV
      RETC  NTC,LT,NOV,NC
      RETC  NTC,LT,C
      RETC  NTC,LT,NOV,C
      RETC  NTC,LT,OV
      RETC  NTC,LT,OV,NC
      RETC  NTC,LT,OV,C
      RETC  NTC,EQ
      RETC  NTC,EQ,NC
      RETC  NTC,EQ,NOV
      RETC  NTC,EQ,NOV,NC
      RETC  NTC,EQ,C
      RETC  NTC,EQ,NOV,C
      RETC  NTC,EQ,OV
      RETC  NTC,EQ,OV,NC
      RETC  NTC,EQ,OV,C
      RETC  NTC,LEQ
      RETC  NTC,LEQ,NC
      RETC  NTC,LEQ,NOV
      RETC  NTC,LEQ,NOV,NC
      RETC  NTC,LEQ,C
      RETC  NTC,LEQ,NOV,C
      RETC  NTC,LEQ,OV
      RETC  NTC,LEQ,OV,NC
      RETC  NTC,LEQ,OV,C
      RET
      RETC  NC
      RETC  NOV
      RETC  NOV,NC
      RETC  GEQ
      RETC  GEQ,NC
      RETC  GEQ,NOV
      RETC  GEQ,NOV,NC
      RETC  NEQ
      RETC  NEQ,NC
      RETC  NEQ,NOV
      RETC  NEQ,NOV,NC
      RETC  GT
      RETC  GT,NC
      RETC  GT,NOV
      RETC  GT,NOV,NC
      RETC  UNC
      RETC  C
      RETC  NOV,C
      RETC  GEQ,C
      RETC  GEQ,NOV,C
      RETC  NEQ,C
      RETC  NEQ,NOV,C
      RETC  GT,C
      RETC  GT,NOV,C
      RETC  OV
      RETC  OV,NC
      RETC  GEQ,OV
      RETC  GEQ,OV,NC
      RETC  NEQ,OV
      RETC  NEQ,OV,NC
      RETC  GT,OV
      RETC  GT,OV,NC
      RETC  OV,C
      RETC  GEQ,OV,C
      RETC  NEQ,OV,C
      RETC  GT,OV,C
      RETC  LT
      RETC  LT,NC
      RETC  LT,NOV
      RETC  LT,NOV,NC
      RETC  LT,C
      RETC  LT,NOV,C
      RETC  LT,OV
      RETC  LT,OV,NC
      RETC  LT,OV,C
      RETC  EQ
      RETC  EQ,NC
      RETC  EQ,NOV
      RETC  EQ,NOV,NC
      RETC  EQ,C
      RETC  EQ,NOV,C
      RETC  EQ,OV
      RETC  EQ,OV,NC
      RETC  EQ,OV,C
      RETC  LEQ
      RETC  LEQ,NC
      RETC  LEQ,NOV
      RETC  LEQ,NOV,NC
      RETC  LEQ,C
      RETC  LEQ,NOV,C
      RETC  LEQ,OV
      RETC  LEQ,OV,NC
      RETC  LEQ,OV,C
      BCNDD 0F101H, BIO
      BCNDD 0F102H, BIO,NC
      BCNDD 0F103H, BIO,NOV
      BCNDD 0F104H, BIO,NOV,NC
      BCNDD 0F105H, BIO,GEQ
      BCNDD 0F106H, BIO,GEQ,NC
      BCNDD 0F107H, BIO,GEQ,NOV
      BCNDD 0F108H, BIO,GEQ,NOV,NC
      BCNDD 0F109H, BIO,NEQ
      BCNDD 0F10AH, BIO,NEQ,NC
      BCNDD 0F10BH, BIO,NEQ,NOV
      BCNDD 0F10CH, BIO,NEQ,NOV,NC
      BCNDD 0F10DH, BIO,GT
      BCNDD 0F10EH, BIO,GT,NC
      BCNDD 0F10FH, BIO,GT,NOV
      BCNDD 0F110H, BIO,GT,NOV,NC
      BCNDD 0F112H, BIO,C
      BCNDD 0F114H, BIO,NOV,C
      BCNDD 0F116H, BIO,GEQ,C
      BCNDD 0F118H, BIO,GEQ,NOV,C
      BCNDD 0F11AH, BIO,NEQ,C
      BCNDD 0F11CH, BIO,NEQ,NOV,C
      BCNDD 0F11EH, BIO,GT,C
      BCNDD 0F120H, BIO,GT,NOV,C
      BCNDD 0F123H, BIO,OV
      BCNDD 0F124H, BIO,OV,NC
      BCNDD 0F127H, BIO,GEQ,OV
      BCNDD 0F128H, BIO,GEQ,OV,NC
      BCNDD 0F12BH, BIO,NEQ,OV
      BCNDD 0F12CH, BIO,NEQ,OV,NC
      BCNDD 0F12FH, BIO,GT,OV
      BCNDD 0F130H, BIO,GT,OV,NC
      BCNDD 0F134H, BIO,OV,C
      BCNDD 0F138H, BIO,GEQ,OV,C
      BCNDD 0F13CH, BIO,NEQ,OV,C
      BCNDD 0F140H, BIO,GT,OV,C
      BCNDD 0F145H, BIO,LT
      BCNDD 0F146H, BIO,LT,NC
      BCNDD 0F147H, BIO,LT,NOV
      BCNDD 0F148H, BIO,LT,NOV,NC
      BCNDD 0F156H, BIO,LT,C
      BCNDD 0F158H, BIO,LT,NOV,C
      BCNDD 0F167H, BIO,LT,OV
      BCNDD 0F168H, BIO,LT,OV,NC
      BCNDD 0F178H, BIO,LT,OV,C
      BCNDD 0F189H, BIO,EQ
      BCNDD 0F18AH, BIO,EQ,NC
      BCNDD 0F18BH, BIO,EQ,NOV
      BCNDD 0F18CH, BIO,EQ,NOV,NC
      BCNDD 0F19AH, BIO,EQ,C
      BCNDD 0F19CH, BIO,EQ,NOV,C
      BCNDD 0F1ABH, BIO,EQ,OV
      BCNDD 0F1ACH, BIO,EQ,OV,NC
      BCNDD 0F1BCH, BIO,EQ,OV,C
      BCNDD 0F1CDH, BIO,LEQ
      BCNDD 0F1CEH, BIO,LEQ,NC
      BCNDD 0F1CFH, BIO,LEQ,NOV
      BCNDD 0F1D0H, BIO,LEQ,NOV,NC
      BCNDD 0F1DEH, BIO,LEQ,C
      BCNDD 0F1E0H, BIO,LEQ,NOV,C
      BCNDD 0F1EFH, BIO,LEQ,OV
      BCNDD 0F1F0H, BIO,LEQ,OV,NC
      BCNDD 0F200H, BIO,LEQ,OV,C
      BCNDD 0F201H, TC
      BCNDD 0F202H, TC,NC
      BCNDD 0F203H, TC,NOV
      BCNDD 0F204H, TC,NOV,NC
      BCNDD 0F205H, TC,GEQ
      BCNDD 0F206H, TC,GEQ,NC
      BCNDD 0F207H, TC,GEQ,NOV
      BCNDD 0F208H, TC,GEQ,NOV,NC
      BCNDD 0F209H, TC,NEQ
      BCNDD 0F20AH, TC,NEQ,NC
      BCNDD 0F20BH, TC,NEQ,NOV
      BCNDD 0F20CH, TC,NEQ,NOV,NC
      BCNDD 0F20DH, TC,GT
      BCNDD 0F20EH, TC,GT,NC
      BCNDD 0F20FH, TC,GT,NOV
      BCNDD 0F210H, TC,GT,NOV,NC
      BCNDD 0F212H, TC,C
      BCNDD 0F214H, TC,NOV,C
      BCNDD 0F216H, TC,GEQ,C
      BCNDD 0F218H, TC,GEQ,NOV,C
      BCNDD 0F21AH, TC,NEQ,C
      BCNDD 0F21CH, TC,NEQ,NOV,C
      BCNDD 0F21EH, TC,GT,C
      BCNDD 0F220H, TC,GT,NOV,C
      BCNDD 0F223H, TC,OV
      BCNDD 0F224H, TC,OV,NC
      BCNDD 0F227H, TC,GEQ,OV
      BCNDD 0F228H, TC,GEQ,OV,NC
      BCNDD 0F22BH, TC,NEQ,OV
      BCNDD 0F22CH, TC,NEQ,OV,NC
      BCNDD 0F22FH, TC,GT,OV
      BCNDD 0F230H, TC,GT,OV,NC
      BCNDD 0F234H, TC,OV,C
      BCNDD 0F238H, TC,GEQ,OV,C
      BCNDD 0F23CH, TC,NEQ,OV,C
      BCNDD 0F240H, TC,GT,OV,C
      BCNDD 0F245H, TC,LT
      BCNDD 0F246H, TC,LT,NC
      BCNDD 0F247H, TC,LT,NOV
      BCNDD 0F248H, TC,LT,NOV,NC
      BCNDD 0F256H, TC,LT,C
      BCNDD 0F258H, TC,LT,NOV,C
      BCNDD 0F267H, TC,LT,OV
      BCNDD 0F268H, TC,LT,OV,NC
      BCNDD 0F278H, TC,LT,OV,C
      BCNDD 0F289H, TC,EQ
      BCNDD 0F28AH, TC,EQ,NC
      BCNDD 0F28BH, TC,EQ,NOV
      BCNDD 0F28CH, TC,EQ,NOV,NC
      BCNDD 0F29AH, TC,EQ,C
      BCNDD 0F29CH, TC,EQ,NOV,C
      BCNDD 0F2ABH, TC,EQ,OV
      BCNDD 0F2ACH, TC,EQ,OV,NC
      BCNDD 0F2BCH, TC,EQ,OV,C
      BCNDD 0F2CDH, TC,LEQ
      BCNDD 0F2CEH, TC,LEQ,NC
      BCNDD 0F2CFH, TC,LEQ,NOV
      BCNDD 0F2D0H, TC,LEQ,NOV,NC
      BCNDD 0F2DEH, TC,LEQ,C
      BCNDD 0F2E0H, TC,LEQ,NOV,C
      BCNDD 0F2EFH, TC,LEQ,OV
      BCNDD 0F2F0H, TC,LEQ,OV,NC
      BCNDD 0F300H, TC,LEQ,OV,C
      BCNDD 0F301H, NTC
      BCNDD 0F302H, NTC,NC
      BCNDD 0F303H, NTC,NOV
      BCNDD 0F304H, NTC,NOV,NC
      BCNDD 0F305H, NTC,GEQ
      BCNDD 0F306H, NTC,GEQ,NC
      BCNDD 0F307H, NTC,GEQ,NOV
      BCNDD 0F308H, NTC,GEQ,NOV,NC
      BCNDD 0F309H, NTC,NEQ
      BCNDD 0F30AH, NTC,NEQ,NC
      BCNDD 0F30BH, NTC,NEQ,NOV
      BCNDD 0F30CH, NTC,NEQ,NOV,NC
      BCNDD 0F30DH, NTC,GT
      BCNDD 0F30EH, NTC,GT,NC
      BCNDD 0F30FH, NTC,GT,NOV
      BCNDD 0F310H, NTC,GT,NOV,NC
      BCNDD 0F312H, NTC,C
      BCNDD 0F314H, NTC,NOV,C
      BCNDD 0F316H, NTC,GEQ,C
      BCNDD 0F318H, NTC,GEQ,NOV,C
      BCNDD 0F31AH, NTC,NEQ,C
      BCNDD 0F31CH, NTC,NEQ,NOV,C
      BCNDD 0F31EH, NTC,GT,C
      BCNDD 0F320H, NTC,GT,NOV,C
      BCNDD 0F323H, NTC,OV
      BCNDD 0F324H, NTC,OV,NC
      BCNDD 0F327H, NTC,GEQ,OV
      BCNDD 0F328H, NTC,GEQ,OV,NC
      BCNDD 0F32BH, NTC,NEQ,OV
      BCNDD 0F32CH, NTC,NEQ,OV,NC
      BCNDD 0F32FH, NTC,GT,OV
      BCNDD 0F330H, NTC,GT,OV,NC
      BCNDD 0F334H, NTC,OV,C
      BCNDD 0F338H, NTC,GEQ,OV,C
      BCNDD 0F33CH, NTC,NEQ,OV,C
      BCNDD 0F340H, NTC,GT,OV,C
      BCNDD 0F345H, NTC,LT
      BCNDD 0F346H, NTC,LT,NC
      BCNDD 0F347H, NTC,LT,NOV
      BCNDD 0F348H, NTC,LT,NOV,NC
      BCNDD 0F356H, NTC,LT,C
      BCNDD 0F358H, NTC,LT,NOV,C
      BCNDD 0F367H, NTC,LT,OV
      BCNDD 0F368H, NTC,LT,OV,NC
      BCNDD 0F378H, NTC,LT,OV,C
      BCNDD 0F389H, NTC,EQ
      BCNDD 0F38AH, NTC,EQ,NC
      BCNDD 0F38BH, NTC,EQ,NOV
      BCNDD 0F38CH, NTC,EQ,NOV,NC
      BCNDD 0F39AH, NTC,EQ,C
      BCNDD 0F39CH, NTC,EQ,NOV,C
      BCNDD 0F3ABH, NTC,EQ,OV
      BCNDD 0F3ACH, NTC,EQ,OV,NC
      BCNDD 0F3BCH, NTC,EQ,OV,C
      BCNDD 0F3CDH, NTC,LEQ
      BCNDD 0F3CEH, NTC,LEQ,NC
      BCNDD 0F3CFH, NTC,LEQ,NOV
      BCNDD 0F3D0H, NTC,LEQ,NOV,NC
      BCNDD 0F3DEH, NTC,LEQ,C
      BCNDD 0F3E0H, NTC,LEQ,NOV,C
      BCNDD 0F3EFH, NTC,LEQ,OV
      BCNDD 0F3F0H, NTC,LEQ,OV,NC
      BCNDD 0F400H, NTC,LEQ,OV,C
      BCNDD 0F401H, UNC
      BCNDD 0F402H, NC
      BCNDD 0F403H, NOV
      BCNDD 0F404H, NOV,NC
      BCNDD 0F405H, GEQ
      BCNDD 0F406H, GEQ,NC
      BCNDD 0F407H, GEQ,NOV
      BCNDD 0F408H, GEQ,NOV,NC
      BCNDD 0F409H, NEQ
      BCNDD 0F40AH, NEQ,NC
      BCNDD 0F40BH, NEQ,NOV
      BCNDD 0F40CH, NEQ,NOV,NC
      BCNDD 0F40DH, GT
      BCNDD 0F40EH, GT,NC
      BCNDD 0F40FH, GT,NOV
      BCNDD 0F410H, GT,NOV,NC
      BCNDD 0F412H, C
      BCNDD 0F414H, NOV,C
      BCNDD 0F416H, GEQ,C
      BCNDD 0F418H, GEQ,NOV,C
      BCNDD 0F41AH, NEQ,C
      BCNDD 0F41CH, NEQ,NOV,C
      BCNDD 0F41EH, GT,C
      BCNDD 0F420H, GT,NOV,C
      BCNDD 0F423H, OV
      BCNDD 0F424H, OV,NC
      BCNDD 0F427H, GEQ,OV
      BCNDD 0F428H, GEQ,OV,NC
      BCNDD 0F42BH, NEQ,OV
      BCNDD 0F42CH, NEQ,OV,NC
      BCNDD 0F42FH, GT,OV
      BCNDD 0F430H, GT,OV,NC
      BCNDD 0F434H, OV,C
      BCNDD 0F438H, GEQ,OV,C
      BCNDD 0F43CH, NEQ,OV,C
      BCNDD 0F440H, GT,OV,C
      BCNDD 0F445H, LT
      BCNDD 0F446H, LT,NC
      BCNDD 0F447H, LT,NOV
      BCNDD 0F448H, LT,NOV,NC
      BCNDD 0F456H, LT,C
      BCNDD 0F458H, LT,NOV,C
      BCNDD 0F467H, LT,OV
      BCNDD 0F468H, LT,OV,NC
      BCNDD 0F478H, LT,OV,C
      BCNDD 0F489H, EQ
      BCNDD 0F48AH, EQ,NC
      BCNDD 0F48BH, EQ,NOV
      BCNDD 0F48CH, EQ,NOV,NC
      BCNDD 0F49AH, EQ,C
      BCNDD 0F49CH, EQ,NOV,C
      BCNDD 0F4ABH, EQ,OV
      BCNDD 0F4ACH, EQ,OV,NC
      BCNDD 0F4BCH, EQ,OV,C
      BCNDD 0F4CDH, LEQ
      BCNDD 0F4CEH, LEQ,NC
      BCNDD 0F4CFH, LEQ,NOV
      BCNDD 0F4D0H, LEQ,NOV,NC
      BCNDD 0F4DEH, LEQ,C
      BCNDD 0F4E0H, LEQ,NOV,C
      BCNDD 0F4EFH, LEQ,OV
      BCNDD 0F4F0H, LEQ,OV,NC
      BCNDD 0F500H, LEQ,OV,C
      CCD   0F901H, BIO
      CCD   0F902H, BIO,NC
      CCD   0F903H, BIO,NOV
      CCD   0F904H, BIO,NOV,NC
      CCD   0F905H, BIO,GEQ
      CCD   0F906H, BIO,GEQ,NC
      CCD   0F907H, BIO,GEQ,NOV
      CCD   0F908H, BIO,GEQ,NOV,NC
      CCD   0F909H, BIO,NEQ
      CCD   0F90AH, BIO,NEQ,NC
      CCD   0F90BH, BIO,NEQ,NOV
      CCD   0F90CH, BIO,NEQ,NOV,NC
      CCD   0F90DH, BIO,GT
      CCD   0F90EH, BIO,GT,NC
      CCD   0F90FH, BIO,GT,NOV
      CCD   0F910H, BIO,GT,NOV,NC
      CCD   0F912H, BIO,C
      CCD   0F914H, BIO,NOV,C
      CCD   0F916H, BIO,GEQ,C
      CCD   0F918H, BIO,GEQ,NOV,C
      CCD   0F91AH, BIO,NEQ,C
      CCD   0F91CH, BIO,NEQ,NOV,C
      CCD   0F91EH, BIO,GT,C
      CCD   0F920H, BIO,GT,NOV,C
      CCD   0F923H, BIO,OV
      CCD   0F924H, BIO,OV,NC
      CCD   0F927H, BIO,GEQ,OV
      CCD   0F928H, BIO,GEQ,OV,NC
      CCD   0F92BH, BIO,NEQ,OV
      CCD   0F92CH, BIO,NEQ,OV,NC
      CCD   0F92FH, BIO,GT,OV
      CCD   0F930H, BIO,GT,OV,NC
      CCD   0F934H, BIO,OV,C
      CCD   0F938H, BIO,GEQ,OV,C
      CCD   0F93CH, BIO,NEQ,OV,C
      CCD   0F940H, BIO,GT,OV,C
      CCD   0F945H, BIO,LT
      CCD   0F946H, BIO,LT,NC
      CCD   0F947H, BIO,LT,NOV
      CCD   0F948H, BIO,LT,NOV,NC
      CCD   0F956H, BIO,LT,C
      CCD   0F958H, BIO,LT,NOV,C
      CCD   0F967H, BIO,LT,OV
      CCD   0F968H, BIO,LT,OV,NC
      CCD   0F978H, BIO,LT,OV,C
      CCD   0F989H, BIO,EQ
      CCD   0F98AH, BIO,EQ,NC
      CCD   0F98BH, BIO,EQ,NOV
      CCD   0F98CH, BIO,EQ,NOV,NC
      CCD   0F99AH, BIO,EQ,C
      CCD   0F99CH, BIO,EQ,NOV,C
      CCD   0F9ABH, BIO,EQ,OV
      CCD   0F9ACH, BIO,EQ,OV,NC
      CCD   0F9BCH, BIO,EQ,OV,C
      CCD   0F9CDH, BIO,LEQ
      CCD   0F9CEH, BIO,LEQ,NC
      CCD   0F9CFH, BIO,LEQ,NOV
      CCD   0F9D0H, BIO,LEQ,NOV,NC
      CCD   0F9DEH, BIO,LEQ,C
      CCD   0F9E0H, BIO,LEQ,NOV,C
      CCD   0F9EFH, BIO,LEQ,OV
      CCD   0F9F0H, BIO,LEQ,OV,NC
      CCD   0FA00H, BIO,LEQ,OV,C
      CCD   0FA01H, TC
      CCD   0FA02H, TC,NC
      CCD   0FA03H, TC,NOV
      CCD   0FA04H, TC,NOV,NC
      CCD   0FA05H, TC,GEQ
      CCD   0FA06H, TC,GEQ,NC
      CCD   0FA07H, TC,GEQ,NOV
      CCD   0FA08H, TC,GEQ,NOV,NC
      CCD   0FA09H, TC,NEQ
      CCD   0FA0AH, TC,NEQ,NC
      CCD   0FA0BH, TC,NEQ,NOV
      CCD   0FA0CH, TC,NEQ,NOV,NC
      CCD   0FA0DH, TC,GT
      CCD   0FA0EH, TC,GT,NC
      CCD   0FA0FH, TC,GT,NOV
      CCD   0FA10H, TC,GT,NOV,NC
      CCD   0FA12H, TC,C
      CCD   0FA14H, TC,NOV,C
      CCD   0FA16H, TC,GEQ,C
      CCD   0FA18H, TC,GEQ,NOV,C
      CCD   0FA1AH, TC,NEQ,C
      CCD   0FA1CH, TC,NEQ,NOV,C
      CCD   0FA1EH, TC,GT,C
      CCD   0FA20H, TC,GT,NOV,C
      CCD   0FA23H, TC,OV
      CCD   0FA24H, TC,OV,NC
      CCD   0FA27H, TC,GEQ,OV
      CCD   0FA28H, TC,GEQ,OV,NC
      CCD   0FA2BH, TC,NEQ,OV
      CCD   0FA2CH, TC,NEQ,OV,NC
      CCD   0FA2FH, TC,GT,OV
      CCD   0FA30H, TC,GT,OV,NC
      CCD   0FA34H, TC,OV,C
      CCD   0FA38H, TC,GEQ,OV,C
      CCD   0FA3CH, TC,NEQ,OV,C
      CCD   0FA40H, TC,GT,OV,C
      CCD   0FA45H, TC,LT
      CCD   0FA46H, TC,LT,NC
      CCD   0FA47H, TC,LT,NOV
      CCD   0FA48H, TC,LT,NOV,NC
      CCD   0FA56H, TC,LT,C
      CCD   0FA58H, TC,LT,NOV,C
      CCD   0FA67H, TC,LT,OV
      CCD   0FA68H, TC,LT,OV,NC
      CCD   0FA78H, TC,LT,OV,C
      CCD   0FA89H, TC,EQ
      CCD   0FA8AH, TC,EQ,NC
      CCD   0FA8BH, TC,EQ,NOV
      CCD   0FA8CH, TC,EQ,NOV,NC
      CCD   0FA9AH, TC,EQ,C
      CCD   0FA9CH, TC,EQ,NOV,C
      CCD   0FAABH, TC,EQ,OV
      CCD   0FAACH, TC,EQ,OV,NC
      CCD   0FABCH, TC,EQ,OV,C
      CCD   0FACDH, TC,LEQ
      CCD   0FACEH, TC,LEQ,NC
      CCD   0FACFH, TC,LEQ,NOV
      CCD   0FAD0H, TC,LEQ,NOV,NC
      CCD   0FADEH, TC,LEQ,C
      CCD   0FAE0H, TC,LEQ,NOV,C
      CCD   0FAEFH, TC,LEQ,OV
      CCD   0FAF0H, TC,LEQ,OV,NC
      CCD   0FB00H, TC,LEQ,OV,C
      CCD   0FB01H, NTC
      CCD   0FB02H, NTC,NC
      CCD   0FB03H, NTC,NOV
      CCD   0FB04H, NTC,NOV,NC
      CCD   0FB05H, NTC,GEQ
      CCD   0FB06H, NTC,GEQ,NC
      CCD   0FB07H, NTC,GEQ,NOV
      CCD   0FB08H, NTC,GEQ,NOV,NC
      CCD   0FB09H, NTC,NEQ
      CCD   0FB0AH, NTC,NEQ,NC
      CCD   0FB0BH, NTC,NEQ,NOV
      CCD   0FB0CH, NTC,NEQ,NOV,NC
      CCD   0FB0DH, NTC,GT
      CCD   0FB0EH, NTC,GT,NC
      CCD   0FB0FH, NTC,GT,NOV
      CCD   0FB10H, NTC,GT,NOV,NC
      CCD   0FB12H, NTC,C
      CCD   0FB14H, NTC,NOV,C
      CCD   0FB16H, NTC,GEQ,C
      CCD   0FB18H, NTC,GEQ,NOV,C
      CCD   0FB1AH, NTC,NEQ,C
      CCD   0FB1CH, NTC,NEQ,NOV,C
      CCD   0FB1EH, NTC,GT,C
      CCD   0FB20H, NTC,GT,NOV,C
      CCD   0FB23H, NTC,OV
      CCD   0FB24H, NTC,OV,NC
      CCD   0FB27H, NTC,GEQ,OV
      CCD   0FB28H, NTC,GEQ,OV,NC
      CCD   0FB2BH, NTC,NEQ,OV
      CCD   0FB2CH, NTC,NEQ,OV,NC
      CCD   0FB2FH, NTC,GT,OV
      CCD   0FB30H, NTC,GT,OV,NC
      CCD   0FB34H, NTC,OV,C
      CCD   0FB38H, NTC,GEQ,OV,C
      CCD   0FB3CH, NTC,NEQ,OV,C
      CCD   0FB40H, NTC,GT,OV,C
      CCD   0FB45H, NTC,LT
      CCD   0FB46H, NTC,LT,NC
      CCD   0FB47H, NTC,LT,NOV
      CCD   0FB48H, NTC,LT,NOV,NC
      CCD   0FB56H, NTC,LT,C
      CCD   0FB58H, NTC,LT,NOV,C
      CCD   0FB67H, NTC,LT,OV
      CCD   0FB68H, NTC,LT,OV,NC
      CCD   0FB78H, NTC,LT,OV,C
      CCD   0FB89H, NTC,EQ
      CCD   0FB8AH, NTC,EQ,NC
      CCD   0FB8BH, NTC,EQ,NOV
      CCD   0FB8CH, NTC,EQ,NOV,NC
      CCD   0FB9AH, NTC,EQ,C
      CCD   0FB9CH, NTC,EQ,NOV,C
      CCD   0FBABH, NTC,EQ,OV
      CCD   0FBACH, NTC,EQ,OV,NC
      CCD   0FBBCH, NTC,EQ,OV,C
      CCD   0FBCDH, NTC,LEQ
      CCD   0FBCEH, NTC,LEQ,NC
      CCD   0FBCFH, NTC,LEQ,NOV
      CCD   0FBD0H, NTC,LEQ,NOV,NC
      CCD   0FBDEH, NTC,LEQ,C
      CCD   0FBE0H, NTC,LEQ,NOV,C
      CCD   0FBEFH, NTC,LEQ,OV
      CCD   0FBF0H, NTC,LEQ,OV,NC
      CCD   0FC00H, NTC,LEQ,OV,C
      CCD   0FC01H, UNC
      CCD   0FC02H, NC
      CCD   0FC03H, NOV
      CCD   0FC04H, NOV,NC
      CCD   0FC05H, GEQ
      CCD   0FC06H, GEQ,NC
      CCD   0FC07H, GEQ,NOV
      CCD   0FC08H, GEQ,NOV,NC
      CCD   0FC09H, NEQ
      CCD   0FC0AH, NEQ,NC
      CCD   0FC0BH, NEQ,NOV
      CCD   0FC0CH, NEQ,NOV,NC
      CCD   0FC0DH, GT
      CCD   0FC0EH, GT,NC
      CCD   0FC0FH, GT,NOV
      CCD   0FC10H, GT,NOV,NC
      CCD   0FC12H, C
      CCD   0FC14H, NOV,C
      CCD   0FC16H, GEQ,C
      CCD   0FC18H, GEQ,NOV,C
      CCD   0FC1AH, NEQ,C
      CCD   0FC1CH, NEQ,NOV,C
      CCD   0FC1EH, GT,C
      CCD   0FC20H, GT,NOV,C
      CCD   0FC23H, OV
      CCD   0FC24H, OV,NC
      CCD   0FC27H, GEQ,OV
      CCD   0FC28H, GEQ,OV,NC
      CCD   0FC2BH, NEQ,OV
      CCD   0FC2CH, NEQ,OV,NC
      CCD   0FC2FH, GT,OV
      CCD   0FC30H, GT,OV,NC
      CCD   0FC34H, OV,C
      CCD   0FC38H, GEQ,OV,C
      CCD   0FC3CH, NEQ,OV,C
      CCD   0FC40H, GT,OV,C
      CCD   0FC45H, LT
      CCD   0FC46H, LT,NC
      CCD   0FC47H, LT,NOV
      CCD   0FC48H, LT,NOV,NC
      CCD   0FC56H, LT,C
      CCD   0FC58H, LT,NOV,C
      CCD   0FC67H, LT,OV
      CCD   0FC68H, LT,OV,NC
      CCD   0FC78H, LT,OV,C
      CCD   0FC89H, EQ
      CCD   0FC8AH, EQ,NC
      CCD   0FC8BH, EQ,NOV
      CCD   0FC8CH, EQ,NOV,NC
      CCD   0FC9AH, EQ,C
      CCD   0FC9CH, EQ,NOV,C
      CCD   0FCABH, EQ,OV
      CCD   0FCACH, EQ,OV,NC
      CCD   0FCBCH, EQ,OV,C
      CCD   0FCCDH, LEQ
      CCD   0FCCEH, LEQ,NC
      CCD   0FCCFH, LEQ,NOV
      CCD   0FCD0H, LEQ,NOV,NC
      CCD   0FCDEH, LEQ,C
      CCD   0FCE0H, LEQ,NOV,C
      CCD   0FCEFH, LEQ,OV
      CCD   0FCF0H, LEQ,OV,NC
      CCD   0FD00H, LEQ,OV,C
      RETCD BIO
      RETCD BIO,NC
      RETCD BIO,NOV
      RETCD BIO,NOV,NC
      RETCD BIO,GEQ
      RETCD BIO,GEQ,NC
      RETCD BIO,GEQ,NOV
      RETCD BIO,GEQ,NOV,NC
      RETCD BIO,NEQ
      RETCD BIO,NEQ,NC
      RETCD BIO,NEQ,NOV
      RETCD BIO,NEQ,NOV,NC
      RETCD BIO,GT
      RETCD BIO,GT,NC
      RETCD BIO,GT,NOV
      RETCD BIO,GT,NOV,NC
      RETCD BIO,C
      RETCD BIO,NOV,C
      RETCD BIO,GEQ,C
      RETCD BIO,GEQ,NOV,C
      RETCD BIO,NEQ,C
      RETCD BIO,NEQ,NOV,C
      RETCD BIO,GT,C
      RETCD BIO,GT,NOV,C
      RETCD BIO,OV
      RETCD BIO,OV,NC
      RETCD BIO,GEQ,OV
      RETCD BIO,GEQ,OV,NC
      RETCD BIO,NEQ,OV
      RETCD BIO,NEQ,OV,NC
      RETCD BIO,GT,OV
      RETCD BIO,GT,OV,NC
      RETCD BIO,OV,C
      RETCD BIO,GEQ,OV,C
      RETCD BIO,NEQ,OV,C
      RETCD BIO,GT,OV,C
      RETCD BIO,LT
      RETCD BIO,LT,NC
      RETCD BIO,LT,NOV
      RETCD BIO,LT,NOV,NC
      RETCD BIO,LT,C
      RETCD BIO,LT,NOV,C
      RETCD BIO,LT,OV
      RETCD BIO,LT,OV,NC
      RETCD BIO,LT,OV,C
      RETCD BIO,EQ
      RETCD BIO,EQ,NC
      RETCD BIO,EQ,NOV
      RETCD BIO,EQ,NOV,NC
      RETCD BIO,EQ,C
      RETCD BIO,EQ,NOV,C
      RETCD BIO,EQ,OV
      RETCD BIO,EQ,OV,NC
      RETCD BIO,EQ,OV,C
      RETCD BIO,LEQ
      RETCD BIO,LEQ,NC
      RETCD BIO,LEQ,NOV
      RETCD BIO,LEQ,NOV,NC
      RETCD BIO,LEQ,C
      RETCD BIO,LEQ,NOV,C
      RETCD BIO,LEQ,OV
      RETCD BIO,LEQ,OV,NC
      RETCD BIO,LEQ,OV,C
      RETCD TC
      RETCD TC,NC
      RETCD TC,NOV
      RETCD TC,NOV,NC
      RETCD TC,GEQ
      RETCD TC,GEQ,NC
      RETCD TC,GEQ,NOV
      RETCD TC,GEQ,NOV,NC
      RETCD TC,NEQ
      RETCD TC,NEQ,NC
      RETCD TC,NEQ,NOV
      RETCD TC,NEQ,NOV,NC
      RETCD TC,GT
      RETCD TC,GT,NC
      RETCD TC,GT,NOV
      RETCD TC,GT,NOV,NC
      RETCD TC,C
      RETCD TC,NOV,C
      RETCD TC,GEQ,C
      RETCD TC,GEQ,NOV,C
      RETCD TC,NEQ,C
      RETCD TC,NEQ,NOV,C
      RETCD TC,GT,C
      RETCD TC,GT,NOV,C
      RETCD TC,OV
      RETCD TC,OV,NC
      RETCD TC,GEQ,OV
      RETCD TC,GEQ,OV,NC
      RETCD TC,NEQ,OV
      RETCD TC,NEQ,OV,NC
      RETCD TC,GT,OV
      RETCD TC,GT,OV,NC
      RETCD TC,OV,C
      RETCD TC,GEQ,OV,C
      RETCD TC,NEQ,OV,C
      RETCD TC,GT,OV,C
      RETCD TC,LT
      RETCD TC,LT,NC
      RETCD TC,LT,NOV
      RETCD TC,LT,NOV,NC
      RETCD TC,LT,C
      RETCD TC,LT,NOV,C
      RETCD TC,LT,OV
      RETCD TC,LT,OV,NC
      RETCD TC,LT,OV,C
      RETCD TC,EQ
      RETCD TC,EQ,NC
      RETCD TC,EQ,NOV
      RETCD TC,EQ,NOV,NC
      RETCD TC,EQ,C
      RETCD TC,EQ,NOV,C
      RETCD TC,EQ,OV
      RETCD TC,EQ,OV,NC
      RETCD TC,EQ,OV,C
      RETCD TC,LEQ
      RETCD TC,LEQ,NC
      RETCD TC,LEQ,NOV
      RETCD TC,LEQ,NOV,NC
      RETCD TC,LEQ,C
      RETCD TC,LEQ,NOV,C
      RETCD TC,LEQ,OV
      RETCD TC,LEQ,OV,NC
      RETCD TC,LEQ,OV,C
      RETCD NTC
      RETCD NTC,NC
      RETCD NTC,NOV
      RETCD NTC,NOV,NC
      RETCD NTC,GEQ
      RETCD NTC,GEQ,NC
      RETCD NTC,GEQ,NOV
      RETCD NTC,GEQ,NOV,NC
      RETCD NTC,NEQ
      RETCD NTC,NEQ,NC
      RETCD NTC,NEQ,NOV
      RETCD NTC,NEQ,NOV,NC
      RETCD NTC,GT
      RETCD NTC,GT,NC
      RETCD NTC,GT,NOV
      RETCD NTC,GT,NOV,NC
      RETCD NTC,C
      RETCD NTC,NOV,C
      RETCD NTC,GEQ,C
      RETCD NTC,GEQ,NOV,C
      RETCD NTC,NEQ,C
      RETCD NTC,NEQ,NOV,C
      RETCD NTC,GT,C
      RETCD NTC,GT,NOV,C
      RETCD NTC,OV
      RETCD NTC,OV,NC
      RETCD NTC,GEQ,OV
      RETCD NTC,GEQ,OV,NC
      RETCD NTC,NEQ,OV
      RETCD NTC,NEQ,OV,NC
      RETCD NTC,GT,OV
      RETCD NTC,GT,OV,NC
      RETCD NTC,OV,C
      RETCD NTC,GEQ,OV,C
      RETCD NTC,NEQ,OV,C
      RETCD NTC,GT,OV,C
      RETCD NTC,LT
      RETCD NTC,LT,NC
      RETCD NTC,LT,NOV
      RETCD NTC,LT,NOV,NC
      RETCD NTC,LT,C
      RETCD NTC,LT,NOV,C
      RETCD NTC,LT,OV
      RETCD NTC,LT,OV,NC
      RETCD NTC,LT,OV,C
      RETCD NTC,EQ
      RETCD NTC,EQ,NC
      RETCD NTC,EQ,NOV
      RETCD NTC,EQ,NOV,NC
      RETCD NTC,EQ,C
      RETCD NTC,EQ,NOV,C
      RETCD NTC,EQ,OV
      RETCD NTC,EQ,OV,NC
      RETCD NTC,EQ,OV,C
      RETCD NTC,LEQ
      RETCD NTC,LEQ,NC
      RETCD NTC,LEQ,NOV
      RETCD NTC,LEQ,NOV,NC
      RETCD NTC,LEQ,C
      RETCD NTC,LEQ,NOV,C
      RETCD NTC,LEQ,OV
      RETCD NTC,LEQ,OV,NC
      RETCD NTC,LEQ,OV,C
      RETD
      RETCD NC
      RETCD NOV
      RETCD NOV,NC
      RETCD GEQ
      RETCD GEQ,NC
      RETCD GEQ,NOV
      RETCD GEQ,NOV,NC
      RETCD NEQ
      RETCD NEQ,NC
      RETCD NEQ,NOV
      RETCD NEQ,NOV,NC
      RETCD GT
      RETCD GT,NC
      RETCD GT,NOV
      RETCD GT,NOV,NC
      RETCD UNC
      RETCD C
      RETCD NOV,C
      RETCD GEQ,C
      RETCD GEQ,NOV,C
      RETCD NEQ,C
      RETCD NEQ,NOV,C
      RETCD GT,C
      RETCD GT,NOV,C
      RETCD OV
      RETCD OV,NC
      RETCD GEQ,OV
      RETCD GEQ,OV,NC
      RETCD NEQ,OV
      RETCD NEQ,OV,NC
      RETCD GT,OV
      RETCD GT,OV,NC
      RETCD OV,C
      RETCD GEQ,OV,C
      RETCD NEQ,OV,C
      RETCD GT,OV,C
      RETCD LT
      RETCD LT,NC
      RETCD LT,NOV
      RETCD LT,NOV,NC
      RETCD LT,C
      RETCD LT,NOV,C
      RETCD LT,OV
      RETCD LT,OV,NC
      RETCD LT,OV,C
      RETCD EQ
      RETCD EQ,NC
      RETCD EQ,NOV
      RETCD EQ,NOV,NC
      RETCD EQ,C
      RETCD EQ,NOV,C
      RETCD EQ,OV
      RETCD EQ,OV,NC
      RETCD EQ,OV,C
      RETCD LEQ
      RETCD LEQ,NC
      RETCD LEQ,NOV
      RETCD LEQ,NOV,NC
      RETCD LEQ,C
      RETCD LEQ,NOV,C
      RETCD LEQ,OV
      RETCD LEQ,OV,NC
      RETCD LEQ,OV,C
