;;; AUTO GENERATED FILE
;;; generated by: gen_mn1610 -i -u -C MN1610 -o gen_mn1610.inc -l gen_mn1610.lst
      MVI  R0, 0
      MVI  SP, 0
      MVI  STR, 0
      WT   R0, 0x00
      WT   SP, 0x00
      WT   STR, 0x00
      RD   R0, 0x00
      RD   SP, 0x00
      RD   STR, 0x00
      H
      PUSH R0
      POP  R0
      RET
      LPSW 0
      SR   R0
      SR   R0, RE
      SR   R0, SE
      SR   R0, CE
      SL   R0
      SL   R0, RE
      SL   R0, SE
      SL   R0, CE
      SR   R0, SKP
      SR   R0, RE, SKP
      SR   R0, SE, SKP
      SR   R0, CE, SKP
      SL   R0, SKP
      SL   R0, RE, SKP
      SL   R0, SE, SKP
      SL   R0, CE, SKP
      SR   R0, M
      SR   R0, RE, M
      SR   R0, SE, M
      SR   R0, CE, M
      SL   R0, M
      SL   R0, RE, M
      SL   R0, SE, M
      SL   R0, CE, M
      SR   R0, PZ
      SR   R0, RE, PZ
      SR   R0, SE, PZ
      SR   R0, CE, PZ
      SL   R0, PZ
      SL   R0, RE, PZ
      SL   R0, SE, PZ
      SL   R0, CE, PZ
      SR   R0, Z
      SR   R0, RE, Z
      SR   R0, SE, Z
      SR   R0, CE, Z
      SL   R0, Z
      SL   R0, RE, Z
      SL   R0, SE, Z
      SL   R0, CE, Z
      SR   R0, NZ
      SR   R0, RE, NZ
      SR   R0, SE, NZ
      SR   R0, CE, NZ
      SL   R0, NZ
      SL   R0, RE, NZ
      SL   R0, SE, NZ
      SL   R0, CE, NZ
      SR   R0, MZ
      SR   R0, RE, MZ
      SR   R0, SE, MZ
      SR   R0, CE, MZ
      SL   R0, MZ
      SL   R0, RE, MZ
      SL   R0, SE, MZ
      SL   R0, CE, MZ
      SR   R0, P
      SR   R0, RE, P
      SR   R0, SE, P
      SR   R0, CE, P
      SL   R0, P
      SL   R0, RE, P
      SL   R0, SE, P
      SL   R0, CE, P
      SR   R0, EZ
      SR   R0, RE, EZ
      SR   R0, SE, EZ
      SR   R0, CE, EZ
      SL   R0, EZ
      SL   R0, RE, EZ
      SL   R0, SE, EZ
      SL   R0, CE, EZ
      SR   R0, ENZ
      SR   R0, RE, ENZ
      SR   R0, SE, ENZ
      SR   R0, CE, ENZ
      SL   R0, ENZ
      SL   R0, RE, ENZ
      SL   R0, SE, ENZ
      SL   R0, CE, ENZ
      SR   R0, OZ
      SR   R0, RE, OZ
      SR   R0, SE, OZ
      SR   R0, CE, OZ
      SL   R0, OZ
      SL   R0, RE, OZ
      SL   R0, SE, OZ
      SL   R0, CE, OZ
      SR   R0, ONZ
      SR   R0, RE, ONZ
      SR   R0, SE, ONZ
      SR   R0, CE, ONZ
      SL   R0, ONZ
      SL   R0, RE, ONZ
      SL   R0, SE, ONZ
      SL   R0, CE, ONZ
      SR   R0, LMZ
      SR   R0, RE, LMZ
      SR   R0, SE, LMZ
      SR   R0, CE, LMZ
      SL   R0, LMZ
      SL   R0, RE, LMZ
      SL   R0, SE, LMZ
      SL   R0, CE, LMZ
      SR   R0, LP
      SR   R0, RE, LP
      SR   R0, SE, LP
      SR   R0, CE, LP
      SL   R0, LP
      SL   R0, RE, LP
      SL   R0, SE, LP
      SL   R0, CE, LP
      SR   R0, LPZ
      SR   R0, RE, LPZ
      SR   R0, SE, LPZ
      SR   R0, CE, LPZ
      SL   R0, LPZ
      SL   R0, RE, LPZ
      SL   R0, SE, LPZ
      SL   R0, CE, LPZ
      SR   R0, LM
      SR   R0, RE, LM
      SR   R0, SE, LM
      SR   R0, CE, LM
      SL   R0, LM
      SL   R0, RE, LM
      SL   R0, SE, LM
      SL   R0, CE, LM
      PUSH SP
      POP  SP
      SR   SP
      SR   SP, RE
      SR   SP, SE
      SR   SP, CE
      SL   SP
      SL   SP, RE
      SL   SP, SE
      SL   SP, CE
      SR   SP, SKP
      SR   SP, RE, SKP
      SR   SP, SE, SKP
      SR   SP, CE, SKP
      SL   SP, SKP
      SL   SP, RE, SKP
      SL   SP, SE, SKP
      SL   SP, CE, SKP
      SR   SP, M
      SR   SP, RE, M
      SR   SP, SE, M
      SR   SP, CE, M
      SL   SP, M
      SL   SP, RE, M
      SL   SP, SE, M
      SL   SP, CE, M
      SR   SP, PZ
      SR   SP, RE, PZ
      SR   SP, SE, PZ
      SR   SP, CE, PZ
      SL   SP, PZ
      SL   SP, RE, PZ
      SL   SP, SE, PZ
      SL   SP, CE, PZ
      SR   SP, Z
      SR   SP, RE, Z
      SR   SP, SE, Z
      SR   SP, CE, Z
      SL   SP, Z
      SL   SP, RE, Z
      SL   SP, SE, Z
      SL   SP, CE, Z
      SR   SP, NZ
      SR   SP, RE, NZ
      SR   SP, SE, NZ
      SR   SP, CE, NZ
      SL   SP, NZ
      SL   SP, RE, NZ
      SL   SP, SE, NZ
      SL   SP, CE, NZ
      SR   SP, MZ
      SR   SP, RE, MZ
      SR   SP, SE, MZ
      SR   SP, CE, MZ
      SL   SP, MZ
      SL   SP, RE, MZ
      SL   SP, SE, MZ
      SL   SP, CE, MZ
      SR   SP, P
      SR   SP, RE, P
      SR   SP, SE, P
      SR   SP, CE, P
      SL   SP, P
      SL   SP, RE, P
      SL   SP, SE, P
      SL   SP, CE, P
      SR   SP, EZ
      SR   SP, RE, EZ
      SR   SP, SE, EZ
      SR   SP, CE, EZ
      SL   SP, EZ
      SL   SP, RE, EZ
      SL   SP, SE, EZ
      SL   SP, CE, EZ
      SR   SP, ENZ
      SR   SP, RE, ENZ
      SR   SP, SE, ENZ
      SR   SP, CE, ENZ
      SL   SP, ENZ
      SL   SP, RE, ENZ
      SL   SP, SE, ENZ
      SL   SP, CE, ENZ
      SR   SP, OZ
      SR   SP, RE, OZ
      SR   SP, SE, OZ
      SR   SP, CE, OZ
      SL   SP, OZ
      SL   SP, RE, OZ
      SL   SP, SE, OZ
      SL   SP, CE, OZ
      SR   SP, ONZ
      SR   SP, RE, ONZ
      SR   SP, SE, ONZ
      SR   SP, CE, ONZ
      SL   SP, ONZ
      SL   SP, RE, ONZ
      SL   SP, SE, ONZ
      SL   SP, CE, ONZ
      SR   SP, LMZ
      SR   SP, RE, LMZ
      SR   SP, SE, LMZ
      SR   SP, CE, LMZ
      SL   SP, LMZ
      SL   SP, RE, LMZ
      SL   SP, SE, LMZ
      SL   SP, CE, LMZ
      SR   SP, LP
      SR   SP, RE, LP
      SR   SP, SE, LP
      SR   SP, CE, LP
      SL   SP, LP
      SL   SP, RE, LP
      SL   SP, SE, LP
      SL   SP, CE, LP
      SR   SP, LPZ
      SR   SP, RE, LPZ
      SR   SP, SE, LPZ
      SR   SP, CE, LPZ
      SL   SP, LPZ
      SL   SP, RE, LPZ
      SL   SP, SE, LPZ
      SL   SP, CE, LPZ
      SR   SP, LM
      SR   SP, RE, LM
      SR   SP, SE, LM
      SR   SP, CE, LM
      SL   SP, LM
      SL   SP, RE, LM
      SL   SP, SE, LM
      SL   SP, CE, LM
      PUSH STR
      POP  STR
      SR   STR
      SR   STR, RE
      SR   STR, SE
      SR   STR, CE
      SL   STR
      SL   STR, RE
      SL   STR, SE
      SL   STR, CE
      SR   STR, SKP
      SR   STR, RE, SKP
      SR   STR, SE, SKP
      SR   STR, CE, SKP
      SL   STR, SKP
      SL   STR, RE, SKP
      SL   STR, SE, SKP
      SL   STR, CE, SKP
      SR   STR, M
      SR   STR, RE, M
      SR   STR, SE, M
      SR   STR, CE, M
      SL   STR, M
      SL   STR, RE, M
      SL   STR, SE, M
      SL   STR, CE, M
      SR   STR, PZ
      SR   STR, RE, PZ
      SR   STR, SE, PZ
      SR   STR, CE, PZ
      SL   STR, PZ
      SL   STR, RE, PZ
      SL   STR, SE, PZ
      SL   STR, CE, PZ
      SR   STR, Z
      SR   STR, RE, Z
      SR   STR, SE, Z
      SR   STR, CE, Z
      SL   STR, Z
      SL   STR, RE, Z
      SL   STR, SE, Z
      SL   STR, CE, Z
      SR   STR, NZ
      SR   STR, RE, NZ
      SR   STR, SE, NZ
      SR   STR, CE, NZ
      SL   STR, NZ
      SL   STR, RE, NZ
      SL   STR, SE, NZ
      SL   STR, CE, NZ
      SR   STR, MZ
      SR   STR, RE, MZ
      SR   STR, SE, MZ
      SR   STR, CE, MZ
      SL   STR, MZ
      SL   STR, RE, MZ
      SL   STR, SE, MZ
      SL   STR, CE, MZ
      SR   STR, P
      SR   STR, RE, P
      SR   STR, SE, P
      SR   STR, CE, P
      SL   STR, P
      SL   STR, RE, P
      SL   STR, SE, P
      SL   STR, CE, P
      SR   STR, EZ
      SR   STR, RE, EZ
      SR   STR, SE, EZ
      SR   STR, CE, EZ
      SL   STR, EZ
      SL   STR, RE, EZ
      SL   STR, SE, EZ
      SL   STR, CE, EZ
      SR   STR, ENZ
      SR   STR, RE, ENZ
      SR   STR, SE, ENZ
      SR   STR, CE, ENZ
      SL   STR, ENZ
      SL   STR, RE, ENZ
      SL   STR, SE, ENZ
      SL   STR, CE, ENZ
      SR   STR, OZ
      SR   STR, RE, OZ
      SR   STR, SE, OZ
      SR   STR, CE, OZ
      SL   STR, OZ
      SL   STR, RE, OZ
      SL   STR, SE, OZ
      SL   STR, CE, OZ
      SR   STR, ONZ
      SR   STR, RE, ONZ
      SR   STR, SE, ONZ
      SR   STR, CE, ONZ
      SL   STR, ONZ
      SL   STR, RE, ONZ
      SL   STR, SE, ONZ
      SL   STR, CE, ONZ
      SR   STR, LMZ
      SR   STR, RE, LMZ
      SR   STR, SE, LMZ
      SR   STR, CE, LMZ
      SL   STR, LMZ
      SL   STR, RE, LMZ
      SL   STR, SE, LMZ
      SL   STR, CE, LMZ
      SR   STR, LP
      SR   STR, RE, LP
      SR   STR, SE, LP
      SR   STR, CE, LP
      SL   STR, LP
      SL   STR, RE, LP
      SL   STR, SE, LP
      SL   STR, CE, LP
      SR   STR, LPZ
      SR   STR, RE, LPZ
      SR   STR, SE, LPZ
      SR   STR, CE, LPZ
      SL   STR, LPZ
      SL   STR, RE, LPZ
      SL   STR, SE, LPZ
      SL   STR, CE, LPZ
      SR   STR, LM
      SR   STR, RE, LM
      SR   STR, SE, LM
      SR   STR, CE, LM
      SL   STR, LM
      SL   STR, RE, LM
      SL   STR, SE, LM
      SL   STR, CE, LM
      TBIT R0, 0
      TBIT R0, 0, SKP
      TBIT R0, 0, M
      TBIT R0, 0, PZ
      TBIT R0, 0, Z
      TBIT R0, 0, NZ
      TBIT R0, 0, MZ
      TBIT R0, 0, P
      TBIT R0, 0, EZ
      TBIT R0, 0, ENZ
      TBIT R0, 0, OZ
      TBIT R0, 0, ONZ
      TBIT R0, 0, LMZ
      TBIT R0, 0, LP
      TBIT R0, 0, LPZ
      TBIT R0, 0, LM
      TBIT SP, 0
      TBIT SP, 0, SKP
      TBIT SP, 0, M
      TBIT SP, 0, PZ
      TBIT SP, 0, Z
      TBIT SP, 0, NZ
      TBIT SP, 0, MZ
      TBIT SP, 0, P
      TBIT SP, 0, EZ
      TBIT SP, 0, ENZ
      TBIT SP, 0, OZ
      TBIT SP, 0, ONZ
      TBIT SP, 0, LMZ
      TBIT SP, 0, LP
      TBIT SP, 0, LPZ
      TBIT SP, 0, LM
      TBIT STR, 0
      TBIT STR, 0, SKP
      TBIT STR, 0, M
      TBIT STR, 0, PZ
      TBIT STR, 0, Z
      TBIT STR, 0, NZ
      TBIT STR, 0, MZ
      TBIT STR, 0, P
      TBIT STR, 0, EZ
      TBIT STR, 0, ENZ
      TBIT STR, 0, OZ
      TBIT STR, 0, ONZ
      TBIT STR, 0, LMZ
      TBIT STR, 0, LP
      TBIT STR, 0, LPZ
      TBIT STR, 0, LM
      RBIT R0, 0
      RBIT R0, 0, SKP
      RBIT R0, 0, M
      RBIT R0, 0, PZ
      RBIT R0, 0, Z
      RBIT R0, 0, NZ
      RBIT R0, 0, MZ
      RBIT R0, 0, P
      RBIT R0, 0, EZ
      RBIT R0, 0, ENZ
      RBIT R0, 0, OZ
      RBIT R0, 0, ONZ
      RBIT R0, 0, LMZ
      RBIT R0, 0, LP
      RBIT R0, 0, LPZ
      RBIT R0, 0, LM
      RBIT SP, 0
      RBIT SP, 0, SKP
      RBIT SP, 0, M
      RBIT SP, 0, PZ
      RBIT SP, 0, Z
      RBIT SP, 0, NZ
      RBIT SP, 0, MZ
      RBIT SP, 0, P
      RBIT SP, 0, EZ
      RBIT SP, 0, ENZ
      RBIT SP, 0, OZ
      RBIT SP, 0, ONZ
      RBIT SP, 0, LMZ
      RBIT SP, 0, LP
      RBIT SP, 0, LPZ
      RBIT SP, 0, LM
      RBIT STR, 0
      RBIT STR, 0, SKP
      RBIT STR, 0, M
      RBIT STR, 0, PZ
      RBIT STR, 0, Z
      RBIT STR, 0, NZ
      RBIT STR, 0, MZ
      RBIT STR, 0, P
      RBIT STR, 0, EZ
      RBIT STR, 0, ENZ
      RBIT STR, 0, OZ
      RBIT STR, 0, ONZ
      RBIT STR, 0, LMZ
      RBIT STR, 0, LP
      RBIT STR, 0, LPZ
      RBIT STR, 0, LM
      SBIT R0, 0
      SBIT R0, 0, SKP
      SBIT R0, 0, M
      SBIT R0, 0, PZ
      SBIT R0, 0, Z
      SBIT R0, 0, NZ
      SBIT R0, 0, MZ
      SBIT R0, 0, P
      SBIT R0, 0, EZ
      SBIT R0, 0, ENZ
      SBIT R0, 0, OZ
      SBIT R0, 0, ONZ
      SBIT R0, 0, LMZ
      SBIT R0, 0, LP
      SBIT R0, 0, LPZ
      SBIT R0, 0, LM
      SBIT SP, 0
      SBIT SP, 0, SKP
      SBIT SP, 0, M
      SBIT SP, 0, PZ
      SBIT SP, 0, Z
      SBIT SP, 0, NZ
      SBIT SP, 0, MZ
      SBIT SP, 0, P
      SBIT SP, 0, EZ
      SBIT SP, 0, ENZ
      SBIT SP, 0, OZ
      SBIT SP, 0, ONZ
      SBIT SP, 0, LMZ
      SBIT SP, 0, LP
      SBIT SP, 0, LPZ
      SBIT SP, 0, LM
      SBIT STR, 0
      SBIT STR, 0, SKP
      SBIT STR, 0, M
      SBIT STR, 0, PZ
      SBIT STR, 0, Z
      SBIT STR, 0, NZ
      SBIT STR, 0, MZ
      SBIT STR, 0, P
      SBIT STR, 0, EZ
      SBIT STR, 0, ENZ
      SBIT STR, 0, OZ
      SBIT STR, 0, ONZ
      SBIT STR, 0, LMZ
      SBIT STR, 0, LP
      SBIT STR, 0, LPZ
      SBIT STR, 0, LM
      SI   R0, 0
      SI   R0, 0, SKP
      SI   R0, 0, M
      SI   R0, 0, PZ
      SI   R0, 0, Z
      SI   R0, 0, NZ
      SI   R0, 0, MZ
      SI   R0, 0, P
      SI   R0, 0, EZ
      SI   R0, 0, ENZ
      SI   R0, 0, OZ
      SI   R0, 0, ONZ
      SI   R0, 0, LMZ
      SI   R0, 0, LP
      SI   R0, 0, LPZ
      SI   R0, 0, LM
      SI   SP, 0
      SI   SP, 0, SKP
      SI   SP, 0, M
      SI   SP, 0, PZ
      SI   SP, 0, Z
      SI   SP, 0, NZ
      SI   SP, 0, MZ
      SI   SP, 0, P
      SI   SP, 0, EZ
      SI   SP, 0, ENZ
      SI   SP, 0, OZ
      SI   SP, 0, ONZ
      SI   SP, 0, LMZ
      SI   SP, 0, LP
      SI   SP, 0, LPZ
      SI   SP, 0, LM
      SI   STR, 0
      SI   STR, 0, SKP
      SI   STR, 0, M
      SI   STR, 0, PZ
      SI   STR, 0, Z
      SI   STR, 0, NZ
      SI   STR, 0, MZ
      SI   STR, 0, P
      SI   STR, 0, EZ
      SI   STR, 0, ENZ
      SI   STR, 0, OZ
      SI   STR, 0, ONZ
      SI   STR, 0, LMZ
      SI   STR, 0, LP
      SI   STR, 0, LPZ
      SI   STR, 0, LM
      AI   R0, 0
      AI   R0, 0, SKP
      AI   R0, 0, M
      AI   R0, 0, PZ
      AI   R0, 0, Z
      AI   R0, 0, NZ
      AI   R0, 0, MZ
      AI   R0, 0, P
      AI   R0, 0, EZ
      AI   R0, 0, ENZ
      AI   R0, 0, OZ
      AI   R0, 0, ONZ
      AI   R0, 0, LMZ
      AI   R0, 0, LP
      AI   R0, 0, LPZ
      AI   R0, 0, LM
      AI   SP, 0
      AI   SP, 0, SKP
      AI   SP, 0, M
      AI   SP, 0, PZ
      AI   SP, 0, Z
      AI   SP, 0, NZ
      AI   SP, 0, MZ
      AI   SP, 0, P
      AI   SP, 0, EZ
      AI   SP, 0, ENZ
      AI   SP, 0, OZ
      AI   SP, 0, ONZ
      AI   SP, 0, LMZ
      AI   SP, 0, LP
      AI   SP, 0, LPZ
      AI   SP, 0, LM
      AI   STR, 0
      AI   STR, 0, SKP
      AI   STR, 0, M
      AI   STR, 0, PZ
      AI   STR, 0, Z
      AI   STR, 0, NZ
      AI   STR, 0, MZ
      AI   STR, 0, P
      AI   STR, 0, EZ
      AI   STR, 0, ENZ
      AI   STR, 0, OZ
      AI   STR, 0, ONZ
      AI   STR, 0, LMZ
      AI   STR, 0, LP
      AI   STR, 0, LPZ
      AI   STR, 0, LM
      CB   R0, R0
      CB   R0, SP
      CB   R0, STR
      C    R0, R0
      C    R0, SP
      C    R0, STR
      CB   R0, R0, SKP
      CB   R0, SP, SKP
      CB   R0, STR, SKP
      C    R0, R0, SKP
      C    R0, SP, SKP
      C    R0, STR, SKP
      CB   R0, R0, M
      CB   R0, SP, M
      CB   R0, STR, M
      C    R0, R0, M
      C    R0, SP, M
      C    R0, STR, M
      CB   R0, R0, PZ
      CB   R0, SP, PZ
      CB   R0, STR, PZ
      C    R0, R0, PZ
      C    R0, SP, PZ
      C    R0, STR, PZ
      CB   R0, R0, Z
      CB   R0, SP, Z
      CB   R0, STR, Z
      C    R0, R0, Z
      C    R0, SP, Z
      C    R0, STR, Z
      CB   R0, R0, NZ
      CB   R0, SP, NZ
      CB   R0, STR, NZ
      C    R0, R0, NZ
      C    R0, SP, NZ
      C    R0, STR, NZ
      CB   R0, R0, MZ
      CB   R0, SP, MZ
      CB   R0, STR, MZ
      C    R0, R0, MZ
      C    R0, SP, MZ
      C    R0, STR, MZ
      CB   R0, R0, P
      CB   R0, SP, P
      CB   R0, STR, P
      C    R0, R0, P
      C    R0, SP, P
      C    R0, STR, P
      CB   R0, R0, EZ
      CB   R0, SP, EZ
      CB   R0, STR, EZ
      C    R0, R0, EZ
      C    R0, SP, EZ
      C    R0, STR, EZ
      CB   R0, R0, ENZ
      CB   R0, SP, ENZ
      CB   R0, STR, ENZ
      C    R0, R0, ENZ
      C    R0, SP, ENZ
      C    R0, STR, ENZ
      CB   R0, R0, OZ
      CB   R0, SP, OZ
      CB   R0, STR, OZ
      C    R0, R0, OZ
      C    R0, SP, OZ
      C    R0, STR, OZ
      CB   R0, R0, ONZ
      CB   R0, SP, ONZ
      CB   R0, STR, ONZ
      C    R0, R0, ONZ
      C    R0, SP, ONZ
      C    R0, STR, ONZ
      CB   R0, R0, LMZ
      CB   R0, SP, LMZ
      CB   R0, STR, LMZ
      C    R0, R0, LMZ
      C    R0, SP, LMZ
      C    R0, STR, LMZ
      CB   R0, R0, LP
      CB   R0, SP, LP
      CB   R0, STR, LP
      C    R0, R0, LP
      C    R0, SP, LP
      C    R0, STR, LP
      CB   R0, R0, LPZ
      CB   R0, SP, LPZ
      CB   R0, STR, LPZ
      C    R0, R0, LPZ
      C    R0, SP, LPZ
      C    R0, STR, LPZ
      CB   R0, R0, LM
      CB   R0, SP, LM
      CB   R0, STR, LM
      C    R0, R0, LM
      C    R0, SP, LM
      C    R0, STR, LM
      CB   SP, R0
      CB   SP, SP
      CB   SP, STR
      C    SP, R0
      C    SP, SP
      C    SP, STR
      CB   SP, R0, SKP
      CB   SP, SP, SKP
      CB   SP, STR, SKP
      C    SP, R0, SKP
      C    SP, SP, SKP
      C    SP, STR, SKP
      CB   SP, R0, M
      CB   SP, SP, M
      CB   SP, STR, M
      C    SP, R0, M
      C    SP, SP, M
      C    SP, STR, M
      CB   SP, R0, PZ
      CB   SP, SP, PZ
      CB   SP, STR, PZ
      C    SP, R0, PZ
      C    SP, SP, PZ
      C    SP, STR, PZ
      CB   SP, R0, Z
      CB   SP, SP, Z
      CB   SP, STR, Z
      C    SP, R0, Z
      C    SP, SP, Z
      C    SP, STR, Z
      CB   SP, R0, NZ
      CB   SP, SP, NZ
      CB   SP, STR, NZ
      C    SP, R0, NZ
      C    SP, SP, NZ
      C    SP, STR, NZ
      CB   SP, R0, MZ
      CB   SP, SP, MZ
      CB   SP, STR, MZ
      C    SP, R0, MZ
      C    SP, SP, MZ
      C    SP, STR, MZ
      CB   SP, R0, P
      CB   SP, SP, P
      CB   SP, STR, P
      C    SP, R0, P
      C    SP, SP, P
      C    SP, STR, P
      CB   SP, R0, EZ
      CB   SP, SP, EZ
      CB   SP, STR, EZ
      C    SP, R0, EZ
      C    SP, SP, EZ
      C    SP, STR, EZ
      CB   SP, R0, ENZ
      CB   SP, SP, ENZ
      CB   SP, STR, ENZ
      C    SP, R0, ENZ
      C    SP, SP, ENZ
      C    SP, STR, ENZ
      CB   SP, R0, OZ
      CB   SP, SP, OZ
      CB   SP, STR, OZ
      C    SP, R0, OZ
      C    SP, SP, OZ
      C    SP, STR, OZ
      CB   SP, R0, ONZ
      CB   SP, SP, ONZ
      CB   SP, STR, ONZ
      C    SP, R0, ONZ
      C    SP, SP, ONZ
      C    SP, STR, ONZ
      CB   SP, R0, LMZ
      CB   SP, SP, LMZ
      CB   SP, STR, LMZ
      C    SP, R0, LMZ
      C    SP, SP, LMZ
      C    SP, STR, LMZ
      CB   SP, R0, LP
      CB   SP, SP, LP
      CB   SP, STR, LP
      C    SP, R0, LP
      C    SP, SP, LP
      C    SP, STR, LP
      CB   SP, R0, LPZ
      CB   SP, SP, LPZ
      CB   SP, STR, LPZ
      C    SP, R0, LPZ
      C    SP, SP, LPZ
      C    SP, STR, LPZ
      CB   SP, R0, LM
      CB   SP, SP, LM
      CB   SP, STR, LM
      C    SP, R0, LM
      C    SP, SP, LM
      C    SP, STR, LM
      CB   STR, R0
      CB   STR, SP
      CB   STR, STR
      C    STR, R0
      C    STR, SP
      C    STR, STR
      CB   STR, R0, SKP
      CB   STR, SP, SKP
      CB   STR, STR, SKP
      C    STR, R0, SKP
      C    STR, SP, SKP
      C    STR, STR, SKP
      CB   STR, R0, M
      CB   STR, SP, M
      CB   STR, STR, M
      C    STR, R0, M
      C    STR, SP, M
      C    STR, STR, M
      CB   STR, R0, PZ
      CB   STR, SP, PZ
      CB   STR, STR, PZ
      C    STR, R0, PZ
      C    STR, SP, PZ
      C    STR, STR, PZ
      CB   STR, R0, Z
      CB   STR, SP, Z
      CB   STR, STR, Z
      C    STR, R0, Z
      C    STR, SP, Z
      C    STR, STR, Z
      CB   STR, R0, NZ
      CB   STR, SP, NZ
      CB   STR, STR, NZ
      C    STR, R0, NZ
      C    STR, SP, NZ
      C    STR, STR, NZ
      CB   STR, R0, MZ
      CB   STR, SP, MZ
      CB   STR, STR, MZ
      C    STR, R0, MZ
      C    STR, SP, MZ
      C    STR, STR, MZ
      CB   STR, R0, P
      CB   STR, SP, P
      CB   STR, STR, P
      C    STR, R0, P
      C    STR, SP, P
      C    STR, STR, P
      CB   STR, R0, EZ
      CB   STR, SP, EZ
      CB   STR, STR, EZ
      C    STR, R0, EZ
      C    STR, SP, EZ
      C    STR, STR, EZ
      CB   STR, R0, ENZ
      CB   STR, SP, ENZ
      CB   STR, STR, ENZ
      C    STR, R0, ENZ
      C    STR, SP, ENZ
      C    STR, STR, ENZ
      CB   STR, R0, OZ
      CB   STR, SP, OZ
      CB   STR, STR, OZ
      C    STR, R0, OZ
      C    STR, SP, OZ
      C    STR, STR, OZ
      CB   STR, R0, ONZ
      CB   STR, SP, ONZ
      CB   STR, STR, ONZ
      C    STR, R0, ONZ
      C    STR, SP, ONZ
      C    STR, STR, ONZ
      CB   STR, R0, LMZ
      CB   STR, SP, LMZ
      CB   STR, STR, LMZ
      C    STR, R0, LMZ
      C    STR, SP, LMZ
      C    STR, STR, LMZ
      CB   STR, R0, LP
      CB   STR, SP, LP
      CB   STR, STR, LP
      C    STR, R0, LP
      C    STR, SP, LP
      C    STR, STR, LP
      CB   STR, R0, LPZ
      CB   STR, SP, LPZ
      CB   STR, STR, LPZ
      C    STR, R0, LPZ
      C    STR, SP, LPZ
      C    STR, STR, LPZ
      CB   STR, R0, LM
      CB   STR, SP, LM
      CB   STR, STR, LM
      C    STR, R0, LM
      C    STR, SP, LM
      C    STR, STR, LM
      S    R0, R0
      S    R0, SP
      S    R0, STR
      A    R0, R0
      A    R0, SP
      A    R0, STR
      S    R0, R0, SKP
      S    R0, SP, SKP
      S    R0, STR, SKP
      A    R0, R0, SKP
      A    R0, SP, SKP
      A    R0, STR, SKP
      S    R0, R0, M
      S    R0, SP, M
      S    R0, STR, M
      A    R0, R0, M
      A    R0, SP, M
      A    R0, STR, M
      S    R0, R0, PZ
      S    R0, SP, PZ
      S    R0, STR, PZ
      A    R0, R0, PZ
      A    R0, SP, PZ
      A    R0, STR, PZ
      S    R0, R0, Z
      S    R0, SP, Z
      S    R0, STR, Z
      A    R0, R0, Z
      A    R0, SP, Z
      A    R0, STR, Z
      S    R0, R0, NZ
      S    R0, SP, NZ
      S    R0, STR, NZ
      A    R0, R0, NZ
      A    R0, SP, NZ
      A    R0, STR, NZ
      S    R0, R0, MZ
      S    R0, SP, MZ
      S    R0, STR, MZ
      A    R0, R0, MZ
      A    R0, SP, MZ
      A    R0, STR, MZ
      S    R0, R0, P
      S    R0, SP, P
      S    R0, STR, P
      A    R0, R0, P
      A    R0, SP, P
      A    R0, STR, P
      S    R0, R0, EZ
      S    R0, SP, EZ
      S    R0, STR, EZ
      A    R0, R0, EZ
      A    R0, SP, EZ
      A    R0, STR, EZ
      S    R0, R0, ENZ
      S    R0, SP, ENZ
      S    R0, STR, ENZ
      A    R0, R0, ENZ
      A    R0, SP, ENZ
      A    R0, STR, ENZ
      S    R0, R0, OZ
      S    R0, SP, OZ
      S    R0, STR, OZ
      A    R0, R0, OZ
      A    R0, SP, OZ
      A    R0, STR, OZ
      S    R0, R0, ONZ
      S    R0, SP, ONZ
      S    R0, STR, ONZ
      A    R0, R0, ONZ
      A    R0, SP, ONZ
      A    R0, STR, ONZ
      S    R0, R0, LMZ
      S    R0, SP, LMZ
      S    R0, STR, LMZ
      A    R0, R0, LMZ
      A    R0, SP, LMZ
      A    R0, STR, LMZ
      S    R0, R0, LP
      S    R0, SP, LP
      S    R0, STR, LP
      A    R0, R0, LP
      A    R0, SP, LP
      A    R0, STR, LP
      S    R0, R0, LPZ
      S    R0, SP, LPZ
      S    R0, STR, LPZ
      A    R0, R0, LPZ
      A    R0, SP, LPZ
      A    R0, STR, LPZ
      S    R0, R0, LM
      S    R0, SP, LM
      S    R0, STR, LM
      A    R0, R0, LM
      A    R0, SP, LM
      A    R0, STR, LM
      S    SP, R0
      S    SP, SP
      S    SP, STR
      A    SP, R0
      A    SP, SP
      A    SP, STR
      S    SP, R0, SKP
      S    SP, SP, SKP
      S    SP, STR, SKP
      A    SP, R0, SKP
      A    SP, SP, SKP
      A    SP, STR, SKP
      S    SP, R0, M
      S    SP, SP, M
      S    SP, STR, M
      A    SP, R0, M
      A    SP, SP, M
      A    SP, STR, M
      S    SP, R0, PZ
      S    SP, SP, PZ
      S    SP, STR, PZ
      A    SP, R0, PZ
      A    SP, SP, PZ
      A    SP, STR, PZ
      S    SP, R0, Z
      S    SP, SP, Z
      S    SP, STR, Z
      A    SP, R0, Z
      A    SP, SP, Z
      A    SP, STR, Z
      S    SP, R0, NZ
      S    SP, SP, NZ
      S    SP, STR, NZ
      A    SP, R0, NZ
      A    SP, SP, NZ
      A    SP, STR, NZ
      S    SP, R0, MZ
      S    SP, SP, MZ
      S    SP, STR, MZ
      A    SP, R0, MZ
      A    SP, SP, MZ
      A    SP, STR, MZ
      S    SP, R0, P
      S    SP, SP, P
      S    SP, STR, P
      A    SP, R0, P
      A    SP, SP, P
      A    SP, STR, P
      S    SP, R0, EZ
      S    SP, SP, EZ
      S    SP, STR, EZ
      A    SP, R0, EZ
      A    SP, SP, EZ
      A    SP, STR, EZ
      S    SP, R0, ENZ
      S    SP, SP, ENZ
      S    SP, STR, ENZ
      A    SP, R0, ENZ
      A    SP, SP, ENZ
      A    SP, STR, ENZ
      S    SP, R0, OZ
      S    SP, SP, OZ
      S    SP, STR, OZ
      A    SP, R0, OZ
      A    SP, SP, OZ
      A    SP, STR, OZ
      S    SP, R0, ONZ
      S    SP, SP, ONZ
      S    SP, STR, ONZ
      A    SP, R0, ONZ
      A    SP, SP, ONZ
      A    SP, STR, ONZ
      S    SP, R0, LMZ
      S    SP, SP, LMZ
      S    SP, STR, LMZ
      A    SP, R0, LMZ
      A    SP, SP, LMZ
      A    SP, STR, LMZ
      S    SP, R0, LP
      S    SP, SP, LP
      S    SP, STR, LP
      A    SP, R0, LP
      A    SP, SP, LP
      A    SP, STR, LP
      S    SP, R0, LPZ
      S    SP, SP, LPZ
      S    SP, STR, LPZ
      A    SP, R0, LPZ
      A    SP, SP, LPZ
      A    SP, STR, LPZ
      S    SP, R0, LM
      S    SP, SP, LM
      S    SP, STR, LM
      A    SP, R0, LM
      A    SP, SP, LM
      A    SP, STR, LM
      S    STR, R0
      S    STR, SP
      S    STR, STR
      A    STR, R0
      A    STR, SP
      A    STR, STR
      S    STR, R0, SKP
      S    STR, SP, SKP
      S    STR, STR, SKP
      A    STR, R0, SKP
      A    STR, SP, SKP
      A    STR, STR, SKP
      S    STR, R0, M
      S    STR, SP, M
      S    STR, STR, M
      A    STR, R0, M
      A    STR, SP, M
      A    STR, STR, M
      S    STR, R0, PZ
      S    STR, SP, PZ
      S    STR, STR, PZ
      A    STR, R0, PZ
      A    STR, SP, PZ
      A    STR, STR, PZ
      S    STR, R0, Z
      S    STR, SP, Z
      S    STR, STR, Z
      A    STR, R0, Z
      A    STR, SP, Z
      A    STR, STR, Z
      S    STR, R0, NZ
      S    STR, SP, NZ
      S    STR, STR, NZ
      A    STR, R0, NZ
      A    STR, SP, NZ
      A    STR, STR, NZ
      S    STR, R0, MZ
      S    STR, SP, MZ
      S    STR, STR, MZ
      A    STR, R0, MZ
      A    STR, SP, MZ
      A    STR, STR, MZ
      S    STR, R0, P
      S    STR, SP, P
      S    STR, STR, P
      A    STR, R0, P
      A    STR, SP, P
      A    STR, STR, P
      S    STR, R0, EZ
      S    STR, SP, EZ
      S    STR, STR, EZ
      A    STR, R0, EZ
      A    STR, SP, EZ
      A    STR, STR, EZ
      S    STR, R0, ENZ
      S    STR, SP, ENZ
      S    STR, STR, ENZ
      A    STR, R0, ENZ
      A    STR, SP, ENZ
      A    STR, STR, ENZ
      S    STR, R0, OZ
      S    STR, SP, OZ
      S    STR, STR, OZ
      A    STR, R0, OZ
      A    STR, SP, OZ
      A    STR, STR, OZ
      S    STR, R0, ONZ
      S    STR, SP, ONZ
      S    STR, STR, ONZ
      A    STR, R0, ONZ
      A    STR, SP, ONZ
      A    STR, STR, ONZ
      S    STR, R0, LMZ
      S    STR, SP, LMZ
      S    STR, STR, LMZ
      A    STR, R0, LMZ
      A    STR, SP, LMZ
      A    STR, STR, LMZ
      S    STR, R0, LP
      S    STR, SP, LP
      S    STR, STR, LP
      A    STR, R0, LP
      A    STR, SP, LP
      A    STR, STR, LP
      S    STR, R0, LPZ
      S    STR, SP, LPZ
      S    STR, STR, LPZ
      A    STR, R0, LPZ
      A    STR, SP, LPZ
      A    STR, STR, LPZ
      S    STR, R0, LM
      S    STR, SP, LM
      S    STR, STR, LM
      A    STR, R0, LM
      A    STR, SP, LM
      A    STR, STR, LM
      EOR  R0, R0
      EOR  R0, SP
      EOR  R0, STR
      OR   R0, R0
      OR   R0, SP
      OR   R0, STR
      EOR  R0, R0, SKP
      EOR  R0, SP, SKP
      EOR  R0, STR, SKP
      OR   R0, R0, SKP
      OR   R0, SP, SKP
      OR   R0, STR, SKP
      EOR  R0, R0, M
      EOR  R0, SP, M
      EOR  R0, STR, M
      OR   R0, R0, M
      OR   R0, SP, M
      OR   R0, STR, M
      EOR  R0, R0, PZ
      EOR  R0, SP, PZ
      EOR  R0, STR, PZ
      OR   R0, R0, PZ
      OR   R0, SP, PZ
      OR   R0, STR, PZ
      EOR  R0, R0, Z
      EOR  R0, SP, Z
      EOR  R0, STR, Z
      OR   R0, R0, Z
      OR   R0, SP, Z
      OR   R0, STR, Z
      EOR  R0, R0, NZ
      EOR  R0, SP, NZ
      EOR  R0, STR, NZ
      OR   R0, R0, NZ
      OR   R0, SP, NZ
      OR   R0, STR, NZ
      EOR  R0, R0, MZ
      EOR  R0, SP, MZ
      EOR  R0, STR, MZ
      OR   R0, R0, MZ
      OR   R0, SP, MZ
      OR   R0, STR, MZ
      EOR  R0, R0, P
      EOR  R0, SP, P
      EOR  R0, STR, P
      OR   R0, R0, P
      OR   R0, SP, P
      OR   R0, STR, P
      EOR  R0, R0, EZ
      EOR  R0, SP, EZ
      EOR  R0, STR, EZ
      OR   R0, R0, EZ
      OR   R0, SP, EZ
      OR   R0, STR, EZ
      EOR  R0, R0, ENZ
      EOR  R0, SP, ENZ
      EOR  R0, STR, ENZ
      OR   R0, R0, ENZ
      OR   R0, SP, ENZ
      OR   R0, STR, ENZ
      EOR  R0, R0, OZ
      EOR  R0, SP, OZ
      EOR  R0, STR, OZ
      OR   R0, R0, OZ
      OR   R0, SP, OZ
      OR   R0, STR, OZ
      EOR  R0, R0, ONZ
      EOR  R0, SP, ONZ
      EOR  R0, STR, ONZ
      OR   R0, R0, ONZ
      OR   R0, SP, ONZ
      OR   R0, STR, ONZ
      EOR  R0, R0, LMZ
      EOR  R0, SP, LMZ
      EOR  R0, STR, LMZ
      OR   R0, R0, LMZ
      OR   R0, SP, LMZ
      OR   R0, STR, LMZ
      EOR  R0, R0, LP
      EOR  R0, SP, LP
      EOR  R0, STR, LP
      OR   R0, R0, LP
      OR   R0, SP, LP
      OR   R0, STR, LP
      EOR  R0, R0, LPZ
      EOR  R0, SP, LPZ
      EOR  R0, STR, LPZ
      OR   R0, R0, LPZ
      OR   R0, SP, LPZ
      OR   R0, STR, LPZ
      EOR  R0, R0, LM
      EOR  R0, SP, LM
      EOR  R0, STR, LM
      OR   R0, R0, LM
      OR   R0, SP, LM
      OR   R0, STR, LM
      EOR  SP, R0
      EOR  SP, SP
      EOR  SP, STR
      OR   SP, R0
      OR   SP, SP
      OR   SP, STR
      EOR  SP, R0, SKP
      EOR  SP, SP, SKP
      EOR  SP, STR, SKP
      OR   SP, R0, SKP
      OR   SP, SP, SKP
      OR   SP, STR, SKP
      EOR  SP, R0, M
      EOR  SP, SP, M
      EOR  SP, STR, M
      OR   SP, R0, M
      OR   SP, SP, M
      OR   SP, STR, M
      EOR  SP, R0, PZ
      EOR  SP, SP, PZ
      EOR  SP, STR, PZ
      OR   SP, R0, PZ
      OR   SP, SP, PZ
      OR   SP, STR, PZ
      EOR  SP, R0, Z
      EOR  SP, SP, Z
      EOR  SP, STR, Z
      OR   SP, R0, Z
      OR   SP, SP, Z
      OR   SP, STR, Z
      EOR  SP, R0, NZ
      EOR  SP, SP, NZ
      EOR  SP, STR, NZ
      OR   SP, R0, NZ
      OR   SP, SP, NZ
      OR   SP, STR, NZ
      EOR  SP, R0, MZ
      EOR  SP, SP, MZ
      EOR  SP, STR, MZ
      OR   SP, R0, MZ
      OR   SP, SP, MZ
      OR   SP, STR, MZ
      EOR  SP, R0, P
      EOR  SP, SP, P
      EOR  SP, STR, P
      OR   SP, R0, P
      OR   SP, SP, P
      OR   SP, STR, P
      EOR  SP, R0, EZ
      EOR  SP, SP, EZ
      EOR  SP, STR, EZ
      OR   SP, R0, EZ
      OR   SP, SP, EZ
      OR   SP, STR, EZ
      EOR  SP, R0, ENZ
      EOR  SP, SP, ENZ
      EOR  SP, STR, ENZ
      OR   SP, R0, ENZ
      OR   SP, SP, ENZ
      OR   SP, STR, ENZ
      EOR  SP, R0, OZ
      EOR  SP, SP, OZ
      EOR  SP, STR, OZ
      OR   SP, R0, OZ
      OR   SP, SP, OZ
      OR   SP, STR, OZ
      EOR  SP, R0, ONZ
      EOR  SP, SP, ONZ
      EOR  SP, STR, ONZ
      OR   SP, R0, ONZ
      OR   SP, SP, ONZ
      OR   SP, STR, ONZ
      EOR  SP, R0, LMZ
      EOR  SP, SP, LMZ
      EOR  SP, STR, LMZ
      OR   SP, R0, LMZ
      OR   SP, SP, LMZ
      OR   SP, STR, LMZ
      EOR  SP, R0, LP
      EOR  SP, SP, LP
      EOR  SP, STR, LP
      OR   SP, R0, LP
      OR   SP, SP, LP
      OR   SP, STR, LP
      EOR  SP, R0, LPZ
      EOR  SP, SP, LPZ
      EOR  SP, STR, LPZ
      OR   SP, R0, LPZ
      OR   SP, SP, LPZ
      OR   SP, STR, LPZ
      EOR  SP, R0, LM
      EOR  SP, SP, LM
      EOR  SP, STR, LM
      OR   SP, R0, LM
      OR   SP, SP, LM
      OR   SP, STR, LM
      EOR  STR, R0
      EOR  STR, SP
      EOR  STR, STR
      OR   STR, R0
      OR   STR, SP
      OR   STR, STR
      EOR  STR, R0, SKP
      EOR  STR, SP, SKP
      EOR  STR, STR, SKP
      OR   STR, R0, SKP
      OR   STR, SP, SKP
      OR   STR, STR, SKP
      EOR  STR, R0, M
      EOR  STR, SP, M
      EOR  STR, STR, M
      OR   STR, R0, M
      OR   STR, SP, M
      OR   STR, STR, M
      EOR  STR, R0, PZ
      EOR  STR, SP, PZ
      EOR  STR, STR, PZ
      OR   STR, R0, PZ
      OR   STR, SP, PZ
      OR   STR, STR, PZ
      EOR  STR, R0, Z
      EOR  STR, SP, Z
      EOR  STR, STR, Z
      OR   STR, R0, Z
      OR   STR, SP, Z
      OR   STR, STR, Z
      EOR  STR, R0, NZ
      EOR  STR, SP, NZ
      EOR  STR, STR, NZ
      OR   STR, R0, NZ
      OR   STR, SP, NZ
      OR   STR, STR, NZ
      EOR  STR, R0, MZ
      EOR  STR, SP, MZ
      EOR  STR, STR, MZ
      OR   STR, R0, MZ
      OR   STR, SP, MZ
      OR   STR, STR, MZ
      EOR  STR, R0, P
      EOR  STR, SP, P
      EOR  STR, STR, P
      OR   STR, R0, P
      OR   STR, SP, P
      OR   STR, STR, P
      EOR  STR, R0, EZ
      EOR  STR, SP, EZ
      EOR  STR, STR, EZ
      OR   STR, R0, EZ
      OR   STR, SP, EZ
      OR   STR, STR, EZ
      EOR  STR, R0, ENZ
      EOR  STR, SP, ENZ
      EOR  STR, STR, ENZ
      OR   STR, R0, ENZ
      OR   STR, SP, ENZ
      OR   STR, STR, ENZ
      EOR  STR, R0, OZ
      EOR  STR, SP, OZ
      EOR  STR, STR, OZ
      OR   STR, R0, OZ
      OR   STR, SP, OZ
      OR   STR, STR, OZ
      EOR  STR, R0, ONZ
      EOR  STR, SP, ONZ
      EOR  STR, STR, ONZ
      OR   STR, R0, ONZ
      OR   STR, SP, ONZ
      OR   STR, STR, ONZ
      EOR  STR, R0, LMZ
      EOR  STR, SP, LMZ
      EOR  STR, STR, LMZ
      OR   STR, R0, LMZ
      OR   STR, SP, LMZ
      OR   STR, STR, LMZ
      EOR  STR, R0, LP
      EOR  STR, SP, LP
      EOR  STR, STR, LP
      OR   STR, R0, LP
      OR   STR, SP, LP
      OR   STR, STR, LP
      EOR  STR, R0, LPZ
      EOR  STR, SP, LPZ
      EOR  STR, STR, LPZ
      OR   STR, R0, LPZ
      OR   STR, SP, LPZ
      OR   STR, STR, LPZ
      EOR  STR, R0, LM
      EOR  STR, SP, LM
      EOR  STR, STR, LM
      OR   STR, R0, LM
      OR   STR, SP, LM
      OR   STR, STR, LM
      LAD  R0, R0
      LAD  R0, SP
      LAD  R0, STR
      AND  R0, R0
      AND  R0, SP
      AND  R0, STR
      LAD  R0, R0, SKP
      LAD  R0, SP, SKP
      LAD  R0, STR, SKP
      AND  R0, R0, SKP
      AND  R0, SP, SKP
      AND  R0, STR, SKP
      LAD  R0, R0, M
      LAD  R0, SP, M
      LAD  R0, STR, M
      AND  R0, R0, M
      AND  R0, SP, M
      AND  R0, STR, M
      LAD  R0, R0, PZ
      LAD  R0, SP, PZ
      LAD  R0, STR, PZ
      AND  R0, R0, PZ
      AND  R0, SP, PZ
      AND  R0, STR, PZ
      LAD  R0, R0, Z
      LAD  R0, SP, Z
      LAD  R0, STR, Z
      AND  R0, R0, Z
      AND  R0, SP, Z
      AND  R0, STR, Z
      LAD  R0, R0, NZ
      LAD  R0, SP, NZ
      LAD  R0, STR, NZ
      AND  R0, R0, NZ
      AND  R0, SP, NZ
      AND  R0, STR, NZ
      LAD  R0, R0, MZ
      LAD  R0, SP, MZ
      LAD  R0, STR, MZ
      AND  R0, R0, MZ
      AND  R0, SP, MZ
      AND  R0, STR, MZ
      LAD  R0, R0, P
      LAD  R0, SP, P
      LAD  R0, STR, P
      AND  R0, R0, P
      AND  R0, SP, P
      AND  R0, STR, P
      LAD  R0, R0, EZ
      LAD  R0, SP, EZ
      LAD  R0, STR, EZ
      AND  R0, R0, EZ
      AND  R0, SP, EZ
      AND  R0, STR, EZ
      LAD  R0, R0, ENZ
      LAD  R0, SP, ENZ
      LAD  R0, STR, ENZ
      AND  R0, R0, ENZ
      AND  R0, SP, ENZ
      AND  R0, STR, ENZ
      LAD  R0, R0, OZ
      LAD  R0, SP, OZ
      LAD  R0, STR, OZ
      AND  R0, R0, OZ
      AND  R0, SP, OZ
      AND  R0, STR, OZ
      LAD  R0, R0, ONZ
      LAD  R0, SP, ONZ
      LAD  R0, STR, ONZ
      AND  R0, R0, ONZ
      AND  R0, SP, ONZ
      AND  R0, STR, ONZ
      LAD  R0, R0, LMZ
      LAD  R0, SP, LMZ
      LAD  R0, STR, LMZ
      AND  R0, R0, LMZ
      AND  R0, SP, LMZ
      AND  R0, STR, LMZ
      LAD  R0, R0, LP
      LAD  R0, SP, LP
      LAD  R0, STR, LP
      AND  R0, R0, LP
      AND  R0, SP, LP
      AND  R0, STR, LP
      LAD  R0, R0, LPZ
      LAD  R0, SP, LPZ
      LAD  R0, STR, LPZ
      AND  R0, R0, LPZ
      AND  R0, SP, LPZ
      AND  R0, STR, LPZ
      LAD  R0, R0, LM
      LAD  R0, SP, LM
      LAD  R0, STR, LM
      AND  R0, R0, LM
      AND  R0, SP, LM
      AND  R0, STR, LM
      LAD  SP, R0
      LAD  SP, SP
      LAD  SP, STR
      AND  SP, R0
      AND  SP, SP
      AND  SP, STR
      LAD  SP, R0, SKP
      LAD  SP, SP, SKP
      LAD  SP, STR, SKP
      AND  SP, R0, SKP
      AND  SP, SP, SKP
      AND  SP, STR, SKP
      LAD  SP, R0, M
      LAD  SP, SP, M
      LAD  SP, STR, M
      AND  SP, R0, M
      AND  SP, SP, M
      AND  SP, STR, M
      LAD  SP, R0, PZ
      LAD  SP, SP, PZ
      LAD  SP, STR, PZ
      AND  SP, R0, PZ
      AND  SP, SP, PZ
      AND  SP, STR, PZ
      LAD  SP, R0, Z
      LAD  SP, SP, Z
      LAD  SP, STR, Z
      AND  SP, R0, Z
      AND  SP, SP, Z
      AND  SP, STR, Z
      LAD  SP, R0, NZ
      LAD  SP, SP, NZ
      LAD  SP, STR, NZ
      AND  SP, R0, NZ
      AND  SP, SP, NZ
      AND  SP, STR, NZ
      LAD  SP, R0, MZ
      LAD  SP, SP, MZ
      LAD  SP, STR, MZ
      AND  SP, R0, MZ
      AND  SP, SP, MZ
      AND  SP, STR, MZ
      LAD  SP, R0, P
      LAD  SP, SP, P
      LAD  SP, STR, P
      AND  SP, R0, P
      AND  SP, SP, P
      AND  SP, STR, P
      LAD  SP, R0, EZ
      LAD  SP, SP, EZ
      LAD  SP, STR, EZ
      AND  SP, R0, EZ
      AND  SP, SP, EZ
      AND  SP, STR, EZ
      LAD  SP, R0, ENZ
      LAD  SP, SP, ENZ
      LAD  SP, STR, ENZ
      AND  SP, R0, ENZ
      AND  SP, SP, ENZ
      AND  SP, STR, ENZ
      LAD  SP, R0, OZ
      LAD  SP, SP, OZ
      LAD  SP, STR, OZ
      AND  SP, R0, OZ
      AND  SP, SP, OZ
      AND  SP, STR, OZ
      LAD  SP, R0, ONZ
      LAD  SP, SP, ONZ
      LAD  SP, STR, ONZ
      AND  SP, R0, ONZ
      AND  SP, SP, ONZ
      AND  SP, STR, ONZ
      LAD  SP, R0, LMZ
      LAD  SP, SP, LMZ
      LAD  SP, STR, LMZ
      AND  SP, R0, LMZ
      AND  SP, SP, LMZ
      AND  SP, STR, LMZ
      LAD  SP, R0, LP
      LAD  SP, SP, LP
      LAD  SP, STR, LP
      AND  SP, R0, LP
      AND  SP, SP, LP
      AND  SP, STR, LP
      LAD  SP, R0, LPZ
      LAD  SP, SP, LPZ
      LAD  SP, STR, LPZ
      AND  SP, R0, LPZ
      AND  SP, SP, LPZ
      AND  SP, STR, LPZ
      LAD  SP, R0, LM
      LAD  SP, SP, LM
      LAD  SP, STR, LM
      AND  SP, R0, LM
      AND  SP, SP, LM
      AND  SP, STR, LM
      LAD  STR, R0
      LAD  STR, SP
      LAD  STR, STR
      AND  STR, R0
      AND  STR, SP
      AND  STR, STR
      LAD  STR, R0, SKP
      LAD  STR, SP, SKP
      LAD  STR, STR, SKP
      AND  STR, R0, SKP
      AND  STR, SP, SKP
      AND  STR, STR, SKP
      LAD  STR, R0, M
      LAD  STR, SP, M
      LAD  STR, STR, M
      AND  STR, R0, M
      AND  STR, SP, M
      AND  STR, STR, M
      LAD  STR, R0, PZ
      LAD  STR, SP, PZ
      LAD  STR, STR, PZ
      AND  STR, R0, PZ
      AND  STR, SP, PZ
      AND  STR, STR, PZ
      LAD  STR, R0, Z
      LAD  STR, SP, Z
      LAD  STR, STR, Z
      AND  STR, R0, Z
      AND  STR, SP, Z
      AND  STR, STR, Z
      LAD  STR, R0, NZ
      LAD  STR, SP, NZ
      LAD  STR, STR, NZ
      AND  STR, R0, NZ
      AND  STR, SP, NZ
      AND  STR, STR, NZ
      LAD  STR, R0, MZ
      LAD  STR, SP, MZ
      LAD  STR, STR, MZ
      AND  STR, R0, MZ
      AND  STR, SP, MZ
      AND  STR, STR, MZ
      LAD  STR, R0, P
      LAD  STR, SP, P
      LAD  STR, STR, P
      AND  STR, R0, P
      AND  STR, SP, P
      AND  STR, STR, P
      LAD  STR, R0, EZ
      LAD  STR, SP, EZ
      LAD  STR, STR, EZ
      AND  STR, R0, EZ
      AND  STR, SP, EZ
      AND  STR, STR, EZ
      LAD  STR, R0, ENZ
      LAD  STR, SP, ENZ
      LAD  STR, STR, ENZ
      AND  STR, R0, ENZ
      AND  STR, SP, ENZ
      AND  STR, STR, ENZ
      LAD  STR, R0, OZ
      LAD  STR, SP, OZ
      LAD  STR, STR, OZ
      AND  STR, R0, OZ
      AND  STR, SP, OZ
      AND  STR, STR, OZ
      LAD  STR, R0, ONZ
      LAD  STR, SP, ONZ
      LAD  STR, STR, ONZ
      AND  STR, R0, ONZ
      AND  STR, SP, ONZ
      AND  STR, STR, ONZ
      LAD  STR, R0, LMZ
      LAD  STR, SP, LMZ
      LAD  STR, STR, LMZ
      AND  STR, R0, LMZ
      AND  STR, SP, LMZ
      AND  STR, STR, LMZ
      LAD  STR, R0, LP
      LAD  STR, SP, LP
      LAD  STR, STR, LP
      AND  STR, R0, LP
      AND  STR, SP, LP
      AND  STR, STR, LP
      LAD  STR, R0, LPZ
      LAD  STR, SP, LPZ
      LAD  STR, STR, LPZ
      AND  STR, R0, LPZ
      AND  STR, SP, LPZ
      AND  STR, STR, LPZ
      LAD  STR, R0, LM
      LAD  STR, SP, LM
      LAD  STR, STR, LM
      AND  STR, R0, LM
      AND  STR, SP, LM
      AND  STR, STR, LM
      DSWP R0, R0
      DSWP R0, SP
      DSWP R0, STR
      BSWP R0, R0
      BSWP R0, SP
      BSWP R0, STR
      DSWP R0, R0, SKP
      DSWP R0, SP, SKP
      DSWP R0, STR, SKP
      BSWP R0, R0, SKP
      BSWP R0, SP, SKP
      BSWP R0, STR, SKP
      DSWP R0, R0, M
      DSWP R0, SP, M
      DSWP R0, STR, M
      BSWP R0, R0, M
      BSWP R0, SP, M
      BSWP R0, STR, M
      DSWP R0, R0, PZ
      DSWP R0, SP, PZ
      DSWP R0, STR, PZ
      BSWP R0, R0, PZ
      BSWP R0, SP, PZ
      BSWP R0, STR, PZ
      DSWP R0, R0, Z
      DSWP R0, SP, Z
      DSWP R0, STR, Z
      BSWP R0, R0, Z
      BSWP R0, SP, Z
      BSWP R0, STR, Z
      DSWP R0, R0, NZ
      DSWP R0, SP, NZ
      DSWP R0, STR, NZ
      BSWP R0, R0, NZ
      BSWP R0, SP, NZ
      BSWP R0, STR, NZ
      DSWP R0, R0, MZ
      DSWP R0, SP, MZ
      DSWP R0, STR, MZ
      BSWP R0, R0, MZ
      BSWP R0, SP, MZ
      BSWP R0, STR, MZ
      DSWP R0, R0, P
      DSWP R0, SP, P
      DSWP R0, STR, P
      BSWP R0, R0, P
      BSWP R0, SP, P
      BSWP R0, STR, P
      DSWP R0, R0, EZ
      DSWP R0, SP, EZ
      DSWP R0, STR, EZ
      BSWP R0, R0, EZ
      BSWP R0, SP, EZ
      BSWP R0, STR, EZ
      DSWP R0, R0, ENZ
      DSWP R0, SP, ENZ
      DSWP R0, STR, ENZ
      BSWP R0, R0, ENZ
      BSWP R0, SP, ENZ
      BSWP R0, STR, ENZ
      DSWP R0, R0, OZ
      DSWP R0, SP, OZ
      DSWP R0, STR, OZ
      BSWP R0, R0, OZ
      BSWP R0, SP, OZ
      BSWP R0, STR, OZ
      DSWP R0, R0, ONZ
      DSWP R0, SP, ONZ
      DSWP R0, STR, ONZ
      BSWP R0, R0, ONZ
      BSWP R0, SP, ONZ
      BSWP R0, STR, ONZ
      DSWP R0, R0, LMZ
      DSWP R0, SP, LMZ
      DSWP R0, STR, LMZ
      BSWP R0, R0, LMZ
      BSWP R0, SP, LMZ
      BSWP R0, STR, LMZ
      DSWP R0, R0, LP
      DSWP R0, SP, LP
      DSWP R0, STR, LP
      BSWP R0, R0, LP
      BSWP R0, SP, LP
      BSWP R0, STR, LP
      DSWP R0, R0, LPZ
      DSWP R0, SP, LPZ
      DSWP R0, STR, LPZ
      BSWP R0, R0, LPZ
      BSWP R0, SP, LPZ
      BSWP R0, STR, LPZ
      DSWP R0, R0, LM
      DSWP R0, SP, LM
      DSWP R0, STR, LM
      BSWP R0, R0, LM
      BSWP R0, SP, LM
      BSWP R0, STR, LM
      DSWP SP, R0
      DSWP SP, SP
      DSWP SP, STR
      BSWP SP, R0
      BSWP SP, SP
      BSWP SP, STR
      DSWP SP, R0, SKP
      DSWP SP, SP, SKP
      DSWP SP, STR, SKP
      BSWP SP, R0, SKP
      BSWP SP, SP, SKP
      BSWP SP, STR, SKP
      DSWP SP, R0, M
      DSWP SP, SP, M
      DSWP SP, STR, M
      BSWP SP, R0, M
      BSWP SP, SP, M
      BSWP SP, STR, M
      DSWP SP, R0, PZ
      DSWP SP, SP, PZ
      DSWP SP, STR, PZ
      BSWP SP, R0, PZ
      BSWP SP, SP, PZ
      BSWP SP, STR, PZ
      DSWP SP, R0, Z
      DSWP SP, SP, Z
      DSWP SP, STR, Z
      BSWP SP, R0, Z
      BSWP SP, SP, Z
      BSWP SP, STR, Z
      DSWP SP, R0, NZ
      DSWP SP, SP, NZ
      DSWP SP, STR, NZ
      BSWP SP, R0, NZ
      BSWP SP, SP, NZ
      BSWP SP, STR, NZ
      DSWP SP, R0, MZ
      DSWP SP, SP, MZ
      DSWP SP, STR, MZ
      BSWP SP, R0, MZ
      BSWP SP, SP, MZ
      BSWP SP, STR, MZ
      DSWP SP, R0, P
      DSWP SP, SP, P
      DSWP SP, STR, P
      BSWP SP, R0, P
      BSWP SP, SP, P
      BSWP SP, STR, P
      DSWP SP, R0, EZ
      DSWP SP, SP, EZ
      DSWP SP, STR, EZ
      BSWP SP, R0, EZ
      BSWP SP, SP, EZ
      BSWP SP, STR, EZ
      DSWP SP, R0, ENZ
      DSWP SP, SP, ENZ
      DSWP SP, STR, ENZ
      BSWP SP, R0, ENZ
      BSWP SP, SP, ENZ
      BSWP SP, STR, ENZ
      DSWP SP, R0, OZ
      DSWP SP, SP, OZ
      DSWP SP, STR, OZ
      BSWP SP, R0, OZ
      BSWP SP, SP, OZ
      BSWP SP, STR, OZ
      DSWP SP, R0, ONZ
      DSWP SP, SP, ONZ
      DSWP SP, STR, ONZ
      BSWP SP, R0, ONZ
      BSWP SP, SP, ONZ
      BSWP SP, STR, ONZ
      DSWP SP, R0, LMZ
      DSWP SP, SP, LMZ
      DSWP SP, STR, LMZ
      BSWP SP, R0, LMZ
      BSWP SP, SP, LMZ
      BSWP SP, STR, LMZ
      DSWP SP, R0, LP
      DSWP SP, SP, LP
      DSWP SP, STR, LP
      BSWP SP, R0, LP
      BSWP SP, SP, LP
      BSWP SP, STR, LP
      DSWP SP, R0, LPZ
      DSWP SP, SP, LPZ
      DSWP SP, STR, LPZ
      BSWP SP, R0, LPZ
      BSWP SP, SP, LPZ
      BSWP SP, STR, LPZ
      DSWP SP, R0, LM
      DSWP SP, SP, LM
      DSWP SP, STR, LM
      BSWP SP, R0, LM
      BSWP SP, SP, LM
      BSWP SP, STR, LM
      DSWP STR, R0
      DSWP STR, SP
      DSWP STR, STR
      BSWP STR, R0
      BSWP STR, SP
      BSWP STR, STR
      DSWP STR, R0, SKP
      DSWP STR, SP, SKP
      DSWP STR, STR, SKP
      BSWP STR, R0, SKP
      BSWP STR, SP, SKP
      BSWP STR, STR, SKP
      DSWP STR, R0, M
      DSWP STR, SP, M
      DSWP STR, STR, M
      BSWP STR, R0, M
      BSWP STR, SP, M
      BSWP STR, STR, M
      DSWP STR, R0, PZ
      DSWP STR, SP, PZ
      DSWP STR, STR, PZ
      BSWP STR, R0, PZ
      BSWP STR, SP, PZ
      BSWP STR, STR, PZ
      DSWP STR, R0, Z
      DSWP STR, SP, Z
      DSWP STR, STR, Z
      BSWP STR, R0, Z
      BSWP STR, SP, Z
      BSWP STR, STR, Z
      DSWP STR, R0, NZ
      DSWP STR, SP, NZ
      DSWP STR, STR, NZ
      BSWP STR, R0, NZ
      BSWP STR, SP, NZ
      BSWP STR, STR, NZ
      DSWP STR, R0, MZ
      DSWP STR, SP, MZ
      DSWP STR, STR, MZ
      BSWP STR, R0, MZ
      BSWP STR, SP, MZ
      BSWP STR, STR, MZ
      DSWP STR, R0, P
      DSWP STR, SP, P
      DSWP STR, STR, P
      BSWP STR, R0, P
      BSWP STR, SP, P
      BSWP STR, STR, P
      DSWP STR, R0, EZ
      DSWP STR, SP, EZ
      DSWP STR, STR, EZ
      BSWP STR, R0, EZ
      BSWP STR, SP, EZ
      BSWP STR, STR, EZ
      DSWP STR, R0, ENZ
      DSWP STR, SP, ENZ
      DSWP STR, STR, ENZ
      BSWP STR, R0, ENZ
      BSWP STR, SP, ENZ
      BSWP STR, STR, ENZ
      DSWP STR, R0, OZ
      DSWP STR, SP, OZ
      DSWP STR, STR, OZ
      BSWP STR, R0, OZ
      BSWP STR, SP, OZ
      BSWP STR, STR, OZ
      DSWP STR, R0, ONZ
      DSWP STR, SP, ONZ
      DSWP STR, STR, ONZ
      BSWP STR, R0, ONZ
      BSWP STR, SP, ONZ
      BSWP STR, STR, ONZ
      DSWP STR, R0, LMZ
      DSWP STR, SP, LMZ
      DSWP STR, STR, LMZ
      BSWP STR, R0, LMZ
      BSWP STR, SP, LMZ
      BSWP STR, STR, LMZ
      DSWP STR, R0, LP
      DSWP STR, SP, LP
      DSWP STR, STR, LP
      BSWP STR, R0, LP
      BSWP STR, SP, LP
      BSWP STR, STR, LP
      DSWP STR, R0, LPZ
      DSWP STR, SP, LPZ
      DSWP STR, STR, LPZ
      BSWP STR, R0, LPZ
      BSWP STR, SP, LPZ
      BSWP STR, STR, LPZ
      DSWP STR, R0, LM
      DSWP STR, SP, LM
      DSWP STR, STR, LM
      BSWP STR, R0, LM
      BSWP STR, SP, LM
      BSWP STR, STR, LM
      MVB  R0, R0
      MVB  R0, SP
      MVB  R0, STR
      MV   R0, R0
      MV   R0, SP
      MV   R0, STR
      MVB  R0, R0, SKP
      MVB  R0, SP, SKP
      MVB  R0, STR, SKP
      MV   R0, R0, SKP
      MV   R0, SP, SKP
      MV   R0, STR, SKP
      MVB  R0, R0, M
      MVB  R0, SP, M
      MVB  R0, STR, M
      MV   R0, R0, M
      MV   R0, SP, M
      MV   R0, STR, M
      MVB  R0, R0, PZ
      MVB  R0, SP, PZ
      MVB  R0, STR, PZ
      MV   R0, R0, PZ
      MV   R0, SP, PZ
      MV   R0, STR, PZ
      MVB  R0, R0, Z
      MVB  R0, SP, Z
      MVB  R0, STR, Z
      MV   R0, R0, Z
      MV   R0, SP, Z
      MV   R0, STR, Z
      MVB  R0, R0, NZ
      MVB  R0, SP, NZ
      MVB  R0, STR, NZ
      MV   R0, R0, NZ
      MV   R0, SP, NZ
      MV   R0, STR, NZ
      MVB  R0, R0, MZ
      MVB  R0, SP, MZ
      MVB  R0, STR, MZ
      MV   R0, R0, MZ
      MV   R0, SP, MZ
      MV   R0, STR, MZ
      MVB  R0, R0, P
      MVB  R0, SP, P
      MVB  R0, STR, P
      MV   R0, R0, P
      MV   R0, SP, P
      MV   R0, STR, P
      MVB  R0, R0, EZ
      MVB  R0, SP, EZ
      MVB  R0, STR, EZ
      MV   R0, R0, EZ
      MV   R0, SP, EZ
      MV   R0, STR, EZ
      MVB  R0, R0, ENZ
      MVB  R0, SP, ENZ
      MVB  R0, STR, ENZ
      MV   R0, R0, ENZ
      MV   R0, SP, ENZ
      MV   R0, STR, ENZ
      MVB  R0, R0, OZ
      MVB  R0, SP, OZ
      MVB  R0, STR, OZ
      MV   R0, R0, OZ
      MV   R0, SP, OZ
      MV   R0, STR, OZ
      MVB  R0, R0, ONZ
      MVB  R0, SP, ONZ
      MVB  R0, STR, ONZ
      MV   R0, R0, ONZ
      MV   R0, SP, ONZ
      MV   R0, STR, ONZ
      MVB  R0, R0, LMZ
      MVB  R0, SP, LMZ
      MVB  R0, STR, LMZ
      MV   R0, R0, LMZ
      MV   R0, SP, LMZ
      MV   R0, STR, LMZ
      MVB  R0, R0, LP
      MVB  R0, SP, LP
      MVB  R0, STR, LP
      MV   R0, R0, LP
      MV   R0, SP, LP
      MV   R0, STR, LP
      MVB  R0, R0, LPZ
      MVB  R0, SP, LPZ
      MVB  R0, STR, LPZ
      MV   R0, R0, LPZ
      MV   R0, SP, LPZ
      MV   R0, STR, LPZ
      MVB  R0, R0, LM
      MVB  R0, SP, LM
      MVB  R0, STR, LM
      MV   R0, R0, LM
      MV   R0, SP, LM
      MV   R0, STR, LM
      MVB  SP, R0
      MVB  SP, SP
      MVB  SP, STR
      MV   SP, R0
      MV   SP, SP
      MV   SP, STR
      MVB  SP, R0, SKP
      MVB  SP, SP, SKP
      MVB  SP, STR, SKP
      MV   SP, R0, SKP
      MV   SP, SP, SKP
      MV   SP, STR, SKP
      MVB  SP, R0, M
      MVB  SP, SP, M
      MVB  SP, STR, M
      MV   SP, R0, M
      MV   SP, SP, M
      MV   SP, STR, M
      MVB  SP, R0, PZ
      MVB  SP, SP, PZ
      MVB  SP, STR, PZ
      MV   SP, R0, PZ
      MV   SP, SP, PZ
      MV   SP, STR, PZ
      MVB  SP, R0, Z
      MVB  SP, SP, Z
      MVB  SP, STR, Z
      MV   SP, R0, Z
      MV   SP, SP, Z
      MV   SP, STR, Z
      MVB  SP, R0, NZ
      MVB  SP, SP, NZ
      MVB  SP, STR, NZ
      MV   SP, R0, NZ
      MV   SP, SP, NZ
      MV   SP, STR, NZ
      MVB  SP, R0, MZ
      MVB  SP, SP, MZ
      MVB  SP, STR, MZ
      MV   SP, R0, MZ
      MV   SP, SP, MZ
      MV   SP, STR, MZ
      MVB  SP, R0, P
      MVB  SP, SP, P
      MVB  SP, STR, P
      MV   SP, R0, P
      MV   SP, SP, P
      MV   SP, STR, P
      MVB  SP, R0, EZ
      MVB  SP, SP, EZ
      MVB  SP, STR, EZ
      MV   SP, R0, EZ
      MV   SP, SP, EZ
      MV   SP, STR, EZ
      MVB  SP, R0, ENZ
      MVB  SP, SP, ENZ
      MVB  SP, STR, ENZ
      MV   SP, R0, ENZ
      MV   SP, SP, ENZ
      MV   SP, STR, ENZ
      MVB  SP, R0, OZ
      MVB  SP, SP, OZ
      MVB  SP, STR, OZ
      MV   SP, R0, OZ
      MV   SP, SP, OZ
      MV   SP, STR, OZ
      MVB  SP, R0, ONZ
      MVB  SP, SP, ONZ
      MVB  SP, STR, ONZ
      MV   SP, R0, ONZ
      MV   SP, SP, ONZ
      MV   SP, STR, ONZ
      MVB  SP, R0, LMZ
      MVB  SP, SP, LMZ
      MVB  SP, STR, LMZ
      MV   SP, R0, LMZ
      MV   SP, SP, LMZ
      MV   SP, STR, LMZ
      MVB  SP, R0, LP
      MVB  SP, SP, LP
      MVB  SP, STR, LP
      MV   SP, R0, LP
      MV   SP, SP, LP
      MV   SP, STR, LP
      MVB  SP, R0, LPZ
      MVB  SP, SP, LPZ
      MVB  SP, STR, LPZ
      MV   SP, R0, LPZ
      MV   SP, SP, LPZ
      MV   SP, STR, LPZ
      MVB  SP, R0, LM
      MVB  SP, SP, LM
      MVB  SP, STR, LM
      MV   SP, R0, LM
      MV   SP, SP, LM
      MV   SP, STR, LM
      MVB  STR, R0
      MVB  STR, SP
      MVB  STR, STR
      MV   STR, R0
      MV   STR, SP
      MV   STR, STR
      MVB  STR, R0, SKP
      MVB  STR, SP, SKP
      MVB  STR, STR, SKP
      MV   STR, R0, SKP
      MV   STR, SP, SKP
      MV   STR, STR, SKP
      MVB  STR, R0, M
      MVB  STR, SP, M
      MVB  STR, STR, M
      MV   STR, R0, M
      MV   STR, SP, M
      MV   STR, STR, M
      MVB  STR, R0, PZ
      MVB  STR, SP, PZ
      MVB  STR, STR, PZ
      MV   STR, R0, PZ
      MV   STR, SP, PZ
      MV   STR, STR, PZ
      MVB  STR, R0, Z
      MVB  STR, SP, Z
      MVB  STR, STR, Z
      MV   STR, R0, Z
      MV   STR, SP, Z
      MV   STR, STR, Z
      MVB  STR, R0, NZ
      MVB  STR, SP, NZ
      MVB  STR, STR, NZ
      MV   STR, R0, NZ
      MV   STR, SP, NZ
      MV   STR, STR, NZ
      MVB  STR, R0, MZ
      MVB  STR, SP, MZ
      MVB  STR, STR, MZ
      MV   STR, R0, MZ
      MV   STR, SP, MZ
      MV   STR, STR, MZ
      MVB  STR, R0, P
      MVB  STR, SP, P
      MVB  STR, STR, P
      MV   STR, R0, P
      MV   STR, SP, P
      MV   STR, STR, P
      MVB  STR, R0, EZ
      MVB  STR, SP, EZ
      MVB  STR, STR, EZ
      MV   STR, R0, EZ
      MV   STR, SP, EZ
      MV   STR, STR, EZ
      MVB  STR, R0, ENZ
      MVB  STR, SP, ENZ
      MVB  STR, STR, ENZ
      MV   STR, R0, ENZ
      MV   STR, SP, ENZ
      MV   STR, STR, ENZ
      MVB  STR, R0, OZ
      MVB  STR, SP, OZ
      MVB  STR, STR, OZ
      MV   STR, R0, OZ
      MV   STR, SP, OZ
      MV   STR, STR, OZ
      MVB  STR, R0, ONZ
      MVB  STR, SP, ONZ
      MVB  STR, STR, ONZ
      MV   STR, R0, ONZ
      MV   STR, SP, ONZ
      MV   STR, STR, ONZ
      MVB  STR, R0, LMZ
      MVB  STR, SP, LMZ
      MVB  STR, STR, LMZ
      MV   STR, R0, LMZ
      MV   STR, SP, LMZ
      MV   STR, STR, LMZ
      MVB  STR, R0, LP
      MVB  STR, SP, LP
      MVB  STR, STR, LP
      MV   STR, R0, LP
      MV   STR, SP, LP
      MV   STR, STR, LP
      MVB  STR, R0, LPZ
      MVB  STR, SP, LPZ
      MVB  STR, STR, LPZ
      MV   STR, R0, LPZ
      MV   STR, SP, LPZ
      MV   STR, STR, LPZ
      MVB  STR, R0, LM
      MVB  STR, SP, LM
      MVB  STR, STR, LM
      MV   STR, R0, LM
      MV   STR, SP, LM
      MV   STR, STR, LM
      ST   R0, 0x00
      ST   SP, 0x00
      DMS  0x00
      BAL  0x00
      ST   R0, *
      ST   R0, *+1
      ST   R0, *-128
      ST   SP, *
      ST   SP, *+1
      ST   SP, *-128
      DMS  *
      DMS  *+1
      DMS  *-128
      BAL  *
      BAL  *+1
      BAL  *-128
      ST   R0, (0x00)
      ST   SP, (0x00)
      DMS  (0x00)
      BAL  (0x00)
      ST   R0, (*)
      ST   R0, (*+1)
      ST   R0, (*-128)
      ST   SP, (*)
      ST   SP, (*+1)
      ST   SP, (*-128)
      DMS  (*)
      DMS  (*+1)
      DMS  (*-128)
      BAL  (*)
      BAL  (*+1)
      BAL  (*-128)
      ST   R0, 0(X0)
      ST   SP, 0(X0)
      DMS  0(X0)
      BAL  0(X0)
      ST   R0, (0x00)(X0)
      ST   SP, (0x00)(X0)
      DMS  (0x00)(X0)
      BAL  (0x00)(X0)
      L    R0, 0x00
      L    SP, 0x00
      IMS  0x00
      B    0x00
      L    R0, *
      L    R0, *+1
      L    R0, *-128
      L    SP, *
      L    SP, *+1
      L    SP, *-128
      IMS  *
      IMS  *+1
      IMS  *-128
      B    *
      B    *+1
      B    *-128
      L    R0, (0x00)
      L    SP, (0x00)
      IMS  (0x00)
      B    (0x00)
      L    R0, (*)
      L    R0, (*+1)
      L    R0, (*-128)
      L    SP, (*)
      L    SP, (*+1)
      L    SP, (*-128)
      IMS  (*)
      IMS  (*+1)
      IMS  (*-128)
      B    (*)
      B    (*+1)
      B    (*-128)
      L    R0, 0(X0)
      L    SP, 0(X0)
      IMS  0(X0)
      B    0(X0)
      L    R0, (0x00)(X0)
      L    SP, (0x00)(X0)
      IMS  (0x00)(X0)
      B    (0x00)(X0)
