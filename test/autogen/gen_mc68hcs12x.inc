;;; AUTO GENERATED FILE
;;; generated by: gen_mc68hc12 -i -u -C 68HCS12X -o gen_mc68hcs12x.inc -l gen_mc68hcs12x.lst
      BGND
      MEM
      INY
      DEY
      DBEQ  X, *+9
      DBEQ  Y, *+10
      DBEQ  SP, *+11
      DBEQ  A, *-236
      DBEQ  B, *-235
      DBEQ  D, *-232
      DBNE  A, *+36
      DBNE  B, *+37
      DBNE  D, *+40
      DBNE  X, *+41
      DBNE  Y, *+42
      DBNE  SP, *+43
      TBEQ  A, *+68
      TBEQ  B, *+69
      TBEQ  D, *+72
      TBEQ  X, *+73
      TBEQ  Y, *+74
      TBEQ  SP, *+75
      TBNE  A, *+100
      TBNE  B, *+101
      TBNE  D, *+104
      TBNE  X, *+105
      TBNE  Y, *+106
      TBNE  SP, *+107
      IBEQ  A, *+132
      IBEQ  B, *+133
      IBEQ  D, *+136
      IBEQ  X, *+137
      IBEQ  Y, *+138
      IBEQ  SP, *+139
      IBNE  A, *+164
      IBNE  B, *+165
      IBNE  D, *+168
      IBNE  X, *+169
      IBNE  Y, *+170
      IBNE  SP, *+171
      JMP   6,X
      JMP   1,+X
      JMP   8,-X
      JMP   1,X+
      JMP   8,X-
      JMP   0,Y
      JMP   1,+Y
      JMP   8,-Y
      JMP   1,Y+
      JMP   8,Y-
      JMP   0,SP
      JMP   1,+SP
      JMP   8,-SP
      JMP   1,SP+
      JMP   8,SP-
      JMP   $0190,PC
      JMP   $E1,X
      JMP   $E3E4,X
      JMP   [$E4E5,X]
      JMP   A,X
      JMP   B,X
      JMP   D,X
      JMP   [D,X]
      JMP   $E9,Y
      JMP   $EBEC,Y
      JMP   [$ECED,Y]
      JMP   A,Y
      JMP   B,Y
      JMP   D,Y
      JMP   [D,Y]
      JMP   $F1,SP
      JMP   $F3F4,SP
      JMP   [$F4F5,SP]
      JMP   A,SP
      JMP   B,SP
      JMP   D,SP
      JMP   [D,SP]
      JMP   $02C5,PC
      JMP   <$01CF,PC
      JMP   $FDCF,PC
      JMP   >$00D7,PC
      JMP   [$FED8,PC]
      JMP   A,PC
      JMP   B,PC
      JMP   D,PC
      JMP   [D,PC]
      JMP   $0708
      JMP   >$0001
      BSR   *+10
      INX
      DEX
      RTC
      RTI
      BSET  13,X, #14
      BSET  1,+X, #$21
      BSET  8,-X, #$29
      BSET  1,X+, #$31
      BSET  8,X-, #$39
      BSET  0,Y, #$41
      BSET  1,+Y, #$61
      BSET  8,-Y, #$69
      BSET  1,Y+, #$71
      BSET  8,Y-, #$79
      BSET  0,SP, #$81
      BSET  1,+SP, #$A1
      BSET  8,-SP, #$A9
      BSET  1,SP+, #$B1
      BSET  8,SP-, #$B9
      BSET  $021F,PC, #$C1
      BSET  $E1,X, #$E2
      BSET  $E3E4,X, #$E5
      BSET  A,X, #$E5
      BSET  B,X, #$E6
      BSET  D,X, #$E7
      BSET  $E9,Y, #$EA
      BSET  $EBEC,Y, #$ED
      BSET  A,Y, #$ED
      BSET  B,Y, #$EE
      BSET  D,Y, #$EF
      BSET  $F1,SP, #$F2
      BSET  $F3F4,SP, #$F5
      BSET  A,SP, #$F5
      BSET  B,SP, #$F6
      BSET  D,SP, #$F7
      BSET  $0352,PC, #$FA
      BSET  <$025D,PC, #1
      BSET  $FE5E,PC, #$FD
      BSET  >$0167,PC, #1
      BSET  A,PC, #$FD
      BSET  B,PC, #$FE
      BSET  D,PC, #$FF
      BCLR  14,X, #15
      BCLR  1,+X, #$21
      BCLR  8,-X, #$29
      BCLR  1,X+, #$31
      BCLR  8,X-, #$39
      BCLR  0,Y, #$41
      BCLR  1,+Y, #$61
      BCLR  8,-Y, #$69
      BCLR  1,Y+, #$71
      BCLR  8,Y-, #$79
      BCLR  0,SP, #$81
      BCLR  1,+SP, #$A1
      BCLR  8,-SP, #$A9
      BCLR  1,SP+, #$B1
      BCLR  8,SP-, #$B9
      BCLR  $02A0,PC, #$C1
      BCLR  $E1,X, #$E2
      BCLR  $E3E4,X, #$E5
      BCLR  A,X, #$E5
      BCLR  B,X, #$E6
      BCLR  D,X, #$E7
      BCLR  $E9,Y, #$EA
      BCLR  $EBEC,Y, #$ED
      BCLR  A,Y, #$ED
      BCLR  B,Y, #$EE
      BCLR  D,Y, #$EF
      BCLR  $F1,SP, #$F2
      BCLR  $F3F4,SP, #$F5
      BCLR  A,SP, #$F5
      BCLR  B,SP, #$F6
      BCLR  D,SP, #$F7
      BCLR  $03D3,PC, #$FA
      BCLR  <$02DE,PC, #1
      BCLR  $FEDF,PC, #$FD
      BCLR  >$01E8,PC, #1
      BCLR  A,PC, #$FD
      BCLR  B,PC, #$FE
      BCLR  D,PC, #$FF
      BRSET 15,X, #16, *+21
      BRSET 1,+X, #$21, *+38
      BRSET 8,-X, #$29, *+46
      BRSET 1,X+, #$31, *+54
      BRSET 8,X-, #$39, *+62
      BRSET 0,Y, #$41, *+70
      BRSET 1,+Y, #$61, *+102
      BRSET 8,-Y, #$69, *+110
      BRSET 1,Y+, #$71, *+118
      BRSET 8,Y-, #$79, *+126
      BRSET 0,SP, #$81, *-122
      BRSET 1,+SP, #$A1, *-90
      BRSET 8,-SP, #$A9, *-82
      BRSET 1,SP+, #$B1, *-74
      BRSET 8,SP-, #$B9, *-66
      BRSET $0331,PC, #$C1, *-58
      BRSET $E1,X, #$E2, *-24
      BRSET $E3E4,X, #$E5, *-20
      BRSET A,X, #$E5, *-22
      BRSET B,X, #$E6, *-21
      BRSET D,X, #$E7, *-20
      BRSET $E9,Y, #$EA, *-16
      BRSET $EBEC,Y, #$ED, *-12
      BRSET A,Y, #$ED, *-14
      BRSET B,Y, #$EE, *-13
      BRSET D,Y, #$EF, *-12
      BRSET $F1,SP, #$F2, *-8
      BRSET $F3F4,SP, #$F5, *-4
      BRSET A,SP, #$F5, *-6
      BRSET B,SP, #$F6, *-5
      BRSET D,SP, #$F7, *-4
      BRSET $0474,PC, #$FA, *
      BRSET <$0380,PC, #1, *+7
      BRSET $FF82,PC, #$FD, *+4
      BRSET >$028C,PC, #1, *+8
      BRSET A,PC, #$FD, *+2
      BRSET B,PC, #$FE, *+3
      BRSET D,PC, #$FF, *+4
      BRCLR -16,X, #17, *+22
      BRCLR 1,+X, #$21, *+38
      BRCLR 8,-X, #$29, *+46
      BRCLR 1,X+, #$31, *+54
      BRCLR 8,X-, #$39, *+62
      BRCLR 0,Y, #$41, *+70
      BRCLR 1,+Y, #$61, *+102
      BRCLR 8,-Y, #$69, *+110
      BRCLR 1,Y+, #$71, *+118
      BRCLR 8,Y-, #$79, *+126
      BRCLR 0,SP, #$81, *-122
      BRCLR 1,+SP, #$A1, *-90
      BRCLR 8,-SP, #$A9, *-82
      BRCLR 1,SP+, #$B1, *-74
      BRCLR 8,SP-, #$B9, *-66
      BRCLR $03D8,PC, #$C1, *-58
      BRCLR $E1,X, #$E2, *-24
      BRCLR $E3E4,X, #$E5, *-20
      BRCLR A,X, #$E5, *-22
      BRCLR B,X, #$E6, *-21
      BRCLR D,X, #$E7, *-20
      BRCLR $E9,Y, #$EA, *-16
      BRCLR $EBEC,Y, #$ED, *-12
      BRCLR A,Y, #$ED, *-14
      BRCLR B,Y, #$EE, *-13
      BRCLR D,Y, #$EF, *-12
      BRCLR $F1,SP, #$F2, *-8
      BRCLR $F3F4,SP, #$F5, *-4
      BRCLR A,SP, #$F5, *-6
      BRCLR B,SP, #$F6, *-5
      BRCLR D,SP, #$F7, *-4
      BRCLR $051B,PC, #$FA, *
      BRCLR <$0427,PC, #1, *+7
      BRCLR $0029,PC, #$FD, *+4
      BRCLR >$0333,PC, #1, *+8
      BRCLR A,PC, #$FD, *+2
      BRCLR B,PC, #$FE, *+3
      BRCLR D,PC, #$FF, *+4
      ANDCC #17
      EDIV
      MUL
      EMUL
      ORCC  #21
      JSR   -10,X
      JSR   1,+X
      JSR   8,-X
      JSR   1,X+
      JSR   8,X-
      JSR   0,Y
      JSR   1,+Y
      JSR   8,-Y
      JSR   1,Y+
      JSR   8,Y-
      JSR   0,SP
      JSR   1,+SP
      JSR   8,-SP
      JSR   1,SP+
      JSR   8,SP-
      JSR   $0466,PC
      JSR   $E1,X
      JSR   $E3E4,X
      JSR   [$E4E5,X]
      JSR   A,X
      JSR   B,X
      JSR   D,X
      JSR   [D,X]
      JSR   $E9,Y
      JSR   $EBEC,Y
      JSR   [$ECED,Y]
      JSR   A,Y
      JSR   B,Y
      JSR   D,Y
      JSR   [D,Y]
      JSR   $F1,SP
      JSR   $F3F4,SP
      JSR   [$F4F5,SP]
      JSR   A,SP
      JSR   B,SP
      JSR   D,SP
      JSR   [D,SP]
      JSR   $059B,PC
      JSR   <$04A5,PC
      JSR   $00A5,PC
      JSR   >$03AD,PC
      JSR   [$01AE,PC]
      JSR   A,PC
      JSR   B,PC
      JSR   D,PC
      JSR   [D,PC]
      JSR   $1718
      JSR   >$0001
      JSR   $18
      MINA  -6,X
      MINA  1,+X
      MINA  8,-X
      MINA  1,X+
      MINA  8,X-
      MINA  0,Y
      MINA  1,+Y
      MINA  8,-Y
      MINA  1,Y+
      MINA  8,Y-
      MINA  0,SP
      MINA  1,+SP
      MINA  8,-SP
      MINA  1,SP+
      MINA  8,SP-
      MINA  $04F1,PC
      MINA  $E1,X
      MINA  $E3E4,X
      MINA  [$E4E5,X]
      MINA  A,X
      MINA  B,X
      MINA  D,X
      MINA  [D,X]
      MINA  $E9,Y
      MINA  $EBEC,Y
      MINA  [$ECED,Y]
      MINA  A,Y
      MINA  B,Y
      MINA  D,Y
      MINA  [D,Y]
      MINA  $F1,SP
      MINA  $F3F4,SP
      MINA  [$F4F5,SP]
      MINA  A,SP
      MINA  B,SP
      MINA  D,SP
      MINA  [D,SP]
      MINA  $063C,PC
      MINA  <$0547,PC
      MINA  $0148,PC
      MINA  >$0451,PC
      MINA  [$0253,PC]
      MINA  A,PC
      MINA  B,PC
      MINA  D,PC
      MINA  [D,PC]
      EMAXD -5,X
      EMAXD 1,+X
      EMAXD 8,-X
      EMAXD 1,X+
      EMAXD 8,X-
      EMAXD 0,Y
      EMAXD 1,+Y
      EMAXD 8,-Y
      EMAXD 1,Y+
      EMAXD 8,Y-
      EMAXD 0,SP
      EMAXD 1,+SP
      EMAXD 8,-SP
      EMAXD 1,SP+
      EMAXD 8,SP-
      EMAXD $0592,PC
      EMAXD $E1,X
      EMAXD $E3E4,X
      EMAXD [$E4E5,X]
      EMAXD A,X
      EMAXD B,X
      EMAXD D,X
      EMAXD [D,X]
      EMAXD $E9,Y
      EMAXD $EBEC,Y
      EMAXD [$ECED,Y]
      EMAXD A,Y
      EMAXD B,Y
      EMAXD D,Y
      EMAXD [D,Y]
      EMAXD $F1,SP
      EMAXD $F3F4,SP
      EMAXD [$F4F5,SP]
      EMAXD A,SP
      EMAXD B,SP
      EMAXD D,SP
      EMAXD [D,SP]
      EMAXD $06DD,PC
      EMAXD <$05E8,PC
      EMAXD $01E9,PC
      EMAXD >$04F2,PC
      EMAXD [$02F4,PC]
      EMAXD A,PC
      EMAXD B,PC
      EMAXD D,PC
      EMAXD [D,PC]
      EMIND -4,X
      EMIND 1,+X
      EMIND 8,-X
      EMIND 1,X+
      EMIND 8,X-
      EMIND 0,Y
      EMIND 1,+Y
      EMIND 8,-Y
      EMIND 1,Y+
      EMIND 8,Y-
      EMIND 0,SP
      EMIND 1,+SP
      EMIND 8,-SP
      EMIND 1,SP+
      EMIND 8,SP-
      EMIND $0633,PC
      EMIND $E1,X
      EMIND $E3E4,X
      EMIND [$E4E5,X]
      EMIND A,X
      EMIND B,X
      EMIND D,X
      EMIND [D,X]
      EMIND $E9,Y
      EMIND $EBEC,Y
      EMIND [$ECED,Y]
      EMIND A,Y
      EMIND B,Y
      EMIND D,Y
      EMIND [D,Y]
      EMIND $F1,SP
      EMIND $F3F4,SP
      EMIND [$F4F5,SP]
      EMIND A,SP
      EMIND B,SP
      EMIND D,SP
      EMIND [D,SP]
      EMIND $077E,PC
      EMIND <$0689,PC
      EMIND $028A,PC
      EMIND >$0593,PC
      EMIND [$0395,PC]
      EMIND A,PC
      EMIND B,PC
      EMIND D,PC
      EMIND [D,PC]
      MAXM  -3,X
      MAXM  1,+X
      MAXM  8,-X
      MAXM  1,X+
      MAXM  8,X-
      MAXM  0,Y
      MAXM  1,+Y
      MAXM  8,-Y
      MAXM  1,Y+
      MAXM  8,Y-
      MAXM  0,SP
      MAXM  1,+SP
      MAXM  8,-SP
      MAXM  1,SP+
      MAXM  8,SP-
      MAXM  $06D4,PC
      MAXM  $E1,X
      MAXM  $E3E4,X
      MAXM  [$E4E5,X]
      MAXM  A,X
      MAXM  B,X
      MAXM  D,X
      MAXM  [D,X]
      MAXM  $E9,Y
      MAXM  $EBEC,Y
      MAXM  [$ECED,Y]
      MAXM  A,Y
      MAXM  B,Y
      MAXM  D,Y
      MAXM  [D,Y]
      MAXM  $F1,SP
      MAXM  $F3F4,SP
      MAXM  [$F4F5,SP]
      MAXM  A,SP
      MAXM  B,SP
      MAXM  D,SP
      MAXM  [D,SP]
      MAXM  $081F,PC
      MAXM  <$072A,PC
      MAXM  $032B,PC
      MAXM  >$0634,PC
      MAXM  [$0436,PC]
      MAXM  A,PC
      MAXM  B,PC
      MAXM  D,PC
      MAXM  [D,PC]
      MINM  -2,X
      MINM  1,+X
      MINM  8,-X
      MINM  1,X+
      MINM  8,X-
      MINM  0,Y
      MINM  1,+Y
      MINM  8,-Y
      MINM  1,Y+
      MINM  8,Y-
      MINM  0,SP
      MINM  1,+SP
      MINM  8,-SP
      MINM  1,SP+
      MINM  8,SP-
      MINM  $0775,PC
      MINM  $E1,X
      MINM  $E3E4,X
      MINM  [$E4E5,X]
      MINM  A,X
      MINM  B,X
      MINM  D,X
      MINM  [D,X]
      MINM  $E9,Y
      MINM  $EBEC,Y
      MINM  [$ECED,Y]
      MINM  A,Y
      MINM  B,Y
      MINM  D,Y
      MINM  [D,Y]
      MINM  $F1,SP
      MINM  $F3F4,SP
      MINM  [$F4F5,SP]
      MINM  A,SP
      MINM  B,SP
      MINM  D,SP
      MINM  [D,SP]
      MINM  $08C0,PC
      MINM  <$07CB,PC
      MINM  $03CC,PC
      MINM  >$06D5,PC
      MINM  [$04D7,PC]
      MINM  A,PC
      MINM  B,PC
      MINM  D,PC
      MINM  [D,PC]
      EMAXM -1,X
      EMAXM 1,+X
      EMAXM 8,-X
      EMAXM 1,X+
      EMAXM 8,X-
      EMAXM 0,Y
      EMAXM 1,+Y
      EMAXM 8,-Y
      EMAXM 1,Y+
      EMAXM 8,Y-
      EMAXM 0,SP
      EMAXM 1,+SP
      EMAXM 8,-SP
      EMAXM 1,SP+
      EMAXM 8,SP-
      EMAXM $0816,PC
      EMAXM $E1,X
      EMAXM $E3E4,X
      EMAXM [$E4E5,X]
      EMAXM A,X
      EMAXM B,X
      EMAXM D,X
      EMAXM [D,X]
      EMAXM $E9,Y
      EMAXM $EBEC,Y
      EMAXM [$ECED,Y]
      EMAXM A,Y
      EMAXM B,Y
      EMAXM D,Y
      EMAXM [D,Y]
      EMAXM $F1,SP
      EMAXM $F3F4,SP
      EMAXM [$F4F5,SP]
      EMAXM A,SP
      EMAXM B,SP
      EMAXM D,SP
      EMAXM [D,SP]
      EMAXM $0961,PC
      EMAXM <$086C,PC
      EMAXM $046D,PC
      EMAXM >$0776,PC
      EMAXM [$0578,PC]
      EMAXM A,PC
      EMAXM B,PC
      EMAXM D,PC
      EMAXM [D,PC]
      EMINM 1,+X
      EMINM 8,-X
      EMINM 1,X+
      EMINM 8,X-
      EMINM 0,Y
      EMINM 1,+Y
      EMINM 8,-Y
      EMINM 1,Y+
      EMINM 8,Y-
      EMINM 0,SP
      EMINM 1,+SP
      EMINM 8,-SP
      EMINM 1,SP+
      EMINM 8,SP-
      EMINM $08B4,PC
      EMINM $E1,X
      EMINM $E3E4,X
      EMINM [$E4E5,X]
      EMINM A,X
      EMINM B,X
      EMINM D,X
      EMINM [D,X]
      EMINM $E9,Y
      EMINM $EBEC,Y
      EMINM [$ECED,Y]
      EMINM A,Y
      EMINM B,Y
      EMINM D,Y
      EMINM [D,Y]
      EMINM $F1,SP
      EMINM $F3F4,SP
      EMINM [$F4F5,SP]
      EMINM A,SP
      EMINM B,SP
      EMINM D,SP
      EMINM [D,SP]
      EMINM $09FF,PC
      EMINM <$090A,PC
      EMINM $050B,PC
      EMINM >$0814,PC
      EMINM [$0616,PC]
      EMINM A,PC
      EMINM B,PC
      EMINM D,PC
      EMINM [D,PC]
      EMINM 0,X
      LBRA  *+$2126
      LBRN  *+$2227
      LBHI  *+$2328
      LBLS  *+$2429
      LBCC  *+$252A
      LBCS  *+$262B
      LBNE  *+$272C
      LBEQ  *+$282D
      LBVC  *+$292E
      LBVS  *+$2A2F
      LBPL  *+$2B30
      LBMI  *+$2C31
      LBGE  *+$2D32
      LBLT  *+$2E33
      LBGT  *+$2F34
      LBLE  *+$3035
      TRAP  $30
      BTAS  $36, #$37
      BTAS  $3738, #$39
      BTAS  >$0001, #2
      BTAS  8,X-, #$39
      BTAS  0,Y, #$41
      BTAS  1,+Y, #$61
      BTAS  8,-Y, #$69
      BTAS  1,Y+, #$71
      BTAS  8,Y-, #$79
      BTAS  0,SP, #$81
      BTAS  1,+SP, #$A1
      BTAS  8,-SP, #$A9
      BTAS  1,SP+, #$B1
      BTAS  8,SP-, #$B9
      BTAS  $09A8,PC, #$C1
      BTAS  $E1,X, #$E2
      BTAS  $E3E4,X, #$E5
      BTAS  A,X, #$E5
      BTAS  B,X, #$E6
      BTAS  D,X, #$E7
      BTAS  $E9,Y, #$EA
      BTAS  $EBEC,Y, #$ED
      BTAS  A,Y, #$ED
      BTAS  B,Y, #$EE
      BTAS  D,Y, #$EF
      BTAS  $F1,SP, #$F2
      BTAS  $F3F4,SP, #$F5
      BTAS  A,SP, #$F5
      BTAS  B,SP, #$F6
      BTAS  D,SP, #$F7
      BTAS  $0AEB,PC, #$FA
      BTAS  <$09F7,PC, #1
      BTAS  $05F9,PC, #$FD
      BTAS  >$0903,PC, #1
      BTAS  A,PC, #$FD
      BTAS  B,PC, #$FE
      BTAS  D,PC, #$FF
      BTAS  0,X, #1
      BTAS  1,+X, #$21
      BTAS  8,-X, #$29
      BTAS  1,X+, #$31
      PULCW
      PSHCW
      REV
      REVW
      WAV
      TBL   2,X-
      TBL   0,Y
      TBL   1,+Y
      TBL   8,-Y
      TBL   1,Y+
      TBL   8,Y-
      TBL   0,SP
      TBL   1,+SP
      TBL   8,-SP
      TBL   1,SP+
      TBL   8,SP-
      TBL   $0A4D,PC
      TBL   A,X
      TBL   B,X
      TBL   D,X
      TBL   A,Y
      TBL   B,Y
      TBL   D,Y
      TBL   A,SP
      TBL   B,SP
      TBL   D,SP
      TBL   A,PC
      TBL   B,PC
      TBL   D,PC
      TBL   0,X
      TBL   1,+X
      TBL   8,-X
      TBL   1,X+
      STOP
      ETBL  0,Y
      ETBL  1,+Y
      ETBL  8,-Y
      ETBL  1,Y+
      ETBL  8,Y-
      ETBL  0,SP
      ETBL  1,+SP
      ETBL  8,-SP
      ETBL  1,SP+
      ETBL  8,SP-
      ETBL  $0AA0,PC
      ETBL  A,X
      ETBL  B,X
      ETBL  D,X
      ETBL  A,Y
      ETBL  B,Y
      ETBL  D,Y
      ETBL  A,SP
      ETBL  B,SP
      ETBL  D,SP
      ETBL  A,PC
      ETBL  B,PC
      ETBL  D,PC
      ETBL  0,X
      ETBL  1,+X
      ETBL  8,-X
      ETBL  1,X+
      ETBL  8,X-
      NEGX
      COMX
      INCX
      DECX
      LSRX
      ROLX
      RORX
      ASRX
      ASLX
      NEGY
      COMY
      INCY
      DECY
      LSRY
      ROLY
      RORY
      ASRY
      ASLY
      GSTAA $5B
      GSTAB $5C
      GSTD  $5D
      GSTY  $5E
      GSTX  $5F
      GSTS  $60
      NEGW  2,+Y
      NEGW  8,-Y
      NEGW  1,Y+
      NEGW  8,Y-
      NEGW  0,SP
      NEGW  1,+SP
      NEGW  8,-SP
      NEGW  1,SP+
      NEGW  8,SP-
      NEGW  $0B27,PC
      NEGW  $E1,X
      NEGW  $E3E4,X
      NEGW  [$E4E5,X]
      NEGW  A,X
      NEGW  B,X
      NEGW  D,X
      NEGW  [D,X]
      NEGW  $E9,Y
      NEGW  $EBEC,Y
      NEGW  [$ECED,Y]
      NEGW  A,Y
      NEGW  B,Y
      NEGW  D,Y
      NEGW  [D,Y]
      NEGW  $F1,SP
      NEGW  $F3F4,SP
      NEGW  [$F4F5,SP]
      NEGW  A,SP
      NEGW  B,SP
      NEGW  D,SP
      NEGW  [D,SP]
      NEGW  $0C72,PC
      NEGW  <$0B7D,PC
      NEGW  $077E,PC
      NEGW  >$0A87,PC
      NEGW  [$0889,PC]
      NEGW  A,PC
      NEGW  B,PC
      NEGW  D,PC
      NEGW  [D,PC]
      NEGW  0,X
      NEGW  1,+X
      NEGW  8,-X
      NEGW  1,X+
      NEGW  8,X-
      NEGW  0,Y
      COMW  3,+Y
      COMW  8,-Y
      COMW  1,Y+
      COMW  8,Y-
      COMW  0,SP
      COMW  1,+SP
      COMW  8,-SP
      COMW  1,SP+
      COMW  8,SP-
      COMW  $0BC8,PC
      COMW  $E1,X
      COMW  $E3E4,X
      COMW  [$E4E5,X]
      COMW  A,X
      COMW  B,X
      COMW  D,X
      COMW  [D,X]
      COMW  $E9,Y
      COMW  $EBEC,Y
      COMW  [$ECED,Y]
      COMW  A,Y
      COMW  B,Y
      COMW  D,Y
      COMW  [D,Y]
      COMW  $F1,SP
      COMW  $F3F4,SP
      COMW  [$F4F5,SP]
      COMW  A,SP
      COMW  B,SP
      COMW  D,SP
      COMW  [D,SP]
      COMW  $0D13,PC
      COMW  <$0C1E,PC
      COMW  $081F,PC
      COMW  >$0B28,PC
      COMW  [$092A,PC]
      COMW  A,PC
      COMW  B,PC
      COMW  D,PC
      COMW  [D,PC]
      COMW  0,X
      COMW  1,+X
      COMW  8,-X
      COMW  1,X+
      COMW  8,X-
      COMW  0,Y
      INCW  4,+Y
      INCW  8,-Y
      INCW  1,Y+
      INCW  8,Y-
      INCW  0,SP
      INCW  1,+SP
      INCW  8,-SP
      INCW  1,SP+
      INCW  8,SP-
      INCW  $0C69,PC
      INCW  $E1,X
      INCW  $E3E4,X
      INCW  [$E4E5,X]
      INCW  A,X
      INCW  B,X
      INCW  D,X
      INCW  [D,X]
      INCW  $E9,Y
      INCW  $EBEC,Y
      INCW  [$ECED,Y]
      INCW  A,Y
      INCW  B,Y
      INCW  D,Y
      INCW  [D,Y]
      INCW  $F1,SP
      INCW  $F3F4,SP
      INCW  [$F4F5,SP]
      INCW  A,SP
      INCW  B,SP
      INCW  D,SP
      INCW  [D,SP]
      INCW  $0DB4,PC
      INCW  <$0CBF,PC
      INCW  $08C0,PC
      INCW  >$0BC9,PC
      INCW  [$09CB,PC]
      INCW  A,PC
      INCW  B,PC
      INCW  D,PC
      INCW  [D,PC]
      INCW  0,X
      INCW  1,+X
      INCW  8,-X
      INCW  1,X+
      INCW  8,X-
      INCW  0,Y
      DECW  5,+Y
      DECW  8,-Y
      DECW  1,Y+
      DECW  8,Y-
      DECW  0,SP
      DECW  1,+SP
      DECW  8,-SP
      DECW  1,SP+
      DECW  8,SP-
      DECW  $0D0A,PC
      DECW  $E1,X
      DECW  $E3E4,X
      DECW  [$E4E5,X]
      DECW  A,X
      DECW  B,X
      DECW  D,X
      DECW  [D,X]
      DECW  $E9,Y
      DECW  $EBEC,Y
      DECW  [$ECED,Y]
      DECW  A,Y
      DECW  B,Y
      DECW  D,Y
      DECW  [D,Y]
      DECW  $F1,SP
      DECW  $F3F4,SP
      DECW  [$F4F5,SP]
      DECW  A,SP
      DECW  B,SP
      DECW  D,SP
      DECW  [D,SP]
      DECW  $0E55,PC
      DECW  <$0D60,PC
      DECW  $0961,PC
      DECW  >$0C6A,PC
      DECW  [$0A6C,PC]
      DECW  A,PC
      DECW  B,PC
      DECW  D,PC
      DECW  [D,PC]
      DECW  0,X
      DECW  1,+X
      DECW  8,-X
      DECW  1,X+
      DECW  8,X-
      DECW  0,Y
      LSRW  6,+Y
      LSRW  8,-Y
      LSRW  1,Y+
      LSRW  8,Y-
      LSRW  0,SP
      LSRW  1,+SP
      LSRW  8,-SP
      LSRW  1,SP+
      LSRW  8,SP-
      LSRW  $0DAB,PC
      LSRW  $E1,X
      LSRW  $E3E4,X
      LSRW  [$E4E5,X]
      LSRW  A,X
      LSRW  B,X
      LSRW  D,X
      LSRW  [D,X]
      LSRW  $E9,Y
      LSRW  $EBEC,Y
      LSRW  [$ECED,Y]
      LSRW  A,Y
      LSRW  B,Y
      LSRW  D,Y
      LSRW  [D,Y]
      LSRW  $F1,SP
      LSRW  $F3F4,SP
      LSRW  [$F4F5,SP]
      LSRW  A,SP
      LSRW  B,SP
      LSRW  D,SP
      LSRW  [D,SP]
      LSRW  $0EF6,PC
      LSRW  <$0E01,PC
      LSRW  $0A02,PC
      LSRW  >$0D0B,PC
      LSRW  [$0B0D,PC]
      LSRW  A,PC
      LSRW  B,PC
      LSRW  D,PC
      LSRW  [D,PC]
      LSRW  0,X
      LSRW  1,+X
      LSRW  8,-X
      LSRW  1,X+
      LSRW  8,X-
      LSRW  0,Y
      ROLW  7,+Y
      ROLW  8,-Y
      ROLW  1,Y+
      ROLW  8,Y-
      ROLW  0,SP
      ROLW  1,+SP
      ROLW  8,-SP
      ROLW  1,SP+
      ROLW  8,SP-
      ROLW  $0E4C,PC
      ROLW  $E1,X
      ROLW  $E3E4,X
      ROLW  [$E4E5,X]
      ROLW  A,X
      ROLW  B,X
      ROLW  D,X
      ROLW  [D,X]
      ROLW  $E9,Y
      ROLW  $EBEC,Y
      ROLW  [$ECED,Y]
      ROLW  A,Y
      ROLW  B,Y
      ROLW  D,Y
      ROLW  [D,Y]
      ROLW  $F1,SP
      ROLW  $F3F4,SP
      ROLW  [$F4F5,SP]
      ROLW  A,SP
      ROLW  B,SP
      ROLW  D,SP
      ROLW  [D,SP]
      ROLW  $0F97,PC
      ROLW  <$0EA2,PC
      ROLW  $0AA3,PC
      ROLW  >$0DAC,PC
      ROLW  [$0BAE,PC]
      ROLW  A,PC
      ROLW  B,PC
      ROLW  D,PC
      ROLW  [D,PC]
      ROLW  0,X
      ROLW  1,+X
      ROLW  8,-X
      ROLW  1,X+
      ROLW  8,X-
      ROLW  0,Y
      RORW  8,+Y
      RORW  8,-Y
      RORW  1,Y+
      RORW  8,Y-
      RORW  0,SP
      RORW  1,+SP
      RORW  8,-SP
      RORW  1,SP+
      RORW  8,SP-
      RORW  $0EED,PC
      RORW  $E1,X
      RORW  $E3E4,X
      RORW  [$E4E5,X]
      RORW  A,X
      RORW  B,X
      RORW  D,X
      RORW  [D,X]
      RORW  $E9,Y
      RORW  $EBEC,Y
      RORW  [$ECED,Y]
      RORW  A,Y
      RORW  B,Y
      RORW  D,Y
      RORW  [D,Y]
      RORW  $F1,SP
      RORW  $F3F4,SP
      RORW  [$F4F5,SP]
      RORW  A,SP
      RORW  B,SP
      RORW  D,SP
      RORW  [D,SP]
      RORW  $1038,PC
      RORW  <$0F43,PC
      RORW  $0B44,PC
      RORW  >$0E4D,PC
      RORW  [$0C4F,PC]
      RORW  A,PC
      RORW  B,PC
      RORW  D,PC
      RORW  [D,PC]
      RORW  0,X
      RORW  1,+X
      RORW  8,-X
      RORW  1,X+
      RORW  8,X-
      RORW  0,Y
      ASRW  8,-Y
      ASRW  1,Y+
      ASRW  8,Y-
      ASRW  0,SP
      ASRW  1,+SP
      ASRW  8,-SP
      ASRW  1,SP+
      ASRW  8,SP-
      ASRW  $0F8B,PC
      ASRW  $E1,X
      ASRW  $E3E4,X
      ASRW  [$E4E5,X]
      ASRW  A,X
      ASRW  B,X
      ASRW  D,X
      ASRW  [D,X]
      ASRW  $E9,Y
      ASRW  $EBEC,Y
      ASRW  [$ECED,Y]
      ASRW  A,Y
      ASRW  B,Y
      ASRW  D,Y
      ASRW  [D,Y]
      ASRW  $F1,SP
      ASRW  $F3F4,SP
      ASRW  [$F4F5,SP]
      ASRW  A,SP
      ASRW  B,SP
      ASRW  D,SP
      ASRW  [D,SP]
      ASRW  $10D6,PC
      ASRW  <$0FE1,PC
      ASRW  $0BE2,PC
      ASRW  >$0EEB,PC
      ASRW  [$0CED,PC]
      ASRW  A,PC
      ASRW  B,PC
      ASRW  D,PC
      ASRW  [D,PC]
      ASRW  0,X
      ASRW  1,+X
      ASRW  8,-X
      ASRW  1,X+
      ASRW  8,X-
      ASRW  0,Y
      ASRW  1,+Y
      ASLW  7,-Y
      ASLW  1,Y+
      ASLW  8,Y-
      ASLW  0,SP
      ASLW  1,+SP
      ASLW  8,-SP
      ASLW  1,SP+
      ASLW  8,SP-
      ASLW  $102C,PC
      ASLW  $E1,X
      ASLW  $E3E4,X
      ASLW  [$E4E5,X]
      ASLW  A,X
      ASLW  B,X
      ASLW  D,X
      ASLW  [D,X]
      ASLW  $E9,Y
      ASLW  $EBEC,Y
      ASLW  [$ECED,Y]
      ASLW  A,Y
      ASLW  B,Y
      ASLW  D,Y
      ASLW  [D,Y]
      ASLW  $F1,SP
      ASLW  $F3F4,SP
      ASLW  [$F4F5,SP]
      ASLW  A,SP
      ASLW  B,SP
      ASLW  D,SP
      ASLW  [D,SP]
      ASLW  $1177,PC
      ASLW  <$1082,PC
      ASLW  $0C83,PC
      ASLW  >$0F8C,PC
      ASLW  [$0D8E,PC]
      ASLW  A,PC
      ASLW  B,PC
      ASLW  D,PC
      ASLW  [D,PC]
      ASLW  0,X
      ASLW  1,+X
      ASLW  8,-X
      ASLW  1,X+
      ASLW  8,X-
      ASLW  0,Y
      ASLW  1,+Y
      CLRW  6,-Y
      CLRW  1,Y+
      CLRW  8,Y-
      CLRW  0,SP
      CLRW  1,+SP
      CLRW  8,-SP
      CLRW  1,SP+
      CLRW  8,SP-
      CLRW  $10CD,PC
      CLRW  $E1,X
      CLRW  $E3E4,X
      CLRW  [$E4E5,X]
      CLRW  A,X
      CLRW  B,X
      CLRW  D,X
      CLRW  [D,X]
      CLRW  $E9,Y
      CLRW  $EBEC,Y
      CLRW  [$ECED,Y]
      CLRW  A,Y
      CLRW  B,Y
      CLRW  D,Y
      CLRW  [D,Y]
      CLRW  $F1,SP
      CLRW  $F3F4,SP
      CLRW  [$F4F5,SP]
      CLRW  A,SP
      CLRW  B,SP
      CLRW  D,SP
      CLRW  [D,SP]
      CLRW  $1218,PC
      CLRW  <$1123,PC
      CLRW  $0D24,PC
      CLRW  >$102D,PC
      CLRW  [$0E2F,PC]
      CLRW  A,PC
      CLRW  B,PC
      CLRW  D,PC
      CLRW  [D,PC]
      CLRW  0,X
      CLRW  1,+X
      CLRW  8,-X
      CLRW  1,X+
      CLRW  8,X-
      CLRW  0,Y
      CLRW  1,+Y
      GSTAA 5,-Y
      GSTAA 1,Y+
      GSTAA 8,Y-
      GSTAA 0,SP
      GSTAA 1,+SP
      GSTAA 8,-SP
      GSTAA 1,SP+
      GSTAA 8,SP-
      GSTAA $116E,PC
      GSTAA $E1,X
      GSTAA $E3E4,X
      GSTAA [$E4E5,X]
      GSTAA A,X
      GSTAA B,X
      GSTAA D,X
      GSTAA [D,X]
      GSTAA $E9,Y
      GSTAA $EBEC,Y
      GSTAA [$ECED,Y]
      GSTAA A,Y
      GSTAA B,Y
      GSTAA D,Y
      GSTAA [D,Y]
      GSTAA $F1,SP
      GSTAA $F3F4,SP
      GSTAA [$F4F5,SP]
      GSTAA A,SP
      GSTAA B,SP
      GSTAA D,SP
      GSTAA [D,SP]
      GSTAA $12B9,PC
      GSTAA <$11C4,PC
      GSTAA $0DC5,PC
      GSTAA >$10CE,PC
      GSTAA [$0ED0,PC]
      GSTAA A,PC
      GSTAA B,PC
      GSTAA D,PC
      GSTAA [D,PC]
      GSTAA 0,X
      GSTAA 1,+X
      GSTAA 8,-X
      GSTAA 1,X+
      GSTAA 8,X-
      GSTAA 0,Y
      GSTAA 1,+Y
      GSTAB 4,-Y
      GSTAB 1,Y+
      GSTAB 8,Y-
      GSTAB 0,SP
      GSTAB 1,+SP
      GSTAB 8,-SP
      GSTAB 1,SP+
      GSTAB 8,SP-
      GSTAB $120F,PC
      GSTAB $E1,X
      GSTAB $E3E4,X
      GSTAB [$E4E5,X]
      GSTAB A,X
      GSTAB B,X
      GSTAB D,X
      GSTAB [D,X]
      GSTAB $E9,Y
      GSTAB $EBEC,Y
      GSTAB [$ECED,Y]
      GSTAB A,Y
      GSTAB B,Y
      GSTAB D,Y
      GSTAB [D,Y]
      GSTAB $F1,SP
      GSTAB $F3F4,SP
      GSTAB [$F4F5,SP]
      GSTAB A,SP
      GSTAB B,SP
      GSTAB D,SP
      GSTAB [D,SP]
      GSTAB $135A,PC
      GSTAB <$1265,PC
      GSTAB $0E66,PC
      GSTAB >$116F,PC
      GSTAB [$0F71,PC]
      GSTAB A,PC
      GSTAB B,PC
      GSTAB D,PC
      GSTAB [D,PC]
      GSTAB 0,X
      GSTAB 1,+X
      GSTAB 8,-X
      GSTAB 1,X+
      GSTAB 8,X-
      GSTAB 0,Y
      GSTAB 1,+Y
      GSTD  3,-Y
      GSTD  1,Y+
      GSTD  8,Y-
      GSTD  0,SP
      GSTD  1,+SP
      GSTD  8,-SP
      GSTD  1,SP+
      GSTD  8,SP-
      GSTD  $12B0,PC
      GSTD  $E1,X
      GSTD  $E3E4,X
      GSTD  [$E4E5,X]
      GSTD  A,X
      GSTD  B,X
      GSTD  D,X
      GSTD  [D,X]
      GSTD  $E9,Y
      GSTD  $EBEC,Y
      GSTD  [$ECED,Y]
      GSTD  A,Y
      GSTD  B,Y
      GSTD  D,Y
      GSTD  [D,Y]
      GSTD  $F1,SP
      GSTD  $F3F4,SP
      GSTD  [$F4F5,SP]
      GSTD  A,SP
      GSTD  B,SP
      GSTD  D,SP
      GSTD  [D,SP]
      GSTD  $13FB,PC
      GSTD  <$1306,PC
      GSTD  $0F07,PC
      GSTD  >$1210,PC
      GSTD  [$1012,PC]
      GSTD  A,PC
      GSTD  B,PC
      GSTD  D,PC
      GSTD  [D,PC]
      GSTD  0,X
      GSTD  1,+X
      GSTD  8,-X
      GSTD  1,X+
      GSTD  8,X-
      GSTD  0,Y
      GSTD  1,+Y
      GSTY  2,-Y
      GSTY  1,Y+
      GSTY  8,Y-
      GSTY  0,SP
      GSTY  1,+SP
      GSTY  8,-SP
      GSTY  1,SP+
      GSTY  8,SP-
      GSTY  $1351,PC
      GSTY  $E1,X
      GSTY  $E3E4,X
      GSTY  [$E4E5,X]
      GSTY  A,X
      GSTY  B,X
      GSTY  D,X
      GSTY  [D,X]
      GSTY  $E9,Y
      GSTY  $EBEC,Y
      GSTY  [$ECED,Y]
      GSTY  A,Y
      GSTY  B,Y
      GSTY  D,Y
      GSTY  [D,Y]
      GSTY  $F1,SP
      GSTY  $F3F4,SP
      GSTY  [$F4F5,SP]
      GSTY  A,SP
      GSTY  B,SP
      GSTY  D,SP
      GSTY  [D,SP]
      GSTY  $149C,PC
      GSTY  <$13A7,PC
      GSTY  $0FA8,PC
      GSTY  >$12B1,PC
      GSTY  [$10B3,PC]
      GSTY  A,PC
      GSTY  B,PC
      GSTY  D,PC
      GSTY  [D,PC]
      GSTY  0,X
      GSTY  1,+X
      GSTY  8,-X
      GSTY  1,X+
      GSTY  8,X-
      GSTY  0,Y
      GSTY  1,+Y
      GSTX  1,-Y
      GSTX  1,Y+
      GSTX  8,Y-
      GSTX  0,SP
      GSTX  1,+SP
      GSTX  8,-SP
      GSTX  1,SP+
      GSTX  8,SP-
      GSTX  $13F2,PC
      GSTX  $E1,X
      GSTX  $E3E4,X
      GSTX  [$E4E5,X]
      GSTX  A,X
      GSTX  B,X
      GSTX  D,X
      GSTX  [D,X]
      GSTX  $E9,Y
      GSTX  $EBEC,Y
      GSTX  [$ECED,Y]
      GSTX  A,Y
      GSTX  B,Y
      GSTX  D,Y
      GSTX  [D,Y]
      GSTX  $F1,SP
      GSTX  $F3F4,SP
      GSTX  [$F4F5,SP]
      GSTX  A,SP
      GSTX  B,SP
      GSTX  D,SP
      GSTX  [D,SP]
      GSTX  $153D,PC
      GSTX  <$1448,PC
      GSTX  $1049,PC
      GSTX  >$1352,PC
      GSTX  [$1154,PC]
      GSTX  A,PC
      GSTX  B,PC
      GSTX  D,PC
      GSTX  [D,PC]
      GSTX  0,X
      GSTX  1,+X
      GSTX  8,-X
      GSTX  1,X+
      GSTX  8,X-
      GSTX  0,Y
      GSTX  1,+Y
      GSTS  1,Y+
      GSTS  8,Y-
      GSTS  0,SP
      GSTS  1,+SP
      GSTS  8,-SP
      GSTS  1,SP+
      GSTS  8,SP-
      GSTS  $1490,PC
      GSTS  $E1,X
      GSTS  $E3E4,X
      GSTS  [$E4E5,X]
      GSTS  A,X
      GSTS  B,X
      GSTS  D,X
      GSTS  [D,X]
      GSTS  $E9,Y
      GSTS  $EBEC,Y
      GSTS  [$ECED,Y]
      GSTS  A,Y
      GSTS  B,Y
      GSTS  D,Y
      GSTS  [D,Y]
      GSTS  $F1,SP
      GSTS  $F3F4,SP
      GSTS  [$F4F5,SP]
      GSTS  A,SP
      GSTS  B,SP
      GSTS  D,SP
      GSTS  [D,SP]
      GSTS  $15DB,PC
      GSTS  <$14E6,PC
      GSTS  $10E7,PC
      GSTS  >$13F0,PC
      GSTS  [$11F2,PC]
      GSTS  A,PC
      GSTS  B,PC
      GSTS  D,PC
      GSTS  [D,PC]
      GSTS  0,X
      GSTS  1,+X
      GSTS  8,-X
      GSTS  1,X+
      GSTS  8,X-
      GSTS  0,Y
      GSTS  1,+Y
      GSTS  8,-Y
      NEGW  $7172
      NEGW  >$0001
      COMW  $7273
      COMW  >$0001
      INCW  $7374
      INCW  >$0001
      DECW  $7475
      DECW  >$0001
      LSRW  $7576
      LSRW  >$0001
      ROLW  $7677
      ROLW  >$0001
      RORW  $7778
      RORW  >$0001
      ASRW  $7879
      ASRW  >$0001
      ASLW  $797A
      ASLW  >$0001
      CLRW  $7A7B
      CLRW  >$0001
      GSTAA $7B7C
      GSTAA >$0001
      GSTAB $7C7D
      GSTAB >$0001
      GSTD  $7D7E
      GSTD  >$0001
      GSTY  $7E7F
      GSTY  >$0001
      GSTX  $7F80
      GSTX  >$0001
      GSTS  $8081
      GSTS  >$0001
      SUBX  #$8182
      SBEX  #$8384
      SBED  #$8485
      ANDX  #$8586
      BITX  #$8687
      CLRX
      EORX  #$898A
      ADEX  #$8A8B
      ORX   #$8B8C
      ADDX  #$8C8D
      CPED  #$8D8E
      CPEY  #$8E8F
      CPEX  #$8F90
      CPES  #$9091
      SUBX  $91
      SBEX  $93
      SBED  $94
      ANDX  $95
      BITX  $96
      GLDAA $97
      TSTX
      EORX  $99
      ADEX  $9A
      ORX   $9B
      ADDX  $9C
      CPED  $9D
      CPEY  $9E
      CPEX  $9F
      CPES  $A0
      SUBX  2,+SP
      SUBX  8,-SP
      SUBX  1,SP+
      SUBX  8,SP-
      SUBX  $160A,PC
      SUBX  $E1,X
      SUBX  $E3E4,X
      SUBX  [$E4E5,X]
      SUBX  A,X
      SUBX  B,X
      SUBX  D,X
      SUBX  [D,X]
      SUBX  $E9,Y
      SUBX  $EBEC,Y
      SUBX  [$ECED,Y]
      SUBX  A,Y
      SUBX  B,Y
      SUBX  D,Y
      SUBX  [D,Y]
      SUBX  $F1,SP
      SUBX  $F3F4,SP
      SUBX  [$F4F5,SP]
      SUBX  A,SP
      SUBX  B,SP
      SUBX  D,SP
      SUBX  [D,SP]
      SUBX  $1755,PC
      SUBX  <$1660,PC
      SUBX  $1261,PC
      SUBX  >$156A,PC
      SUBX  [$136C,PC]
      SUBX  A,PC
      SUBX  B,PC
      SUBX  D,PC
      SUBX  [D,PC]
      SUBX  0,X
      SUBX  1,+X
      SUBX  8,-X
      SUBX  1,X+
      SUBX  8,X-
      SUBX  0,Y
      SUBX  1,+Y
      SUBX  8,-Y
      SUBX  1,Y+
      SUBX  8,Y-
      SUBX  0,SP
      SBEX  4,+SP
      SBEX  8,-SP
      SBEX  1,SP+
      SBEX  8,SP-
      SBEX  $16AB,PC
      SBEX  $E1,X
      SBEX  $E3E4,X
      SBEX  [$E4E5,X]
      SBEX  A,X
      SBEX  B,X
      SBEX  D,X
      SBEX  [D,X]
      SBEX  $E9,Y
      SBEX  $EBEC,Y
      SBEX  [$ECED,Y]
      SBEX  A,Y
      SBEX  B,Y
      SBEX  D,Y
      SBEX  [D,Y]
      SBEX  $F1,SP
      SBEX  $F3F4,SP
      SBEX  [$F4F5,SP]
      SBEX  A,SP
      SBEX  B,SP
      SBEX  D,SP
      SBEX  [D,SP]
      SBEX  $17F6,PC
      SBEX  <$1701,PC
      SBEX  $1302,PC
      SBEX  >$160B,PC
      SBEX  [$140D,PC]
      SBEX  A,PC
      SBEX  B,PC
      SBEX  D,PC
      SBEX  [D,PC]
      SBEX  0,X
      SBEX  1,+X
      SBEX  8,-X
      SBEX  1,X+
      SBEX  8,X-
      SBEX  0,Y
      SBEX  1,+Y
      SBEX  8,-Y
      SBEX  1,Y+
      SBEX  8,Y-
      SBEX  0,SP
      SBED  5,+SP
      SBED  8,-SP
      SBED  1,SP+
      SBED  8,SP-
      SBED  $174C,PC
      SBED  $E1,X
      SBED  $E3E4,X
      SBED  [$E4E5,X]
      SBED  A,X
      SBED  B,X
      SBED  D,X
      SBED  [D,X]
      SBED  $E9,Y
      SBED  $EBEC,Y
      SBED  [$ECED,Y]
      SBED  A,Y
      SBED  B,Y
      SBED  D,Y
      SBED  [D,Y]
      SBED  $F1,SP
      SBED  $F3F4,SP
      SBED  [$F4F5,SP]
      SBED  A,SP
      SBED  B,SP
      SBED  D,SP
      SBED  [D,SP]
      SBED  $1897,PC
      SBED  <$17A2,PC
      SBED  $13A3,PC
      SBED  >$16AC,PC
      SBED  [$14AE,PC]
      SBED  A,PC
      SBED  B,PC
      SBED  D,PC
      SBED  [D,PC]
      SBED  0,X
      SBED  1,+X
      SBED  8,-X
      SBED  1,X+
      SBED  8,X-
      SBED  0,Y
      SBED  1,+Y
      SBED  8,-Y
      SBED  1,Y+
      SBED  8,Y-
      SBED  0,SP
      ANDX  6,+SP
      ANDX  8,-SP
      ANDX  1,SP+
      ANDX  8,SP-
      ANDX  $17ED,PC
      ANDX  $E1,X
      ANDX  $E3E4,X
      ANDX  [$E4E5,X]
      ANDX  A,X
      ANDX  B,X
      ANDX  D,X
      ANDX  [D,X]
      ANDX  $E9,Y
      ANDX  $EBEC,Y
      ANDX  [$ECED,Y]
      ANDX  A,Y
      ANDX  B,Y
      ANDX  D,Y
      ANDX  [D,Y]
      ANDX  $F1,SP
      ANDX  $F3F4,SP
      ANDX  [$F4F5,SP]
      ANDX  A,SP
      ANDX  B,SP
      ANDX  D,SP
      ANDX  [D,SP]
      ANDX  $1938,PC
      ANDX  <$1843,PC
      ANDX  $1444,PC
      ANDX  >$174D,PC
      ANDX  [$154F,PC]
      ANDX  A,PC
      ANDX  B,PC
      ANDX  D,PC
      ANDX  [D,PC]
      ANDX  0,X
      ANDX  1,+X
      ANDX  8,-X
      ANDX  1,X+
      ANDX  8,X-
      ANDX  0,Y
      ANDX  1,+Y
      ANDX  8,-Y
      ANDX  1,Y+
      ANDX  8,Y-
      ANDX  0,SP
      BITX  7,+SP
      BITX  8,-SP
      BITX  1,SP+
      BITX  8,SP-
      BITX  $188E,PC
      BITX  $E1,X
      BITX  $E3E4,X
      BITX  [$E4E5,X]
      BITX  A,X
      BITX  B,X
      BITX  D,X
      BITX  [D,X]
      BITX  $E9,Y
      BITX  $EBEC,Y
      BITX  [$ECED,Y]
      BITX  A,Y
      BITX  B,Y
      BITX  D,Y
      BITX  [D,Y]
      BITX  $F1,SP
      BITX  $F3F4,SP
      BITX  [$F4F5,SP]
      BITX  A,SP
      BITX  B,SP
      BITX  D,SP
      BITX  [D,SP]
      BITX  $19D9,PC
      BITX  <$18E4,PC
      BITX  $14E5,PC
      BITX  >$17EE,PC
      BITX  [$15F0,PC]
      BITX  A,PC
      BITX  B,PC
      BITX  D,PC
      BITX  [D,PC]
      BITX  0,X
      BITX  1,+X
      BITX  8,-X
      BITX  1,X+
      BITX  8,X-
      BITX  0,Y
      BITX  1,+Y
      BITX  8,-Y
      BITX  1,Y+
      BITX  8,Y-
      BITX  0,SP
      GLDAA 8,+SP
      GLDAA 8,-SP
      GLDAA 1,SP+
      GLDAA 8,SP-
      GLDAA $192F,PC
      GLDAA $E1,X
      GLDAA $E3E4,X
      GLDAA [$E4E5,X]
      GLDAA A,X
      GLDAA B,X
      GLDAA D,X
      GLDAA [D,X]
      GLDAA $E9,Y
      GLDAA $EBEC,Y
      GLDAA [$ECED,Y]
      GLDAA A,Y
      GLDAA B,Y
      GLDAA D,Y
      GLDAA [D,Y]
      GLDAA $F1,SP
      GLDAA $F3F4,SP
      GLDAA [$F4F5,SP]
      GLDAA A,SP
      GLDAA B,SP
      GLDAA D,SP
      GLDAA [D,SP]
      GLDAA $1A7A,PC
      GLDAA <$1985,PC
      GLDAA $1586,PC
      GLDAA >$188F,PC
      GLDAA [$1691,PC]
      GLDAA A,PC
      GLDAA B,PC
      GLDAA D,PC
      GLDAA [D,PC]
      GLDAA 0,X
      GLDAA 1,+X
      GLDAA 8,-X
      GLDAA 1,X+
      GLDAA 8,X-
      GLDAA 0,Y
      GLDAA 1,+Y
      GLDAA 8,-Y
      GLDAA 1,Y+
      GLDAA 8,Y-
      GLDAA 0,SP
      SYS
      EORX  7,-SP
      EORX  1,SP+
      EORX  8,SP-
      EORX  $19CF,PC
      EORX  $E1,X
      EORX  $E3E4,X
      EORX  [$E4E5,X]
      EORX  A,X
      EORX  B,X
      EORX  D,X
      EORX  [D,X]
      EORX  $E9,Y
      EORX  $EBEC,Y
      EORX  [$ECED,Y]
      EORX  A,Y
      EORX  B,Y
      EORX  D,Y
      EORX  [D,Y]
      EORX  $F1,SP
      EORX  $F3F4,SP
      EORX  [$F4F5,SP]
      EORX  A,SP
      EORX  B,SP
      EORX  D,SP
      EORX  [D,SP]
      EORX  $1B1A,PC
      EORX  <$1A25,PC
      EORX  $1626,PC
      EORX  >$192F,PC
      EORX  [$1731,PC]
      EORX  A,PC
      EORX  B,PC
      EORX  D,PC
      EORX  [D,PC]
      EORX  0,X
      EORX  1,+X
      EORX  8,-X
      EORX  1,X+
      EORX  8,X-
      EORX  0,Y
      EORX  1,+Y
      EORX  8,-Y
      EORX  1,Y+
      EORX  8,Y-
      EORX  0,SP
      EORX  1,+SP
      ADEX  6,-SP
      ADEX  1,SP+
      ADEX  8,SP-
      ADEX  $1A70,PC
      ADEX  $E1,X
      ADEX  $E3E4,X
      ADEX  [$E4E5,X]
      ADEX  A,X
      ADEX  B,X
      ADEX  D,X
      ADEX  [D,X]
      ADEX  $E9,Y
      ADEX  $EBEC,Y
      ADEX  [$ECED,Y]
      ADEX  A,Y
      ADEX  B,Y
      ADEX  D,Y
      ADEX  [D,Y]
      ADEX  $F1,SP
      ADEX  $F3F4,SP
      ADEX  [$F4F5,SP]
      ADEX  A,SP
      ADEX  B,SP
      ADEX  D,SP
      ADEX  [D,SP]
      ADEX  $1BBB,PC
      ADEX  <$1AC6,PC
      ADEX  $16C7,PC
      ADEX  >$19D0,PC
      ADEX  [$17D2,PC]
      ADEX  A,PC
      ADEX  B,PC
      ADEX  D,PC
      ADEX  [D,PC]
      ADEX  0,X
      ADEX  1,+X
      ADEX  8,-X
      ADEX  1,X+
      ADEX  8,X-
      ADEX  0,Y
      ADEX  1,+Y
      ADEX  8,-Y
      ADEX  1,Y+
      ADEX  8,Y-
      ADEX  0,SP
      ADEX  1,+SP
      ORX   5,-SP
      ORX   1,SP+
      ORX   8,SP-
      ORX   $1B11,PC
      ORX   $E1,X
      ORX   $E3E4,X
      ORX   [$E4E5,X]
      ORX   A,X
      ORX   B,X
      ORX   D,X
      ORX   [D,X]
      ORX   $E9,Y
      ORX   $EBEC,Y
      ORX   [$ECED,Y]
      ORX   A,Y
      ORX   B,Y
      ORX   D,Y
      ORX   [D,Y]
      ORX   $F1,SP
      ORX   $F3F4,SP
      ORX   [$F4F5,SP]
      ORX   A,SP
      ORX   B,SP
      ORX   D,SP
      ORX   [D,SP]
      ORX   $1C5C,PC
      ORX   <$1B67,PC
      ORX   $1768,PC
      ORX   >$1A71,PC
      ORX   [$1873,PC]
      ORX   A,PC
      ORX   B,PC
      ORX   D,PC
      ORX   [D,PC]
      ORX   0,X
      ORX   1,+X
      ORX   8,-X
      ORX   1,X+
      ORX   8,X-
      ORX   0,Y
      ORX   1,+Y
      ORX   8,-Y
      ORX   1,Y+
      ORX   8,Y-
      ORX   0,SP
      ORX   1,+SP
      ADDX  4,-SP
      ADDX  1,SP+
      ADDX  8,SP-
      ADDX  $1BB2,PC
      ADDX  $E1,X
      ADDX  $E3E4,X
      ADDX  [$E4E5,X]
      ADDX  A,X
      ADDX  B,X
      ADDX  D,X
      ADDX  [D,X]
      ADDX  $E9,Y
      ADDX  $EBEC,Y
      ADDX  [$ECED,Y]
      ADDX  A,Y
      ADDX  B,Y
      ADDX  D,Y
      ADDX  [D,Y]
      ADDX  $F1,SP
      ADDX  $F3F4,SP
      ADDX  [$F4F5,SP]
      ADDX  A,SP
      ADDX  B,SP
      ADDX  D,SP
      ADDX  [D,SP]
      ADDX  $1CFD,PC
      ADDX  <$1C08,PC
      ADDX  $1809,PC
      ADDX  >$1B12,PC
      ADDX  [$1914,PC]
      ADDX  A,PC
      ADDX  B,PC
      ADDX  D,PC
      ADDX  [D,PC]
      ADDX  0,X
      ADDX  1,+X
      ADDX  8,-X
      ADDX  1,X+
      ADDX  8,X-
      ADDX  0,Y
      ADDX  1,+Y
      ADDX  8,-Y
      ADDX  1,Y+
      ADDX  8,Y-
      ADDX  0,SP
      ADDX  1,+SP
      CPED  3,-SP
      CPED  1,SP+
      CPED  8,SP-
      CPED  $1C53,PC
      CPED  $E1,X
      CPED  $E3E4,X
      CPED  [$E4E5,X]
      CPED  A,X
      CPED  B,X
      CPED  D,X
      CPED  [D,X]
      CPED  $E9,Y
      CPED  $EBEC,Y
      CPED  [$ECED,Y]
      CPED  A,Y
      CPED  B,Y
      CPED  D,Y
      CPED  [D,Y]
      CPED  $F1,SP
      CPED  $F3F4,SP
      CPED  [$F4F5,SP]
      CPED  A,SP
      CPED  B,SP
      CPED  D,SP
      CPED  [D,SP]
      CPED  $1D9E,PC
      CPED  <$1CA9,PC
      CPED  $18AA,PC
      CPED  >$1BB3,PC
      CPED  [$19B5,PC]
      CPED  A,PC
      CPED  B,PC
      CPED  D,PC
      CPED  [D,PC]
      CPED  0,X
      CPED  1,+X
      CPED  8,-X
      CPED  1,X+
      CPED  8,X-
      CPED  0,Y
      CPED  1,+Y
      CPED  8,-Y
      CPED  1,Y+
      CPED  8,Y-
      CPED  0,SP
      CPED  1,+SP
      CPEY  2,-SP
      CPEY  1,SP+
      CPEY  8,SP-
      CPEY  $1CF4,PC
      CPEY  $E1,X
      CPEY  $E3E4,X
      CPEY  [$E4E5,X]
      CPEY  A,X
      CPEY  B,X
      CPEY  D,X
      CPEY  [D,X]
      CPEY  $E9,Y
      CPEY  $EBEC,Y
      CPEY  [$ECED,Y]
      CPEY  A,Y
      CPEY  B,Y
      CPEY  D,Y
      CPEY  [D,Y]
      CPEY  $F1,SP
      CPEY  $F3F4,SP
      CPEY  [$F4F5,SP]
      CPEY  A,SP
      CPEY  B,SP
      CPEY  D,SP
      CPEY  [D,SP]
      CPEY  $1E3F,PC
      CPEY  <$1D4A,PC
      CPEY  $194B,PC
      CPEY  >$1C54,PC
      CPEY  [$1A56,PC]
      CPEY  A,PC
      CPEY  B,PC
      CPEY  D,PC
      CPEY  [D,PC]
      CPEY  0,X
      CPEY  1,+X
      CPEY  8,-X
      CPEY  1,X+
      CPEY  8,X-
      CPEY  0,Y
      CPEY  1,+Y
      CPEY  8,-Y
      CPEY  1,Y+
      CPEY  8,Y-
      CPEY  0,SP
      CPEY  1,+SP
      CPEX  1,-SP
      CPEX  1,SP+
      CPEX  8,SP-
      CPEX  $1D95,PC
      CPEX  $E1,X
      CPEX  $E3E4,X
      CPEX  [$E4E5,X]
      CPEX  A,X
      CPEX  B,X
      CPEX  D,X
      CPEX  [D,X]
      CPEX  $E9,Y
      CPEX  $EBEC,Y
      CPEX  [$ECED,Y]
      CPEX  A,Y
      CPEX  B,Y
      CPEX  D,Y
      CPEX  [D,Y]
      CPEX  $F1,SP
      CPEX  $F3F4,SP
      CPEX  [$F4F5,SP]
      CPEX  A,SP
      CPEX  B,SP
      CPEX  D,SP
      CPEX  [D,SP]
      CPEX  $1EE0,PC
      CPEX  <$1DEB,PC
      CPEX  $19EC,PC
      CPEX  >$1CF5,PC
      CPEX  [$1AF7,PC]
      CPEX  A,PC
      CPEX  B,PC
      CPEX  D,PC
      CPEX  [D,PC]
      CPEX  0,X
      CPEX  1,+X
      CPEX  8,-X
      CPEX  1,X+
      CPEX  8,X-
      CPEX  0,Y
      CPEX  1,+Y
      CPEX  8,-Y
      CPEX  1,Y+
      CPEX  8,Y-
      CPEX  0,SP
      CPEX  1,+SP
      CPES  1,SP+
      CPES  8,SP-
      CPES  $1E33,PC
      CPES  $E1,X
      CPES  $E3E4,X
      CPES  [$E4E5,X]
      CPES  A,X
      CPES  B,X
      CPES  D,X
      CPES  [D,X]
      CPES  $E9,Y
      CPES  $EBEC,Y
      CPES  [$ECED,Y]
      CPES  A,Y
      CPES  B,Y
      CPES  D,Y
      CPES  [D,Y]
      CPES  $F1,SP
      CPES  $F3F4,SP
      CPES  [$F4F5,SP]
      CPES  A,SP
      CPES  B,SP
      CPES  D,SP
      CPES  [D,SP]
      CPES  $1F7E,PC
      CPES  <$1E89,PC
      CPES  $1A8A,PC
      CPES  >$1D93,PC
      CPES  [$1B95,PC]
      CPES  A,PC
      CPES  B,PC
      CPES  D,PC
      CPES  [D,PC]
      CPES  0,X
      CPES  1,+X
      CPES  8,-X
      CPES  1,X+
      CPES  8,X-
      CPES  0,Y
      CPES  1,+Y
      CPES  8,-Y
      CPES  1,Y+
      CPES  8,Y-
      CPES  0,SP
      CPES  1,+SP
      CPES  8,-SP
      SUBX  $B1B2
      SUBX  >$0001
      SBEX  $B3B4
      SBEX  >$0001
      SBED  $B4B5
      SBED  >$0001
      ANDX  $B5B6
      ANDX  >$0001
      BITX  $B6B7
      BITX  >$0001
      GLDAA $B7B8
      GLDAA >$0001
      EORX  $B9BA
      EORX  >$0001
      ADEX  $BABB
      ADEX  >$0001
      ORX   $BBBC
      ORX   >$0001
      ADDX  $BCBD
      ADDX  >$0001
      CPED  $BDBE
      CPED  >$0001
      CPEY  $BEBF
      CPEY  >$0001
      CPEX  $BFC0
      CPEX  >$0001
      CPES  $C0C1
      CPES  >$0001
      SUBY  #$C1C2
      SBEY  #$C3C4
      ADED  #$C4C5
      ANDY  #$C5C6
      BITY  #$C6C7
      CLRY
      EORY  #$C9CA
      ADEY  #$CACB
      ORY   #$CBCC
      ADDY  #$CCCD
      SUBY  $D1
      SBEY  $D3
      ADED  $D4
      ANDY  $D5
      BITY  $D6
      GLDAB $D7
      TSTY
      EORY  $D9
      ADEY  $DA
      ORY   $DB
      ADDY  $DC
      GLDD  $DD
      GLDY  $DE
      GLDX  $DF
      GLDS  $E0
      SUBY  -30,X
      SUBY  $E3E4,X
      SUBY  [$E4E5,X]
      SUBY  A,X
      SUBY  B,X
      SUBY  D,X
      SUBY  [D,X]
      SUBY  $E9,Y
      SUBY  $EBEC,Y
      SUBY  [$ECED,Y]
      SUBY  A,Y
      SUBY  B,Y
      SUBY  D,Y
      SUBY  [D,Y]
      SUBY  $F1,SP
      SUBY  $F3F4,SP
      SUBY  [$F4F5,SP]
      SUBY  A,SP
      SUBY  B,SP
      SUBY  D,SP
      SUBY  [D,SP]
      SUBY  $20D8,PC
      SUBY  <$1FE3,PC
      SUBY  $1BE4,PC
      SUBY  >$1EED,PC
      SUBY  [$1CEF,PC]
      SUBY  A,PC
      SUBY  B,PC
      SUBY  D,PC
      SUBY  [D,PC]
      SUBY  0,X
      SUBY  1,+X
      SUBY  8,-X
      SUBY  1,X+
      SUBY  8,X-
      SUBY  0,Y
      SUBY  1,+Y
      SUBY  8,-Y
      SUBY  1,Y+
      SUBY  8,Y-
      SUBY  0,SP
      SUBY  1,+SP
      SUBY  8,-SP
      SUBY  1,SP+
      SUBY  8,SP-
      SUBY  $202E,PC
      SBEY  [$E4E5,X]
      SBEY  A,X
      SBEY  B,X
      SBEY  D,X
      SBEY  [D,X]
      SBEY  $E9,Y
      SBEY  $EBEC,Y
      SBEY  [$ECED,Y]
      SBEY  A,Y
      SBEY  B,Y
      SBEY  D,Y
      SBEY  [D,Y]
      SBEY  $F1,SP
      SBEY  $F3F4,SP
      SBEY  [$F4F5,SP]
      SBEY  A,SP
      SBEY  B,SP
      SBEY  D,SP
      SBEY  [D,SP]
      SBEY  $2170,PC
      SBEY  <$207B,PC
      SBEY  $1C7C,PC
      SBEY  >$1F85,PC
      SBEY  [$1D87,PC]
      SBEY  A,PC
      SBEY  B,PC
      SBEY  D,PC
      SBEY  [D,PC]
      SBEY  0,X
      SBEY  1,+X
      SBEY  8,-X
      SBEY  1,X+
      SBEY  8,X-
      SBEY  0,Y
      SBEY  1,+Y
      SBEY  8,-Y
      SBEY  1,Y+
      SBEY  8,Y-
      SBEY  0,SP
      SBEY  1,+SP
      SBEY  8,-SP
      SBEY  1,SP+
      SBEY  8,SP-
      SBEY  $20C6,PC
      SBEY  $E1,X
      SBEY  $E3E4,X
      ADED  A,X
      ADED  B,X
      ADED  D,X
      ADED  [D,X]
      ADED  $E9,Y
      ADED  $EBEC,Y
      ADED  [$ECED,Y]
      ADED  A,Y
      ADED  B,Y
      ADED  D,Y
      ADED  [D,Y]
      ADED  $F1,SP
      ADED  $F3F4,SP
      ADED  [$F4F5,SP]
      ADED  A,SP
      ADED  B,SP
      ADED  D,SP
      ADED  [D,SP]
      ADED  $220C,PC
      ADED  <$2117,PC
      ADED  $1D18,PC
      ADED  >$2021,PC
      ADED  [$1E23,PC]
      ADED  A,PC
      ADED  B,PC
      ADED  D,PC
      ADED  [D,PC]
      ADED  0,X
      ADED  1,+X
      ADED  8,-X
      ADED  1,X+
      ADED  8,X-
      ADED  0,Y
      ADED  1,+Y
      ADED  8,-Y
      ADED  1,Y+
      ADED  8,Y-
      ADED  0,SP
      ADED  1,+SP
      ADED  8,-SP
      ADED  1,SP+
      ADED  8,SP-
      ADED  $2162,PC
      ADED  $E1,X
      ADED  $E3E4,X
      ADED  [$E4E5,X]
      ANDY  B,X
      ANDY  D,X
      ANDY  [D,X]
      ANDY  $E9,Y
      ANDY  $EBEC,Y
      ANDY  [$ECED,Y]
      ANDY  A,Y
      ANDY  B,Y
      ANDY  D,Y
      ANDY  [D,Y]
      ANDY  $F1,SP
      ANDY  $F3F4,SP
      ANDY  [$F4F5,SP]
      ANDY  A,SP
      ANDY  B,SP
      ANDY  D,SP
      ANDY  [D,SP]
      ANDY  $22AA,PC
      ANDY  <$21B5,PC
      ANDY  $1DB6,PC
      ANDY  >$20BF,PC
      ANDY  [$1EC1,PC]
      ANDY  A,PC
      ANDY  B,PC
      ANDY  D,PC
      ANDY  [D,PC]
      ANDY  0,X
      ANDY  1,+X
      ANDY  8,-X
      ANDY  1,X+
      ANDY  8,X-
      ANDY  0,Y
      ANDY  1,+Y
      ANDY  8,-Y
      ANDY  1,Y+
      ANDY  8,Y-
      ANDY  0,SP
      ANDY  1,+SP
      ANDY  8,-SP
      ANDY  1,SP+
      ANDY  8,SP-
      ANDY  $2200,PC
      ANDY  $E1,X
      ANDY  $E3E4,X
      ANDY  [$E4E5,X]
      ANDY  A,X
      BITY  D,X
      BITY  [D,X]
      BITY  $E9,Y
      BITY  $EBEC,Y
      BITY  [$ECED,Y]
      BITY  A,Y
      BITY  B,Y
      BITY  D,Y
      BITY  [D,Y]
      BITY  $F1,SP
      BITY  $F3F4,SP
      BITY  [$F4F5,SP]
      BITY  A,SP
      BITY  B,SP
      BITY  D,SP
      BITY  [D,SP]
      BITY  $2348,PC
      BITY  <$2253,PC
      BITY  $1E54,PC
      BITY  >$215D,PC
      BITY  [$1F5F,PC]
      BITY  A,PC
      BITY  B,PC
      BITY  D,PC
      BITY  [D,PC]
      BITY  0,X
      BITY  1,+X
      BITY  8,-X
      BITY  1,X+
      BITY  8,X-
      BITY  0,Y
      BITY  1,+Y
      BITY  8,-Y
      BITY  1,Y+
      BITY  8,Y-
      BITY  0,SP
      BITY  1,+SP
      BITY  8,-SP
      BITY  1,SP+
      BITY  8,SP-
      BITY  $229E,PC
      BITY  $E1,X
      BITY  $E3E4,X
      BITY  [$E4E5,X]
      BITY  A,X
      BITY  B,X
      GLDAB [D,X]
      GLDAB $E9,Y
      GLDAB $EBEC,Y
      GLDAB [$ECED,Y]
      GLDAB A,Y
      GLDAB B,Y
      GLDAB D,Y
      GLDAB [D,Y]
      GLDAB $F1,SP
      GLDAB $F3F4,SP
      GLDAB [$F4F5,SP]
      GLDAB A,SP
      GLDAB B,SP
      GLDAB D,SP
      GLDAB [D,SP]
      GLDAB $23E6,PC
      GLDAB <$22F1,PC
      GLDAB $1EF2,PC
      GLDAB >$21FB,PC
      GLDAB [$1FFD,PC]
      GLDAB A,PC
      GLDAB B,PC
      GLDAB D,PC
      GLDAB [D,PC]
      GLDAB 0,X
      GLDAB 1,+X
      GLDAB 8,-X
      GLDAB 1,X+
      GLDAB 8,X-
      GLDAB 0,Y
      GLDAB 1,+Y
      GLDAB 8,-Y
      GLDAB 1,Y+
      GLDAB 8,Y-
      GLDAB 0,SP
      GLDAB 1,+SP
      GLDAB 8,-SP
      GLDAB 1,SP+
      GLDAB 8,SP-
      GLDAB $233C,PC
      GLDAB $E1,X
      GLDAB $E3E4,X
      GLDAB [$E4E5,X]
      GLDAB A,X
      GLDAB B,X
      GLDAB D,X
      TSTW  $E9,Y
      TSTW  $EBEC,Y
      TSTW  [$ECED,Y]
      TSTW  A,Y
      TSTW  B,Y
      TSTW  D,Y
      TSTW  [D,Y]
      TSTW  $F1,SP
      TSTW  $F3F4,SP
      TSTW  [$F4F5,SP]
      TSTW  A,SP
      TSTW  B,SP
      TSTW  D,SP
      TSTW  [D,SP]
      TSTW  $2484,PC
      TSTW  <$238F,PC
      TSTW  $1F90,PC
      TSTW  >$2299,PC
      TSTW  [$209B,PC]
      TSTW  A,PC
      TSTW  B,PC
      TSTW  D,PC
      TSTW  [D,PC]
      TSTW  0,X
      TSTW  1,+X
      TSTW  8,-X
      TSTW  1,X+
      TSTW  8,X-
      TSTW  0,Y
      TSTW  1,+Y
      TSTW  8,-Y
      TSTW  1,Y+
      TSTW  8,Y-
      TSTW  0,SP
      TSTW  1,+SP
      TSTW  8,-SP
      TSTW  1,SP+
      TSTW  8,SP-
      TSTW  $23DA,PC
      TSTW  $E1,X
      TSTW  $E3E4,X
      TSTW  [$E4E5,X]
      TSTW  A,X
      TSTW  B,X
      TSTW  D,X
      TSTW  [D,X]
      EORY  -22,Y
      EORY  $EBEC,Y
      EORY  [$ECED,Y]
      EORY  A,Y
      EORY  B,Y
      EORY  D,Y
      EORY  [D,Y]
      EORY  $F1,SP
      EORY  $F3F4,SP
      EORY  [$F4F5,SP]
      EORY  A,SP
      EORY  B,SP
      EORY  D,SP
      EORY  [D,SP]
      EORY  $2525,PC
      EORY  <$2430,PC
      EORY  $2031,PC
      EORY  >$233A,PC
      EORY  [$213C,PC]
      EORY  A,PC
      EORY  B,PC
      EORY  D,PC
      EORY  [D,PC]
      EORY  0,X
      EORY  1,+X
      EORY  8,-X
      EORY  1,X+
      EORY  8,X-
      EORY  0,Y
      EORY  1,+Y
      EORY  8,-Y
      EORY  1,Y+
      EORY  8,Y-
      EORY  0,SP
      EORY  1,+SP
      EORY  8,-SP
      EORY  1,SP+
      EORY  8,SP-
      EORY  $247B,PC
      EORY  $E1,X
      EORY  $E3E4,X
      EORY  [$E4E5,X]
      EORY  A,X
      EORY  B,X
      EORY  D,X
      EORY  [D,X]
      ADEY  $EBEC,Y
      ADEY  [$ECED,Y]
      ADEY  A,Y
      ADEY  B,Y
      ADEY  D,Y
      ADEY  [D,Y]
      ADEY  $F1,SP
      ADEY  $F3F4,SP
      ADEY  [$F4F5,SP]
      ADEY  A,SP
      ADEY  B,SP
      ADEY  D,SP
      ADEY  [D,SP]
      ADEY  $25C2,PC
      ADEY  <$24CD,PC
      ADEY  $20CE,PC
      ADEY  >$23D7,PC
      ADEY  [$21D9,PC]
      ADEY  A,PC
      ADEY  B,PC
      ADEY  D,PC
      ADEY  [D,PC]
      ADEY  0,X
      ADEY  1,+X
      ADEY  8,-X
      ADEY  1,X+
      ADEY  8,X-
      ADEY  0,Y
      ADEY  1,+Y
      ADEY  8,-Y
      ADEY  1,Y+
      ADEY  8,Y-
      ADEY  0,SP
      ADEY  1,+SP
      ADEY  8,-SP
      ADEY  1,SP+
      ADEY  8,SP-
      ADEY  $2518,PC
      ADEY  $E1,X
      ADEY  $E3E4,X
      ADEY  [$E4E5,X]
      ADEY  A,X
      ADEY  B,X
      ADEY  D,X
      ADEY  [D,X]
      ADEY  $E9,Y
      ORY   [$ECED,Y]
      ORY   A,Y
      ORY   B,Y
      ORY   D,Y
      ORY   [D,Y]
      ORY   $F1,SP
      ORY   $F3F4,SP
      ORY   [$F4F5,SP]
      ORY   A,SP
      ORY   B,SP
      ORY   D,SP
      ORY   [D,SP]
      ORY   $265E,PC
      ORY   <$2569,PC
      ORY   $216A,PC
      ORY   >$2473,PC
      ORY   [$2275,PC]
      ORY   A,PC
      ORY   B,PC
      ORY   D,PC
      ORY   [D,PC]
      ORY   0,X
      ORY   1,+X
      ORY   8,-X
      ORY   1,X+
      ORY   8,X-
      ORY   0,Y
      ORY   1,+Y
      ORY   8,-Y
      ORY   1,Y+
      ORY   8,Y-
      ORY   0,SP
      ORY   1,+SP
      ORY   8,-SP
      ORY   1,SP+
      ORY   8,SP-
      ORY   $25B4,PC
      ORY   $E1,X
      ORY   $E3E4,X
      ORY   [$E4E5,X]
      ORY   A,X
      ORY   B,X
      ORY   D,X
      ORY   [D,X]
      ORY   $E9,Y
      ORY   $EBEC,Y
      ADDY  A,Y
      ADDY  B,Y
      ADDY  D,Y
      ADDY  [D,Y]
      ADDY  $F1,SP
      ADDY  $F3F4,SP
      ADDY  [$F4F5,SP]
      ADDY  A,SP
      ADDY  B,SP
      ADDY  D,SP
      ADDY  [D,SP]
      ADDY  $26FA,PC
      ADDY  <$2605,PC
      ADDY  $2206,PC
      ADDY  >$250F,PC
      ADDY  [$2311,PC]
      ADDY  A,PC
      ADDY  B,PC
      ADDY  D,PC
      ADDY  [D,PC]
      ADDY  0,X
      ADDY  1,+X
      ADDY  8,-X
      ADDY  1,X+
      ADDY  8,X-
      ADDY  0,Y
      ADDY  1,+Y
      ADDY  8,-Y
      ADDY  1,Y+
      ADDY  8,Y-
      ADDY  0,SP
      ADDY  1,+SP
      ADDY  8,-SP
      ADDY  1,SP+
      ADDY  8,SP-
      ADDY  $2650,PC
      ADDY  $E1,X
      ADDY  $E3E4,X
      ADDY  [$E4E5,X]
      ADDY  A,X
      ADDY  B,X
      ADDY  D,X
      ADDY  [D,X]
      ADDY  $E9,Y
      ADDY  $EBEC,Y
      ADDY  [$ECED,Y]
      GLDD  B,Y
      GLDD  D,Y
      GLDD  [D,Y]
      GLDD  $F1,SP
      GLDD  $F3F4,SP
      GLDD  [$F4F5,SP]
      GLDD  A,SP
      GLDD  B,SP
      GLDD  D,SP
      GLDD  [D,SP]
      GLDD  $2798,PC
      GLDD  <$26A3,PC
      GLDD  $22A4,PC
      GLDD  >$25AD,PC
      GLDD  [$23AF,PC]
      GLDD  A,PC
      GLDD  B,PC
      GLDD  D,PC
      GLDD  [D,PC]
      GLDD  0,X
      GLDD  1,+X
      GLDD  8,-X
      GLDD  1,X+
      GLDD  8,X-
      GLDD  0,Y
      GLDD  1,+Y
      GLDD  8,-Y
      GLDD  1,Y+
      GLDD  8,Y-
      GLDD  0,SP
      GLDD  1,+SP
      GLDD  8,-SP
      GLDD  1,SP+
      GLDD  8,SP-
      GLDD  $26EE,PC
      GLDD  $E1,X
      GLDD  $E3E4,X
      GLDD  [$E4E5,X]
      GLDD  A,X
      GLDD  B,X
      GLDD  D,X
      GLDD  [D,X]
      GLDD  $E9,Y
      GLDD  $EBEC,Y
      GLDD  [$ECED,Y]
      GLDD  A,Y
      GLDY  D,Y
      GLDY  [D,Y]
      GLDY  $F1,SP
      GLDY  $F3F4,SP
      GLDY  [$F4F5,SP]
      GLDY  A,SP
      GLDY  B,SP
      GLDY  D,SP
      GLDY  [D,SP]
      GLDY  $2836,PC
      GLDY  <$2741,PC
      GLDY  $2342,PC
      GLDY  >$264B,PC
      GLDY  [$244D,PC]
      GLDY  A,PC
      GLDY  B,PC
      GLDY  D,PC
      GLDY  [D,PC]
      GLDY  0,X
      GLDY  1,+X
      GLDY  8,-X
      GLDY  1,X+
      GLDY  8,X-
      GLDY  0,Y
      GLDY  1,+Y
      GLDY  8,-Y
      GLDY  1,Y+
      GLDY  8,Y-
      GLDY  0,SP
      GLDY  1,+SP
      GLDY  8,-SP
      GLDY  1,SP+
      GLDY  8,SP-
      GLDY  $278C,PC
      GLDY  $E1,X
      GLDY  $E3E4,X
      GLDY  [$E4E5,X]
      GLDY  A,X
      GLDY  B,X
      GLDY  D,X
      GLDY  [D,X]
      GLDY  $E9,Y
      GLDY  $EBEC,Y
      GLDY  [$ECED,Y]
      GLDY  A,Y
      GLDY  B,Y
      GLDX  [D,Y]
      GLDX  $F1,SP
      GLDX  $F3F4,SP
      GLDX  [$F4F5,SP]
      GLDX  A,SP
      GLDX  B,SP
      GLDX  D,SP
      GLDX  [D,SP]
      GLDX  $28D4,PC
      GLDX  <$27DF,PC
      GLDX  $23E0,PC
      GLDX  >$26E9,PC
      GLDX  [$24EB,PC]
      GLDX  A,PC
      GLDX  B,PC
      GLDX  D,PC
      GLDX  [D,PC]
      GLDX  0,X
      GLDX  1,+X
      GLDX  8,-X
      GLDX  1,X+
      GLDX  8,X-
      GLDX  0,Y
      GLDX  1,+Y
      GLDX  8,-Y
      GLDX  1,Y+
      GLDX  8,Y-
      GLDX  0,SP
      GLDX  1,+SP
      GLDX  8,-SP
      GLDX  1,SP+
      GLDX  8,SP-
      GLDX  $282A,PC
      GLDX  $E1,X
      GLDX  $E3E4,X
      GLDX  [$E4E5,X]
      GLDX  A,X
      GLDX  B,X
      GLDX  D,X
      GLDX  [D,X]
      GLDX  $E9,Y
      GLDX  $EBEC,Y
      GLDX  [$ECED,Y]
      GLDX  A,Y
      GLDX  B,Y
      GLDX  D,Y
      GLDS  $F1,SP
      GLDS  $F3F4,SP
      GLDS  [$F4F5,SP]
      GLDS  A,SP
      GLDS  B,SP
      GLDS  D,SP
      GLDS  [D,SP]
      GLDS  $2972,PC
      GLDS  <$287D,PC
      GLDS  $247E,PC
      GLDS  >$2787,PC
      GLDS  [$2589,PC]
      GLDS  A,PC
      GLDS  B,PC
      GLDS  D,PC
      GLDS  [D,PC]
      GLDS  0,X
      GLDS  1,+X
      GLDS  8,-X
      GLDS  1,X+
      GLDS  8,X-
      GLDS  0,Y
      GLDS  1,+Y
      GLDS  8,-Y
      GLDS  1,Y+
      GLDS  8,Y-
      GLDS  0,SP
      GLDS  1,+SP
      GLDS  8,-SP
      GLDS  1,SP+
      GLDS  8,SP-
      GLDS  $28C8,PC
      GLDS  $E1,X
      GLDS  $E3E4,X
      GLDS  [$E4E5,X]
      GLDS  A,X
      GLDS  B,X
      GLDS  D,X
      GLDS  [D,X]
      GLDS  $E9,Y
      GLDS  $EBEC,Y
      GLDS  [$ECED,Y]
      GLDS  A,Y
      GLDS  B,Y
      GLDS  D,Y
      GLDS  [D,Y]
      SUBY  $F1F2
      SUBY  >$0001
      SBEY  $F3F4
      SBEY  >$0001
      ADED  $F4F5
      ADED  >$0001
      ANDY  $F5F6
      ANDY  >$0001
      BITY  $F6F7
      BITY  >$0001
      GLDAB $F7F8
      GLDAB >$0001
      TSTW  $F8F9
      TSTW  >$0001
      EORY  $F9FA
      EORY  >$0001
      ADEY  $FAFB
      ADEY  >$0001
      ORY   $FBFC
      ORY   >$0001
      ADDY  $FCFD
      ADDY  >$0001
      GLDD  $FDFE
      GLDD  >$0001
      GLDY  $FEFF
      GLDY  >$0001
      GLDX  $FF00
      GLDX  >$0001
      GLDS  >$0001
      GLDS  $0102
      MOVW  #$0203, 1,X
      MOVW  #$2122, 1,+X
      MOVW  #$292A, 8,-X
      MOVW  #$3132, 1,X+
      MOVW  #$393A, 8,X-
      MOVW  #$4142, 0,Y
      MOVW  #$6162, 1,+Y
      MOVW  #$696A, 8,-Y
      MOVW  #$7172, 1,Y+
      MOVW  #$797A, 8,Y-
      MOVW  #$8182, 0,SP
      MOVW  #$A1A2, 1,+SP
      MOVW  #$A9AA, 8,-SP
      MOVW  #$B1B2, 1,SP+
      MOVW  #$B9BA, 8,SP-
      MOVW  #$C1C2, $29C4,PC
      MOVW  #$E2E3, $E1,X
      MOVW  #$E5E6, $E3E4,X
      MOVW  #$E6E7, [$E4E5,X]
      MOVW  #$E5E6, A,X
      MOVW  #$E6E7, B,X
      MOVW  #$E7E8, D,X
      MOVW  #$E8E9, [D,X]
      MOVW  #$EAEB, $E9,Y
      MOVW  #$EDEE, $EBEC,Y
      MOVW  #$EEEF, [$ECED,Y]
      MOVW  #$EDEE, A,Y
      MOVW  #$EEEF, B,Y
      MOVW  #$EFF0, D,Y
      MOVW  #$F0F1, [D,Y]
      MOVW  #$F2F3, $F1,SP
      MOVW  #$F5F6, $F3F4,SP
      MOVW  #$F6F7, [$F4F5,SP]
      MOVW  #$F5F6, A,SP
      MOVW  #$F6F7, B,SP
      MOVW  #$F7F8, D,SP
      MOVW  #$F8F9, [D,SP]
      MOVW  #$FAFB, $2B3B,PC
      MOVW  #$0102, <$2A48,PC
      MOVW  #$FDFE, $264B,PC
      MOVW  #$0102, >$2956,PC
      MOVW  #$FEFF, [$275A,PC]
      MOVW  #$FDFE, A,PC
      MOVW  #$FEFF, B,PC
      MOVW  #$FF00, D,PC
      MOVW  #1, [D,PC]
      MOVW  $0304, 2,X
      MOVW  >$0001, 2,X
      MOVW  $2122, 1,+X
      MOVW  >$0001, 1,+X
      MOVW  $292A, 8,-X
      MOVW  >$0001, 8,-X
      MOVW  $3132, 1,X+
      MOVW  >$0001, 1,X+
      MOVW  $393A, 8,X-
      MOVW  >$0001, 8,X-
      MOVW  $4142, 0,Y
      MOVW  >$0001, 0,Y
      MOVW  $6162, 1,+Y
      MOVW  >$0001, 1,+Y
      MOVW  $696A, 8,-Y
      MOVW  >$0001, 8,-Y
      MOVW  $7172, 1,Y+
      MOVW  >$0001, 1,Y+
      MOVW  $797A, 8,Y-
      MOVW  >$0001, 8,Y-
      MOVW  $8182, 0,SP
      MOVW  >$0001, 0,SP
      MOVW  $A1A2, 1,+SP
      MOVW  >$0001, 1,+SP
      MOVW  $A9AA, 8,-SP
      MOVW  >$0001, 8,-SP
      MOVW  $B1B2, 1,SP+
      MOVW  >$0001, 1,SP+
      MOVW  $B9BA, 8,SP-
      MOVW  >$0001, 8,SP-
      MOVW  $C1C2, $2B0C,PC
      MOVW  >$0001, $2B11,PC
      MOVW  $E2E3, $E1,X
      MOVW  >$0001, $E1,X
      MOVW  $E5E6, $E3E4,X
      MOVW  >$0001, $E3E4,X
      MOVW  $E6E7, [$E4E5,X]
      MOVW  >$0001, [$E4E5,X]
      MOVW  $E5E6, A,X
      MOVW  >$0001, A,X
      MOVW  $E6E7, B,X
      MOVW  >$0001, B,X
      MOVW  $E7E8, D,X
      MOVW  >$0001, D,X
      MOVW  $E8E9, [D,X]
      MOVW  >$0001, [D,X]
      MOVW  $EAEB, $E9,Y
      MOVW  >$0001, $E9,Y
      MOVW  $EDEE, $EBEC,Y
      MOVW  >$0001, $EBEC,Y
      MOVW  $EEEF, [$ECED,Y]
      MOVW  >$0001, [$ECED,Y]
      MOVW  $EDEE, A,Y
      MOVW  >$0001, A,Y
      MOVW  $EEEF, B,Y
      MOVW  >$0001, B,Y
      MOVW  $EFF0, D,Y
      MOVW  >$0001, D,Y
      MOVW  $F0F1, [D,Y]
      MOVW  >$0001, [D,Y]
      MOVW  $F2F3, $F1,SP
      MOVW  >$0001, $F1,SP
      MOVW  $F5F6, $F3F4,SP
      MOVW  >$0001, $F3F4,SP
      MOVW  $F6F7, [$F4F5,SP]
      MOVW  >$0001, [$F4F5,SP]
      MOVW  $F5F6, A,SP
      MOVW  >$0001, A,SP
      MOVW  $F6F7, B,SP
      MOVW  >$0001, B,SP
      MOVW  $F7F8, D,SP
      MOVW  >$0001, D,SP
      MOVW  $F8F9, [D,SP]
      MOVW  >$0001, [D,SP]
      MOVW  $FAFB, $2D00,PC
      MOVW  >$0001, $2D06,PC
      MOVW  $0102, <$2C13,PC
      MOVW  >$0001, <$2C19,PC
      MOVW  $FDFE, $281C,PC
      MOVW  >$0001, $2823,PC
      MOVW  $0102, >$2B2E,PC
      MOVW  >$0001, >$2B35,PC
      MOVW  $FEFF, [$2939,PC]
      MOVW  >$0001, [$2940,PC]
      MOVW  $FDFE, A,PC
      MOVW  >$0001, A,PC
      MOVW  $FEFF, B,PC
      MOVW  >$0001, B,PC
      MOVW  $FF00, D,PC
      MOVW  >$0001, D,PC
      MOVW  >$0001, [D,PC]
      MOVW  $0102, [D,PC]
      MOVW  3,X, 4,X
      MOVW  3,X, 1,+X
      MOVW  3,X, 8,-X
      MOVW  3,X, 1,X+
      MOVW  3,X, 8,X-
      MOVW  3,X, 0,Y
      MOVW  3,X, 1,+Y
      MOVW  3,X, 8,-Y
      MOVW  3,X, 1,Y+
      MOVW  3,X, 8,Y-
      MOVW  3,X, 0,SP
      MOVW  3,X, 1,+SP
      MOVW  3,X, 8,-SP
      MOVW  3,X, 1,SP+
      MOVW  3,X, 8,SP-
      MOVW  3,X, $2CAB,PC
      MOVW  3,X, $E1,X
      MOVW  3,X, $E3E4,X
      MOVW  3,X, [$E4E5,X]
      MOVW  3,X, A,X
      MOVW  3,X, B,X
      MOVW  3,X, D,X
      MOVW  3,X, [D,X]
      MOVW  3,X, $E9,Y
      MOVW  3,X, $EBEC,Y
      MOVW  3,X, [$ECED,Y]
      MOVW  3,X, A,Y
      MOVW  3,X, B,Y
      MOVW  3,X, D,Y
      MOVW  3,X, [D,Y]
      MOVW  3,X, $F1,SP
      MOVW  3,X, $F3F4,SP
      MOVW  3,X, [$F4F5,SP]
      MOVW  3,X, A,SP
      MOVW  3,X, B,SP
      MOVW  3,X, D,SP
      MOVW  3,X, [D,SP]
      MOVW  3,X, $2E0C,PC
      MOVW  3,X, <$2D18,PC
      MOVW  3,X, $291A,PC
      MOVW  3,X, >$2C24,PC
      MOVW  3,X, [$2A27,PC]
      MOVW  3,X, A,PC
      MOVW  3,X, B,PC
      MOVW  3,X, D,PC
      MOVW  3,X, [D,PC]
      MOVW  1,+X, 2,+X
      MOVW  1,+X, 8,-X
      MOVW  1,+X, 1,X+
      MOVW  1,+X, 8,X-
      MOVW  1,+X, 0,Y
      MOVW  1,+X, 1,+Y
      MOVW  1,+X, 8,-Y
      MOVW  1,+X, 1,Y+
      MOVW  1,+X, 8,Y-
      MOVW  1,+X, 0,SP
      MOVW  1,+X, 1,+SP
      MOVW  1,+X, 8,-SP
      MOVW  1,+X, 1,SP+
      MOVW  1,+X, 8,SP-
      MOVW  1,+X, $2D76,PC
      MOVW  1,+X, $E1,X
      MOVW  1,+X, $E3E4,X
      MOVW  1,+X, [$E4E5,X]
      MOVW  1,+X, A,X
      MOVW  1,+X, B,X
      MOVW  1,+X, D,X
      MOVW  1,+X, [D,X]
      MOVW  1,+X, $E9,Y
      MOVW  1,+X, $EBEC,Y
      MOVW  1,+X, [$ECED,Y]
      MOVW  1,+X, A,Y
      MOVW  1,+X, B,Y
      MOVW  1,+X, D,Y
      MOVW  1,+X, [D,Y]
      MOVW  1,+X, $F1,SP
      MOVW  1,+X, $F3F4,SP
      MOVW  1,+X, [$F4F5,SP]
      MOVW  1,+X, A,SP
      MOVW  1,+X, B,SP
      MOVW  1,+X, D,SP
      MOVW  1,+X, [D,SP]
      MOVW  1,+X, $2ED7,PC
      MOVW  1,+X, <$2DE3,PC
      MOVW  1,+X, $29E5,PC
      MOVW  1,+X, >$2CEF,PC
      MOVW  1,+X, [$2AF2,PC]
      MOVW  1,+X, A,PC
      MOVW  1,+X, B,PC
      MOVW  1,+X, D,PC
      MOVW  1,+X, [D,PC]
      MOVW  1,+X, 0,X
      MOVW  8,-X, 7,-X
      MOVW  8,-X, 1,X+
      MOVW  8,-X, 8,X-
      MOVW  8,-X, 0,Y
      MOVW  8,-X, 1,+Y
      MOVW  8,-X, 8,-Y
      MOVW  8,-X, 1,Y+
      MOVW  8,-X, 8,Y-
      MOVW  8,-X, 0,SP
      MOVW  8,-X, 1,+SP
      MOVW  8,-X, 8,-SP
      MOVW  8,-X, 1,SP+
      MOVW  8,-X, 8,SP-
      MOVW  8,-X, $2E41,PC
      MOVW  8,-X, $E1,X
      MOVW  8,-X, $E3E4,X
      MOVW  8,-X, [$E4E5,X]
      MOVW  8,-X, A,X
      MOVW  8,-X, B,X
      MOVW  8,-X, D,X
      MOVW  8,-X, [D,X]
      MOVW  8,-X, $E9,Y
      MOVW  8,-X, $EBEC,Y
      MOVW  8,-X, [$ECED,Y]
      MOVW  8,-X, A,Y
      MOVW  8,-X, B,Y
      MOVW  8,-X, D,Y
      MOVW  8,-X, [D,Y]
      MOVW  8,-X, $F1,SP
      MOVW  8,-X, $F3F4,SP
      MOVW  8,-X, [$F4F5,SP]
      MOVW  8,-X, A,SP
      MOVW  8,-X, B,SP
      MOVW  8,-X, D,SP
      MOVW  8,-X, [D,SP]
      MOVW  8,-X, $2FA2,PC
      MOVW  8,-X, <$2EAE,PC
      MOVW  8,-X, $2AB0,PC
      MOVW  8,-X, >$2DBA,PC
      MOVW  8,-X, [$2BBD,PC]
      MOVW  8,-X, A,PC
      MOVW  8,-X, B,PC
      MOVW  8,-X, D,PC
      MOVW  8,-X, [D,PC]
      MOVW  8,-X, 0,X
      MOVW  8,-X, 1,+X
      MOVW  1,X+, 2,X+
      MOVW  1,X+, 8,X-
      MOVW  1,X+, 0,Y
      MOVW  1,X+, 1,+Y
      MOVW  1,X+, 8,-Y
      MOVW  1,X+, 1,Y+
      MOVW  1,X+, 8,Y-
      MOVW  1,X+, 0,SP
      MOVW  1,X+, 1,+SP
      MOVW  1,X+, 8,-SP
      MOVW  1,X+, 1,SP+
      MOVW  1,X+, 8,SP-
      MOVW  1,X+, $2F0C,PC
      MOVW  1,X+, $E1,X
      MOVW  1,X+, $E3E4,X
      MOVW  1,X+, [$E4E5,X]
      MOVW  1,X+, A,X
      MOVW  1,X+, B,X
      MOVW  1,X+, D,X
      MOVW  1,X+, [D,X]
      MOVW  1,X+, $E9,Y
      MOVW  1,X+, $EBEC,Y
      MOVW  1,X+, [$ECED,Y]
      MOVW  1,X+, A,Y
      MOVW  1,X+, B,Y
      MOVW  1,X+, D,Y
      MOVW  1,X+, [D,Y]
      MOVW  1,X+, $F1,SP
      MOVW  1,X+, $F3F4,SP
      MOVW  1,X+, [$F4F5,SP]
      MOVW  1,X+, A,SP
      MOVW  1,X+, B,SP
      MOVW  1,X+, D,SP
      MOVW  1,X+, [D,SP]
      MOVW  1,X+, $306D,PC
      MOVW  1,X+, <$2F79,PC
      MOVW  1,X+, $2B7B,PC
      MOVW  1,X+, >$2E85,PC
      MOVW  1,X+, [$2C88,PC]
      MOVW  1,X+, A,PC
      MOVW  1,X+, B,PC
      MOVW  1,X+, D,PC
      MOVW  1,X+, [D,PC]
      MOVW  1,X+, 0,X
      MOVW  1,X+, 1,+X
      MOVW  1,X+, 8,-X
      MOVW  8,X-, 7,X-
      MOVW  8,X-, 0,Y
      MOVW  8,X-, 1,+Y
      MOVW  8,X-, 8,-Y
      MOVW  8,X-, 1,Y+
      MOVW  8,X-, 8,Y-
      MOVW  8,X-, 0,SP
      MOVW  8,X-, 1,+SP
      MOVW  8,X-, 8,-SP
      MOVW  8,X-, 1,SP+
      MOVW  8,X-, 8,SP-
      MOVW  8,X-, $2FD7,PC
      MOVW  8,X-, $E1,X
      MOVW  8,X-, $E3E4,X
      MOVW  8,X-, [$E4E5,X]
      MOVW  8,X-, A,X
      MOVW  8,X-, B,X
      MOVW  8,X-, D,X
      MOVW  8,X-, [D,X]
      MOVW  8,X-, $E9,Y
      MOVW  8,X-, $EBEC,Y
      MOVW  8,X-, [$ECED,Y]
      MOVW  8,X-, A,Y
      MOVW  8,X-, B,Y
      MOVW  8,X-, D,Y
      MOVW  8,X-, [D,Y]
      MOVW  8,X-, $F1,SP
      MOVW  8,X-, $F3F4,SP
      MOVW  8,X-, [$F4F5,SP]
      MOVW  8,X-, A,SP
      MOVW  8,X-, B,SP
      MOVW  8,X-, D,SP
      MOVW  8,X-, [D,SP]
      MOVW  8,X-, $3138,PC
      MOVW  8,X-, <$3044,PC
      MOVW  8,X-, $2C46,PC
      MOVW  8,X-, >$2F50,PC
      MOVW  8,X-, [$2D53,PC]
      MOVW  8,X-, A,PC
      MOVW  8,X-, B,PC
      MOVW  8,X-, D,PC
      MOVW  8,X-, [D,PC]
      MOVW  8,X-, 0,X
      MOVW  8,X-, 1,+X
      MOVW  8,X-, 8,-X
      MOVW  8,X-, 1,X+
      MOVW  0,Y, 1,Y
      MOVW  0,Y, 1,+Y
      MOVW  0,Y, 8,-Y
      MOVW  0,Y, 1,Y+
      MOVW  0,Y, 8,Y-
      MOVW  0,Y, 0,SP
      MOVW  0,Y, 1,+SP
      MOVW  0,Y, 8,-SP
      MOVW  0,Y, 1,SP+
      MOVW  0,Y, 8,SP-
      MOVW  0,Y, $30A2,PC
      MOVW  0,Y, $E1,X
      MOVW  0,Y, $E3E4,X
      MOVW  0,Y, [$E4E5,X]
      MOVW  0,Y, A,X
      MOVW  0,Y, B,X
      MOVW  0,Y, D,X
      MOVW  0,Y, [D,X]
      MOVW  0,Y, $E9,Y
      MOVW  0,Y, $EBEC,Y
      MOVW  0,Y, [$ECED,Y]
      MOVW  0,Y, A,Y
      MOVW  0,Y, B,Y
      MOVW  0,Y, D,Y
      MOVW  0,Y, [D,Y]
      MOVW  0,Y, $F1,SP
      MOVW  0,Y, $F3F4,SP
      MOVW  0,Y, [$F4F5,SP]
      MOVW  0,Y, A,SP
      MOVW  0,Y, B,SP
      MOVW  0,Y, D,SP
      MOVW  0,Y, [D,SP]
      MOVW  0,Y, $3203,PC
      MOVW  0,Y, <$310F,PC
      MOVW  0,Y, $2D11,PC
      MOVW  0,Y, >$301B,PC
      MOVW  0,Y, [$2E1E,PC]
      MOVW  0,Y, A,PC
      MOVW  0,Y, B,PC
      MOVW  0,Y, D,PC
      MOVW  0,Y, [D,PC]
      MOVW  0,Y, 0,X
      MOVW  0,Y, 1,+X
      MOVW  0,Y, 8,-X
      MOVW  0,Y, 1,X+
      MOVW  0,Y, 8,X-
      MOVW  1,+Y, 2,+Y
      MOVW  1,+Y, 8,-Y
      MOVW  1,+Y, 1,Y+
      MOVW  1,+Y, 8,Y-
      MOVW  1,+Y, 0,SP
      MOVW  1,+Y, 1,+SP
      MOVW  1,+Y, 8,-SP
      MOVW  1,+Y, 1,SP+
      MOVW  1,+Y, 8,SP-
      MOVW  1,+Y, $316D,PC
      MOVW  1,+Y, $E1,X
      MOVW  1,+Y, $E3E4,X
      MOVW  1,+Y, [$E4E5,X]
      MOVW  1,+Y, A,X
      MOVW  1,+Y, B,X
      MOVW  1,+Y, D,X
      MOVW  1,+Y, [D,X]
      MOVW  1,+Y, $E9,Y
      MOVW  1,+Y, $EBEC,Y
      MOVW  1,+Y, [$ECED,Y]
      MOVW  1,+Y, A,Y
      MOVW  1,+Y, B,Y
      MOVW  1,+Y, D,Y
      MOVW  1,+Y, [D,Y]
      MOVW  1,+Y, $F1,SP
      MOVW  1,+Y, $F3F4,SP
      MOVW  1,+Y, [$F4F5,SP]
      MOVW  1,+Y, A,SP
      MOVW  1,+Y, B,SP
      MOVW  1,+Y, D,SP
      MOVW  1,+Y, [D,SP]
      MOVW  1,+Y, $32CE,PC
      MOVW  1,+Y, <$31DA,PC
      MOVW  1,+Y, $2DDC,PC
      MOVW  1,+Y, >$30E6,PC
      MOVW  1,+Y, [$2EE9,PC]
      MOVW  1,+Y, A,PC
      MOVW  1,+Y, B,PC
      MOVW  1,+Y, D,PC
      MOVW  1,+Y, [D,PC]
      MOVW  1,+Y, 0,X
      MOVW  1,+Y, 1,+X
      MOVW  1,+Y, 8,-X
      MOVW  1,+Y, 1,X+
      MOVW  1,+Y, 8,X-
      MOVW  1,+Y, 0,Y
      MOVW  8,-Y, 7,-Y
      MOVW  8,-Y, 1,Y+
      MOVW  8,-Y, 8,Y-
      MOVW  8,-Y, 0,SP
      MOVW  8,-Y, 1,+SP
      MOVW  8,-Y, 8,-SP
      MOVW  8,-Y, 1,SP+
      MOVW  8,-Y, 8,SP-
      MOVW  8,-Y, $3238,PC
      MOVW  8,-Y, $E1,X
      MOVW  8,-Y, $E3E4,X
      MOVW  8,-Y, [$E4E5,X]
      MOVW  8,-Y, A,X
      MOVW  8,-Y, B,X
      MOVW  8,-Y, D,X
      MOVW  8,-Y, [D,X]
      MOVW  8,-Y, $E9,Y
      MOVW  8,-Y, $EBEC,Y
      MOVW  8,-Y, [$ECED,Y]
      MOVW  8,-Y, A,Y
      MOVW  8,-Y, B,Y
      MOVW  8,-Y, D,Y
      MOVW  8,-Y, [D,Y]
      MOVW  8,-Y, $F1,SP
      MOVW  8,-Y, $F3F4,SP
      MOVW  8,-Y, [$F4F5,SP]
      MOVW  8,-Y, A,SP
      MOVW  8,-Y, B,SP
      MOVW  8,-Y, D,SP
      MOVW  8,-Y, [D,SP]
      MOVW  8,-Y, $3399,PC
      MOVW  8,-Y, <$32A5,PC
      MOVW  8,-Y, $2EA7,PC
      MOVW  8,-Y, >$31B1,PC
      MOVW  8,-Y, [$2FB4,PC]
      MOVW  8,-Y, A,PC
      MOVW  8,-Y, B,PC
      MOVW  8,-Y, D,PC
      MOVW  8,-Y, [D,PC]
      MOVW  8,-Y, 0,X
      MOVW  8,-Y, 1,+X
      MOVW  8,-Y, 8,-X
      MOVW  8,-Y, 1,X+
      MOVW  8,-Y, 8,X-
      MOVW  8,-Y, 0,Y
      MOVW  8,-Y, 1,+Y
      MOVW  1,Y+, 2,Y+
      MOVW  1,Y+, 8,Y-
      MOVW  1,Y+, 0,SP
      MOVW  1,Y+, 1,+SP
      MOVW  1,Y+, 8,-SP
      MOVW  1,Y+, 1,SP+
      MOVW  1,Y+, 8,SP-
      MOVW  1,Y+, $3303,PC
      MOVW  1,Y+, $E1,X
      MOVW  1,Y+, $E3E4,X
      MOVW  1,Y+, [$E4E5,X]
      MOVW  1,Y+, A,X
      MOVW  1,Y+, B,X
      MOVW  1,Y+, D,X
      MOVW  1,Y+, [D,X]
      MOVW  1,Y+, $E9,Y
      MOVW  1,Y+, $EBEC,Y
      MOVW  1,Y+, [$ECED,Y]
      MOVW  1,Y+, A,Y
      MOVW  1,Y+, B,Y
      MOVW  1,Y+, D,Y
      MOVW  1,Y+, [D,Y]
      MOVW  1,Y+, $F1,SP
      MOVW  1,Y+, $F3F4,SP
      MOVW  1,Y+, [$F4F5,SP]
      MOVW  1,Y+, A,SP
      MOVW  1,Y+, B,SP
      MOVW  1,Y+, D,SP
      MOVW  1,Y+, [D,SP]
      MOVW  1,Y+, $3464,PC
      MOVW  1,Y+, <$3370,PC
      MOVW  1,Y+, $2F72,PC
      MOVW  1,Y+, >$327C,PC
      MOVW  1,Y+, [$307F,PC]
      MOVW  1,Y+, A,PC
      MOVW  1,Y+, B,PC
      MOVW  1,Y+, D,PC
      MOVW  1,Y+, [D,PC]
      MOVW  1,Y+, 0,X
      MOVW  1,Y+, 1,+X
      MOVW  1,Y+, 8,-X
      MOVW  1,Y+, 1,X+
      MOVW  1,Y+, 8,X-
      MOVW  1,Y+, 0,Y
      MOVW  1,Y+, 1,+Y
      MOVW  1,Y+, 8,-Y
      MOVW  8,Y-, 7,Y-
      MOVW  8,Y-, 0,SP
      MOVW  8,Y-, 1,+SP
      MOVW  8,Y-, 8,-SP
      MOVW  8,Y-, 1,SP+
      MOVW  8,Y-, 8,SP-
      MOVW  8,Y-, $33CE,PC
      MOVW  8,Y-, $E1,X
      MOVW  8,Y-, $E3E4,X
      MOVW  8,Y-, [$E4E5,X]
      MOVW  8,Y-, A,X
      MOVW  8,Y-, B,X
      MOVW  8,Y-, D,X
      MOVW  8,Y-, [D,X]
      MOVW  8,Y-, $E9,Y
      MOVW  8,Y-, $EBEC,Y
      MOVW  8,Y-, [$ECED,Y]
      MOVW  8,Y-, A,Y
      MOVW  8,Y-, B,Y
      MOVW  8,Y-, D,Y
      MOVW  8,Y-, [D,Y]
      MOVW  8,Y-, $F1,SP
      MOVW  8,Y-, $F3F4,SP
      MOVW  8,Y-, [$F4F5,SP]
      MOVW  8,Y-, A,SP
      MOVW  8,Y-, B,SP
      MOVW  8,Y-, D,SP
      MOVW  8,Y-, [D,SP]
      MOVW  8,Y-, $352F,PC
      MOVW  8,Y-, <$343B,PC
      MOVW  8,Y-, $303D,PC
      MOVW  8,Y-, >$3347,PC
      MOVW  8,Y-, [$314A,PC]
      MOVW  8,Y-, A,PC
      MOVW  8,Y-, B,PC
      MOVW  8,Y-, D,PC
      MOVW  8,Y-, [D,PC]
      MOVW  8,Y-, 0,X
      MOVW  8,Y-, 1,+X
      MOVW  8,Y-, 8,-X
      MOVW  8,Y-, 1,X+
      MOVW  8,Y-, 8,X-
      MOVW  8,Y-, 0,Y
      MOVW  8,Y-, 1,+Y
      MOVW  8,Y-, 8,-Y
      MOVW  8,Y-, 1,Y+
      MOVW  0,SP, 1,SP
      MOVW  0,SP, 1,+SP
      MOVW  0,SP, 8,-SP
      MOVW  0,SP, 1,SP+
      MOVW  0,SP, 8,SP-
      MOVW  0,SP, $3499,PC
      MOVW  0,SP, $E1,X
      MOVW  0,SP, $E3E4,X
      MOVW  0,SP, [$E4E5,X]
      MOVW  0,SP, A,X
      MOVW  0,SP, B,X
      MOVW  0,SP, D,X
      MOVW  0,SP, [D,X]
      MOVW  0,SP, $E9,Y
      MOVW  0,SP, $EBEC,Y
      MOVW  0,SP, [$ECED,Y]
      MOVW  0,SP, A,Y
      MOVW  0,SP, B,Y
      MOVW  0,SP, D,Y
      MOVW  0,SP, [D,Y]
      MOVW  0,SP, $F1,SP
      MOVW  0,SP, $F3F4,SP
      MOVW  0,SP, [$F4F5,SP]
      MOVW  0,SP, A,SP
      MOVW  0,SP, B,SP
      MOVW  0,SP, D,SP
      MOVW  0,SP, [D,SP]
      MOVW  0,SP, $35FA,PC
      MOVW  0,SP, <$3506,PC
      MOVW  0,SP, $3108,PC
      MOVW  0,SP, >$3412,PC
      MOVW  0,SP, [$3215,PC]
      MOVW  0,SP, A,PC
      MOVW  0,SP, B,PC
      MOVW  0,SP, D,PC
      MOVW  0,SP, [D,PC]
      MOVW  0,SP, 0,X
      MOVW  0,SP, 1,+X
      MOVW  0,SP, 8,-X
      MOVW  0,SP, 1,X+
      MOVW  0,SP, 8,X-
      MOVW  0,SP, 0,Y
      MOVW  0,SP, 1,+Y
      MOVW  0,SP, 8,-Y
      MOVW  0,SP, 1,Y+
      MOVW  0,SP, 8,Y-
      MOVW  1,+SP, 2,+SP
      MOVW  1,+SP, 8,-SP
      MOVW  1,+SP, 1,SP+
      MOVW  1,+SP, 8,SP-
      MOVW  1,+SP, $3564,PC
      MOVW  1,+SP, $E1,X
      MOVW  1,+SP, $E3E4,X
      MOVW  1,+SP, [$E4E5,X]
      MOVW  1,+SP, A,X
      MOVW  1,+SP, B,X
      MOVW  1,+SP, D,X
      MOVW  1,+SP, [D,X]
      MOVW  1,+SP, $E9,Y
      MOVW  1,+SP, $EBEC,Y
      MOVW  1,+SP, [$ECED,Y]
      MOVW  1,+SP, A,Y
      MOVW  1,+SP, B,Y
      MOVW  1,+SP, D,Y
      MOVW  1,+SP, [D,Y]
      MOVW  1,+SP, $F1,SP
      MOVW  1,+SP, $F3F4,SP
      MOVW  1,+SP, [$F4F5,SP]
      MOVW  1,+SP, A,SP
      MOVW  1,+SP, B,SP
      MOVW  1,+SP, D,SP
      MOVW  1,+SP, [D,SP]
      MOVW  1,+SP, $36C5,PC
      MOVW  1,+SP, <$35D1,PC
      MOVW  1,+SP, $31D3,PC
      MOVW  1,+SP, >$34DD,PC
      MOVW  1,+SP, [$32E0,PC]
      MOVW  1,+SP, A,PC
      MOVW  1,+SP, B,PC
      MOVW  1,+SP, D,PC
      MOVW  1,+SP, [D,PC]
      MOVW  1,+SP, 0,X
      MOVW  1,+SP, 1,+X
      MOVW  1,+SP, 8,-X
      MOVW  1,+SP, 1,X+
      MOVW  1,+SP, 8,X-
      MOVW  1,+SP, 0,Y
      MOVW  1,+SP, 1,+Y
      MOVW  1,+SP, 8,-Y
      MOVW  1,+SP, 1,Y+
      MOVW  1,+SP, 8,Y-
      MOVW  1,+SP, 0,SP
      MOVW  8,-SP, 7,-SP
      MOVW  8,-SP, 1,SP+
      MOVW  8,-SP, 8,SP-
      MOVW  8,-SP, $362F,PC
      MOVW  8,-SP, $E1,X
      MOVW  8,-SP, $E3E4,X
      MOVW  8,-SP, [$E4E5,X]
      MOVW  8,-SP, A,X
      MOVW  8,-SP, B,X
      MOVW  8,-SP, D,X
      MOVW  8,-SP, [D,X]
      MOVW  8,-SP, $E9,Y
      MOVW  8,-SP, $EBEC,Y
      MOVW  8,-SP, [$ECED,Y]
      MOVW  8,-SP, A,Y
      MOVW  8,-SP, B,Y
      MOVW  8,-SP, D,Y
      MOVW  8,-SP, [D,Y]
      MOVW  8,-SP, $F1,SP
      MOVW  8,-SP, $F3F4,SP
      MOVW  8,-SP, [$F4F5,SP]
      MOVW  8,-SP, A,SP
      MOVW  8,-SP, B,SP
      MOVW  8,-SP, D,SP
      MOVW  8,-SP, [D,SP]
      MOVW  8,-SP, $3790,PC
      MOVW  8,-SP, <$369C,PC
      MOVW  8,-SP, $329E,PC
      MOVW  8,-SP, >$35A8,PC
      MOVW  8,-SP, [$33AB,PC]
      MOVW  8,-SP, A,PC
      MOVW  8,-SP, B,PC
      MOVW  8,-SP, D,PC
      MOVW  8,-SP, [D,PC]
      MOVW  8,-SP, 0,X
      MOVW  8,-SP, 1,+X
      MOVW  8,-SP, 8,-X
      MOVW  8,-SP, 1,X+
      MOVW  8,-SP, 8,X-
      MOVW  8,-SP, 0,Y
      MOVW  8,-SP, 1,+Y
      MOVW  8,-SP, 8,-Y
      MOVW  8,-SP, 1,Y+
      MOVW  8,-SP, 8,Y-
      MOVW  8,-SP, 0,SP
      MOVW  8,-SP, 1,+SP
      MOVW  1,SP+, 2,SP+
      MOVW  1,SP+, 8,SP-
      MOVW  1,SP+, $36FA,PC
      MOVW  1,SP+, $E1,X
      MOVW  1,SP+, $E3E4,X
      MOVW  1,SP+, [$E4E5,X]
      MOVW  1,SP+, A,X
      MOVW  1,SP+, B,X
      MOVW  1,SP+, D,X
      MOVW  1,SP+, [D,X]
      MOVW  1,SP+, $E9,Y
      MOVW  1,SP+, $EBEC,Y
      MOVW  1,SP+, [$ECED,Y]
      MOVW  1,SP+, A,Y
      MOVW  1,SP+, B,Y
      MOVW  1,SP+, D,Y
      MOVW  1,SP+, [D,Y]
      MOVW  1,SP+, $F1,SP
      MOVW  1,SP+, $F3F4,SP
      MOVW  1,SP+, [$F4F5,SP]
      MOVW  1,SP+, A,SP
      MOVW  1,SP+, B,SP
      MOVW  1,SP+, D,SP
      MOVW  1,SP+, [D,SP]
      MOVW  1,SP+, $385B,PC
      MOVW  1,SP+, <$3767,PC
      MOVW  1,SP+, $3369,PC
      MOVW  1,SP+, >$3673,PC
      MOVW  1,SP+, [$3476,PC]
      MOVW  1,SP+, A,PC
      MOVW  1,SP+, B,PC
      MOVW  1,SP+, D,PC
      MOVW  1,SP+, [D,PC]
      MOVW  1,SP+, 0,X
      MOVW  1,SP+, 1,+X
      MOVW  1,SP+, 8,-X
      MOVW  1,SP+, 1,X+
      MOVW  1,SP+, 8,X-
      MOVW  1,SP+, 0,Y
      MOVW  1,SP+, 1,+Y
      MOVW  1,SP+, 8,-Y
      MOVW  1,SP+, 1,Y+
      MOVW  1,SP+, 8,Y-
      MOVW  1,SP+, 0,SP
      MOVW  1,SP+, 1,+SP
      MOVW  1,SP+, 8,-SP
      MOVW  8,SP-, 7,SP-
      MOVW  8,SP-, $37C5,PC
      MOVW  8,SP-, $E1,X
      MOVW  8,SP-, $E3E4,X
      MOVW  8,SP-, [$E4E5,X]
      MOVW  8,SP-, A,X
      MOVW  8,SP-, B,X
      MOVW  8,SP-, D,X
      MOVW  8,SP-, [D,X]
      MOVW  8,SP-, $E9,Y
      MOVW  8,SP-, $EBEC,Y
      MOVW  8,SP-, [$ECED,Y]
      MOVW  8,SP-, A,Y
      MOVW  8,SP-, B,Y
      MOVW  8,SP-, D,Y
      MOVW  8,SP-, [D,Y]
      MOVW  8,SP-, $F1,SP
      MOVW  8,SP-, $F3F4,SP
      MOVW  8,SP-, [$F4F5,SP]
      MOVW  8,SP-, A,SP
      MOVW  8,SP-, B,SP
      MOVW  8,SP-, D,SP
      MOVW  8,SP-, [D,SP]
      MOVW  8,SP-, $3926,PC
      MOVW  8,SP-, <$3832,PC
      MOVW  8,SP-, $3434,PC
      MOVW  8,SP-, >$373E,PC
      MOVW  8,SP-, [$3541,PC]
      MOVW  8,SP-, A,PC
      MOVW  8,SP-, B,PC
      MOVW  8,SP-, D,PC
      MOVW  8,SP-, [D,PC]
      MOVW  8,SP-, 0,X
      MOVW  8,SP-, 1,+X
      MOVW  8,SP-, 8,-X
      MOVW  8,SP-, 1,X+
      MOVW  8,SP-, 8,X-
      MOVW  8,SP-, 0,Y
      MOVW  8,SP-, 1,+Y
      MOVW  8,SP-, 8,-Y
      MOVW  8,SP-, 1,Y+
      MOVW  8,SP-, 8,Y-
      MOVW  8,SP-, 0,SP
      MOVW  8,SP-, 1,+SP
      MOVW  8,SP-, 8,-SP
      MOVW  8,SP-, 1,SP+
      MOVW  $3890,PC, $3891,PC
      MOVW  $3894,PC, $E1,X
      MOVW  $3899,PC, $E3E4,X
      MOVW  $389F,PC, [$E4E5,X]
      MOVW  $38A5,PC, A,X
      MOVW  $38A9,PC, B,X
      MOVW  $38AD,PC, D,X
      MOVW  $38B1,PC, [D,X]
      MOVW  $38B5,PC, $E9,Y
      MOVW  $38BA,PC, $EBEC,Y
      MOVW  $38C0,PC, [$ECED,Y]
      MOVW  $38C6,PC, A,Y
      MOVW  $38CA,PC, B,Y
      MOVW  $38CE,PC, D,Y
      MOVW  $38D2,PC, [D,Y]
      MOVW  $38D6,PC, $F1,SP
      MOVW  $38DB,PC, $F3F4,SP
      MOVW  $38E1,PC, [$F4F5,SP]
      MOVW  $38E7,PC, A,SP
      MOVW  $38EB,PC, B,SP
      MOVW  $38EF,PC, D,SP
      MOVW  $38F3,PC, [D,SP]
      MOVW  $38F7,PC, $39F1,PC
      MOVW  $38FC,PC, <$38FD,PC
      MOVW  $3901,PC, $34FF,PC
      MOVW  $3907,PC, >$3809,PC
      MOVW  $390D,PC, [$360C,PC]
      MOVW  $3913,PC, A,PC
      MOVW  $3917,PC, B,PC
      MOVW  $391B,PC, D,PC
      MOVW  $391F,PC, [D,PC]
      MOVW  $3923,PC, 0,X
      MOVW  $3927,PC, 1,+X
      MOVW  $392B,PC, 8,-X
      MOVW  $392F,PC, 1,X+
      MOVW  $3933,PC, 8,X-
      MOVW  $3937,PC, 0,Y
      MOVW  $393B,PC, 1,+Y
      MOVW  $393F,PC, 8,-Y
      MOVW  $3943,PC, 1,Y+
      MOVW  $3947,PC, 8,Y-
      MOVW  $394B,PC, 0,SP
      MOVW  $394F,PC, 1,+SP
      MOVW  $3953,PC, 8,-SP
      MOVW  $3957,PC, 1,SP+
      MOVW  $395B,PC, 8,SP-
      MOVW  $E1,X, $E3E4,X
      MOVW  $E1,X, [$E4E5,X]
      MOVW  $E1,X, A,X
      MOVW  $E1,X, B,X
      MOVW  $E1,X, D,X
      MOVW  $E1,X, [D,X]
      MOVW  $E9,X, $EBEC,Y
      MOVW  $E9,X, [$ECED,Y]
      MOVW  $E9,X, A,Y
      MOVW  $E9,X, B,Y
      MOVW  $E9,X, D,Y
      MOVW  $E9,X, [D,Y]
      MOVW  $F1,X, $F3F4,SP
      MOVW  $F1,X, [$F4F5,SP]
      MOVW  $F1,X, A,SP
      MOVW  $F1,X, B,SP
      MOVW  $F1,X, D,SP
      MOVW  $F1,X, [D,SP]
      MOVW  $F8,X, <$39C1,PC
      MOVW  $F9,X, $35CA,PC
      MOVW  $F9,X, >$38D5,PC
      MOVW  $F9,X, [$36D9,PC]
      MOVW  $F9,X, A,PC
      MOVW  $F9,X, B,PC
      MOVW  $F9,X, D,PC
      MOVW  $F9,X, [D,PC]
      MOVW  $F9,X, 1,+X
      MOVW  $F9,X, 8,-X
      MOVW  $F9,X, 1,X+
      MOVW  $F9,X, 8,X-
      MOVW  $F9,X, 1,+Y
      MOVW  $F9,X, 8,-Y
      MOVW  $F9,X, 1,Y+
      MOVW  $F9,X, 8,Y-
      MOVW  $F9,X, 1,+SP
      MOVW  $F9,X, 8,-SP
      MOVW  $F9,X, 1,SP+
      MOVW  $F9,X, 8,SP-
      MOVW  $E3E4,X, B,X
      MOVW  $E3E4,X, D,X
      MOVW  $E3E4,X, [D,X]
      MOVW  $E3E9,X, $EBEC,Y
      MOVW  $E3E9,X, [$ECED,Y]
      MOVW  $E3E9,X, A,Y
      MOVW  $E3E9,X, B,Y
      MOVW  $E3E9,X, D,Y
      MOVW  $E3E9,X, [D,Y]
      MOVW  $E3F1,X, $F3F4,SP
      MOVW  $E3F1,X, [$F4F5,SP]
      MOVW  $E3F1,X, A,SP
      MOVW  $E3F1,X, B,SP
      MOVW  $E3F1,X, D,SP
      MOVW  $E3F1,X, [D,SP]
      MOVW  $E3F8,X, <$3A8F,PC
      MOVW  $E3F9,X, $3699,PC
      MOVW  $E3F9,X, >$39A5,PC
      MOVW  $E3F9,X, [$37AA,PC]
      MOVW  $E3F9,X, A,PC
      MOVW  $E3F9,X, B,PC
      MOVW  $E3F9,X, D,PC
      MOVW  $E3F9,X, [D,PC]
      MOVW  [$E4E5,X], D,X
      MOVW  [$E4E5,X], [D,X]
      MOVW  [$E4E5,X], $E9,Y
      MOVW  [$E4E5,X], $EBEC,Y
      MOVW  [$E4E5,X], [$ECED,Y]
      MOVW  [$E4E5,X], A,Y
      MOVW  [$E4E5,X], B,Y
      MOVW  [$E4E5,X], D,Y
      MOVW  [$E4E5,X], [D,Y]
      MOVW  [$E4E5,X], $F1,SP
      MOVW  [$E4E5,X], $F3F4,SP
      MOVW  [$E4E5,X], [$F4F5,SP]
      MOVW  [$E4E5,X], A,SP
      MOVW  [$E4E5,X], B,SP
      MOVW  [$E4E5,X], D,SP
      MOVW  [$E4E5,X], [D,SP]
      MOVW  [$E4E5,X], $3C2F,PC
      MOVW  [$E4E5,X], <$3B3D,PC
      MOVW  [$E4E5,X], $3741,PC
      MOVW  [$E4E5,X], >$3A4D,PC
      MOVW  [$E4E5,X], [$3852,PC]
      MOVW  [$E4E5,X], A,PC
      MOVW  [$E4E5,X], B,PC
      MOVW  [$E4E5,X], D,PC
      MOVW  [$E4E5,X], [D,PC]
      MOVW  [$E4E5,X], 0,X
      MOVW  [$E4E5,X], 1,+X
      MOVW  [$E4E5,X], 8,-X
      MOVW  [$E4E5,X], 1,X+
      MOVW  [$E4E5,X], 8,X-
      MOVW  [$E4E5,X], 0,Y
      MOVW  [$E4E5,X], 1,+Y
      MOVW  [$E4E5,X], 8,-Y
      MOVW  [$E4E5,X], 1,Y+
      MOVW  [$E4E5,X], 8,Y-
      MOVW  [$E4E5,X], 0,SP
      MOVW  [$E4E5,X], 1,+SP
      MOVW  [$E4E5,X], 8,-SP
      MOVW  [$E4E5,X], 1,SP+
      MOVW  [$E4E5,X], 8,SP-
      MOVW  [$E4E5,X], $3BCD,PC
      MOVW  [$E4E5,X], $E1,X
      MOVW  [$E4E5,X], $E3E4,X
      MOVW  [$E4E5,X], [$E4E5,X]
      MOVW  [$E4E5,X], A,X
      MOVW  [$E4E5,X], B,X
      MOVW  A,X, B,X
      MOVW  A,X, D,X
      MOVW  A,X, [D,X]
      MOVW  A,X, $E9,Y
      MOVW  A,X, $EBEC,Y
      MOVW  A,X, [$ECED,Y]
      MOVW  A,X, A,Y
      MOVW  A,X, B,Y
      MOVW  A,X, D,Y
      MOVW  A,X, [D,Y]
      MOVW  A,X, $F1,SP
      MOVW  A,X, $F3F4,SP
      MOVW  A,X, [$F4F5,SP]
      MOVW  A,X, A,SP
      MOVW  A,X, B,SP
      MOVW  A,X, D,SP
      MOVW  A,X, [D,SP]
      MOVW  A,X, $3D3C,PC
      MOVW  A,X, <$3C48,PC
      MOVW  A,X, $384A,PC
      MOVW  A,X, >$3B54,PC
      MOVW  A,X, [$3957,PC]
      MOVW  A,X, A,PC
      MOVW  A,X, B,PC
      MOVW  A,X, D,PC
      MOVW  A,X, [D,PC]
      MOVW  A,X, 0,X
      MOVW  A,X, 1,+X
      MOVW  A,X, 8,-X
      MOVW  A,X, 1,X+
      MOVW  A,X, 8,X-
      MOVW  A,X, 0,Y
      MOVW  A,X, 1,+Y
      MOVW  A,X, 8,-Y
      MOVW  A,X, 1,Y+
      MOVW  A,X, 8,Y-
      MOVW  A,X, 0,SP
      MOVW  A,X, 1,+SP
      MOVW  A,X, 8,-SP
      MOVW  A,X, 1,SP+
      MOVW  A,X, 8,SP-
      MOVW  A,X, $3CAA,PC
      MOVW  A,X, $E1,X
      MOVW  A,X, $E3E4,X
      MOVW  A,X, [$E4E5,X]
      MOVW  A,X, A,X
      MOVW  B,X, D,X
      MOVW  B,X, [D,X]
      MOVW  B,X, $E9,Y
      MOVW  B,X, $EBEC,Y
      MOVW  B,X, [$ECED,Y]
      MOVW  B,X, A,Y
      MOVW  B,X, B,Y
      MOVW  B,X, D,Y
      MOVW  B,X, [D,Y]
      MOVW  B,X, $F1,SP
      MOVW  B,X, $F3F4,SP
      MOVW  B,X, [$F4F5,SP]
      MOVW  B,X, A,SP
      MOVW  B,X, B,SP
      MOVW  B,X, D,SP
      MOVW  B,X, [D,SP]
      MOVW  B,X, $3E07,PC
      MOVW  B,X, <$3D13,PC
      MOVW  B,X, $3915,PC
      MOVW  B,X, >$3C1F,PC
      MOVW  B,X, [$3A22,PC]
      MOVW  B,X, A,PC
      MOVW  B,X, B,PC
      MOVW  B,X, D,PC
      MOVW  B,X, [D,PC]
      MOVW  B,X, 0,X
      MOVW  B,X, 1,+X
      MOVW  B,X, 8,-X
      MOVW  B,X, 1,X+
      MOVW  B,X, 8,X-
      MOVW  B,X, 0,Y
      MOVW  B,X, 1,+Y
      MOVW  B,X, 8,-Y
      MOVW  B,X, 1,Y+
      MOVW  B,X, 8,Y-
      MOVW  B,X, 0,SP
      MOVW  B,X, 1,+SP
      MOVW  B,X, 8,-SP
      MOVW  B,X, 1,SP+
      MOVW  B,X, 8,SP-
      MOVW  B,X, $3D75,PC
      MOVW  B,X, $E1,X
      MOVW  B,X, $E3E4,X
      MOVW  B,X, [$E4E5,X]
      MOVW  B,X, A,X
      MOVW  B,X, B,X
      MOVW  D,X, [D,X]
      MOVW  D,X, $E9,Y
      MOVW  D,X, $EBEC,Y
      MOVW  D,X, [$ECED,Y]
      MOVW  D,X, A,Y
      MOVW  D,X, B,Y
      MOVW  D,X, D,Y
      MOVW  D,X, [D,Y]
      MOVW  D,X, $F1,SP
      MOVW  D,X, $F3F4,SP
      MOVW  D,X, [$F4F5,SP]
      MOVW  D,X, A,SP
      MOVW  D,X, B,SP
      MOVW  D,X, D,SP
      MOVW  D,X, [D,SP]
      MOVW  D,X, $3ED2,PC
      MOVW  D,X, <$3DDE,PC
      MOVW  D,X, $39E0,PC
      MOVW  D,X, >$3CEA,PC
      MOVW  D,X, [$3AED,PC]
      MOVW  D,X, A,PC
      MOVW  D,X, B,PC
      MOVW  D,X, D,PC
      MOVW  D,X, [D,PC]
      MOVW  D,X, 0,X
      MOVW  D,X, 1,+X
      MOVW  D,X, 8,-X
      MOVW  D,X, 1,X+
      MOVW  D,X, 8,X-
      MOVW  D,X, 0,Y
      MOVW  D,X, 1,+Y
      MOVW  D,X, 8,-Y
      MOVW  D,X, 1,Y+
      MOVW  D,X, 8,Y-
      MOVW  D,X, 0,SP
      MOVW  D,X, 1,+SP
      MOVW  D,X, 8,-SP
      MOVW  D,X, 1,SP+
      MOVW  D,X, 8,SP-
      MOVW  D,X, $3E40,PC
      MOVW  D,X, $E1,X
      MOVW  D,X, $E3E4,X
      MOVW  D,X, [$E4E5,X]
      MOVW  D,X, A,X
      MOVW  D,X, B,X
      MOVW  D,X, D,X
      MOVW  [D,X], $E9,Y
      MOVW  [D,X], $EBEC,Y
      MOVW  [D,X], [$ECED,Y]
      MOVW  [D,X], A,Y
      MOVW  [D,X], B,Y
      MOVW  [D,X], D,Y
      MOVW  [D,X], [D,Y]
      MOVW  [D,X], $F1,SP
      MOVW  [D,X], $F3F4,SP
      MOVW  [D,X], [$F4F5,SP]
      MOVW  [D,X], A,SP
      MOVW  [D,X], B,SP
      MOVW  [D,X], D,SP
      MOVW  [D,X], [D,SP]
      MOVW  [D,X], $3F9D,PC
      MOVW  [D,X], <$3EA9,PC
      MOVW  [D,X], $3AAB,PC
      MOVW  [D,X], >$3DB5,PC
      MOVW  [D,X], [$3BB8,PC]
      MOVW  [D,X], A,PC
      MOVW  [D,X], B,PC
      MOVW  [D,X], D,PC
      MOVW  [D,X], [D,PC]
      MOVW  [D,X], 0,X
      MOVW  [D,X], 1,+X
      MOVW  [D,X], 8,-X
      MOVW  [D,X], 1,X+
      MOVW  [D,X], 8,X-
      MOVW  [D,X], 0,Y
      MOVW  [D,X], 1,+Y
      MOVW  [D,X], 8,-Y
      MOVW  [D,X], 1,Y+
      MOVW  [D,X], 8,Y-
      MOVW  [D,X], 0,SP
      MOVW  [D,X], 1,+SP
      MOVW  [D,X], 8,-SP
      MOVW  [D,X], 1,SP+
      MOVW  [D,X], 8,SP-
      MOVW  [D,X], $3F0B,PC
      MOVW  [D,X], $E1,X
      MOVW  [D,X], $E3E4,X
      MOVW  [D,X], [$E4E5,X]
      MOVW  [D,X], A,X
      MOVW  [D,X], B,X
      MOVW  [D,X], D,X
      MOVW  [D,X], [D,X]
      MOVW  $E9,Y, $EBEC,Y
      MOVW  $E9,Y, [$ECED,Y]
      MOVW  $E9,Y, A,Y
      MOVW  $E9,Y, B,Y
      MOVW  $E9,Y, D,Y
      MOVW  $E9,Y, [D,Y]
      MOVW  $F1,Y, $F3F4,SP
      MOVW  $F1,Y, [$F4F5,SP]
      MOVW  $F1,Y, A,SP
      MOVW  $F1,Y, B,SP
      MOVW  $F1,Y, D,SP
      MOVW  $F1,Y, [D,SP]
      MOVW  $F8,Y, <$3F70,PC
      MOVW  $F9,Y, $3B79,PC
      MOVW  $F9,Y, >$3E84,PC
      MOVW  $F9,Y, [$3C88,PC]
      MOVW  $F9,Y, A,PC
      MOVW  $F9,Y, B,PC
      MOVW  $F9,Y, D,PC
      MOVW  $F9,Y, [D,PC]
      MOVW  $F9,Y, 1,+X
      MOVW  $F9,Y, 8,-X
      MOVW  $F9,Y, 1,X+
      MOVW  $F9,Y, 8,X-
      MOVW  $F9,Y, 1,+Y
      MOVW  $F9,Y, 8,-Y
      MOVW  $F9,Y, 1,Y+
      MOVW  $F9,Y, 8,Y-
      MOVW  $F9,Y, 1,+SP
      MOVW  $F9,Y, 8,-SP
      MOVW  $F9,Y, 1,SP+
      MOVW  $F9,Y, 8,SP-
      MOVW  $EBEC,Y, B,Y
      MOVW  $EBEC,Y, D,Y
      MOVW  $EBEC,Y, [D,Y]
      MOVW  $EBF1,Y, $F3F4,SP
      MOVW  $EBF1,Y, [$F4F5,SP]
      MOVW  $EBF1,Y, A,SP
      MOVW  $EBF1,Y, B,SP
      MOVW  $EBF1,Y, D,SP
      MOVW  $EBF1,Y, [D,SP]
      MOVW  $EBF8,Y, <$4016,PC
      MOVW  $EBF9,Y, $3C20,PC
      MOVW  $EBF9,Y, >$3F2C,PC
      MOVW  $EBF9,Y, [$3D31,PC]
      MOVW  $EBF9,Y, A,PC
      MOVW  $EBF9,Y, B,PC
      MOVW  $EBF9,Y, D,PC
      MOVW  $EBF9,Y, [D,PC]
      MOVW  [$ECED,Y], D,Y
      MOVW  [$ECED,Y], [D,Y]
      MOVW  [$ECED,Y], $F1,SP
      MOVW  [$ECED,Y], $F3F4,SP
      MOVW  [$ECED,Y], [$F4F5,SP]
      MOVW  [$ECED,Y], A,SP
      MOVW  [$ECED,Y], B,SP
      MOVW  [$ECED,Y], D,SP
      MOVW  [$ECED,Y], [D,SP]
      MOVW  [$ECED,Y], $4187,PC
      MOVW  [$ECED,Y], <$4095,PC
      MOVW  [$ECED,Y], $3C99,PC
      MOVW  [$ECED,Y], >$3FA5,PC
      MOVW  [$ECED,Y], [$3DAA,PC]
      MOVW  [$ECED,Y], A,PC
      MOVW  [$ECED,Y], B,PC
      MOVW  [$ECED,Y], D,PC
      MOVW  [$ECED,Y], [D,PC]
      MOVW  [$ECED,Y], 0,X
      MOVW  [$ECED,Y], 1,+X
      MOVW  [$ECED,Y], 8,-X
      MOVW  [$ECED,Y], 1,X+
      MOVW  [$ECED,Y], 8,X-
      MOVW  [$ECED,Y], 0,Y
      MOVW  [$ECED,Y], 1,+Y
      MOVW  [$ECED,Y], 8,-Y
      MOVW  [$ECED,Y], 1,Y+
      MOVW  [$ECED,Y], 8,Y-
      MOVW  [$ECED,Y], 0,SP
      MOVW  [$ECED,Y], 1,+SP
      MOVW  [$ECED,Y], 8,-SP
      MOVW  [$ECED,Y], 1,SP+
      MOVW  [$ECED,Y], 8,SP-
      MOVW  [$ECED,Y], $4125,PC
      MOVW  [$ECED,Y], $E1,X
      MOVW  [$ECED,Y], $E3E4,X
      MOVW  [$ECED,Y], [$E4E5,X]
      MOVW  [$ECED,Y], A,X
      MOVW  [$ECED,Y], B,X
      MOVW  [$ECED,Y], D,X
      MOVW  [$ECED,Y], [D,X]
      MOVW  [$ECED,Y], $E9,Y
      MOVW  [$ECED,Y], $EBEC,Y
      MOVW  [$ECED,Y], [$ECED,Y]
      MOVW  [$ECED,Y], A,Y
      MOVW  [$ECED,Y], B,Y
      MOVW  A,Y, B,Y
      MOVW  A,Y, D,Y
      MOVW  A,Y, [D,Y]
      MOVW  A,Y, $F1,SP
      MOVW  A,Y, $F3F4,SP
      MOVW  A,Y, [$F4F5,SP]
      MOVW  A,Y, A,SP
      MOVW  A,Y, B,SP
      MOVW  A,Y, D,SP
      MOVW  A,Y, [D,SP]
      MOVW  A,Y, $42A2,PC
      MOVW  A,Y, <$41AE,PC
      MOVW  A,Y, $3DB0,PC
      MOVW  A,Y, >$40BA,PC
      MOVW  A,Y, [$3EBD,PC]
      MOVW  A,Y, A,PC
      MOVW  A,Y, B,PC
      MOVW  A,Y, D,PC
      MOVW  A,Y, [D,PC]
      MOVW  A,Y, 0,X
      MOVW  A,Y, 1,+X
      MOVW  A,Y, 8,-X
      MOVW  A,Y, 1,X+
      MOVW  A,Y, 8,X-
      MOVW  A,Y, 0,Y
      MOVW  A,Y, 1,+Y
      MOVW  A,Y, 8,-Y
      MOVW  A,Y, 1,Y+
      MOVW  A,Y, 8,Y-
      MOVW  A,Y, 0,SP
      MOVW  A,Y, 1,+SP
      MOVW  A,Y, 8,-SP
      MOVW  A,Y, 1,SP+
      MOVW  A,Y, 8,SP-
      MOVW  A,Y, $4210,PC
      MOVW  A,Y, $E1,X
      MOVW  A,Y, $E3E4,X
      MOVW  A,Y, [$E4E5,X]
      MOVW  A,Y, A,X
      MOVW  A,Y, B,X
      MOVW  A,Y, D,X
      MOVW  A,Y, [D,X]
      MOVW  A,Y, $E9,Y
      MOVW  A,Y, $EBEC,Y
      MOVW  A,Y, [$ECED,Y]
      MOVW  A,Y, A,Y
      MOVW  B,Y, D,Y
      MOVW  B,Y, [D,Y]
      MOVW  B,Y, $F1,SP
      MOVW  B,Y, $F3F4,SP
      MOVW  B,Y, [$F4F5,SP]
      MOVW  B,Y, A,SP
      MOVW  B,Y, B,SP
      MOVW  B,Y, D,SP
      MOVW  B,Y, [D,SP]
      MOVW  B,Y, $436D,PC
      MOVW  B,Y, <$4279,PC
      MOVW  B,Y, $3E7B,PC
      MOVW  B,Y, >$4185,PC
      MOVW  B,Y, [$3F88,PC]
      MOVW  B,Y, A,PC
      MOVW  B,Y, B,PC
      MOVW  B,Y, D,PC
      MOVW  B,Y, [D,PC]
      MOVW  B,Y, 0,X
      MOVW  B,Y, 1,+X
      MOVW  B,Y, 8,-X
      MOVW  B,Y, 1,X+
      MOVW  B,Y, 8,X-
      MOVW  B,Y, 0,Y
      MOVW  B,Y, 1,+Y
      MOVW  B,Y, 8,-Y
      MOVW  B,Y, 1,Y+
      MOVW  B,Y, 8,Y-
      MOVW  B,Y, 0,SP
      MOVW  B,Y, 1,+SP
      MOVW  B,Y, 8,-SP
      MOVW  B,Y, 1,SP+
      MOVW  B,Y, 8,SP-
      MOVW  B,Y, $42DB,PC
      MOVW  B,Y, $E1,X
      MOVW  B,Y, $E3E4,X
      MOVW  B,Y, [$E4E5,X]
      MOVW  B,Y, A,X
      MOVW  B,Y, B,X
      MOVW  B,Y, D,X
      MOVW  B,Y, [D,X]
      MOVW  B,Y, $E9,Y
      MOVW  B,Y, $EBEC,Y
      MOVW  B,Y, [$ECED,Y]
      MOVW  B,Y, A,Y
      MOVW  B,Y, B,Y
      MOVW  D,Y, [D,Y]
      MOVW  D,Y, $F1,SP
      MOVW  D,Y, $F3F4,SP
      MOVW  D,Y, [$F4F5,SP]
      MOVW  D,Y, A,SP
      MOVW  D,Y, B,SP
      MOVW  D,Y, D,SP
      MOVW  D,Y, [D,SP]
      MOVW  D,Y, $4438,PC
      MOVW  D,Y, <$4344,PC
      MOVW  D,Y, $3F46,PC
      MOVW  D,Y, >$4250,PC
      MOVW  D,Y, [$4053,PC]
      MOVW  D,Y, A,PC
      MOVW  D,Y, B,PC
      MOVW  D,Y, D,PC
      MOVW  D,Y, [D,PC]
      MOVW  D,Y, 0,X
      MOVW  D,Y, 1,+X
      MOVW  D,Y, 8,-X
      MOVW  D,Y, 1,X+
      MOVW  D,Y, 8,X-
      MOVW  D,Y, 0,Y
      MOVW  D,Y, 1,+Y
      MOVW  D,Y, 8,-Y
      MOVW  D,Y, 1,Y+
      MOVW  D,Y, 8,Y-
      MOVW  D,Y, 0,SP
      MOVW  D,Y, 1,+SP
      MOVW  D,Y, 8,-SP
      MOVW  D,Y, 1,SP+
      MOVW  D,Y, 8,SP-
      MOVW  D,Y, $43A6,PC
      MOVW  D,Y, $E1,X
      MOVW  D,Y, $E3E4,X
      MOVW  D,Y, [$E4E5,X]
      MOVW  D,Y, A,X
      MOVW  D,Y, B,X
      MOVW  D,Y, D,X
      MOVW  D,Y, [D,X]
      MOVW  D,Y, $E9,Y
      MOVW  D,Y, $EBEC,Y
      MOVW  D,Y, [$ECED,Y]
      MOVW  D,Y, A,Y
      MOVW  D,Y, B,Y
      MOVW  D,Y, D,Y
      MOVW  [D,Y], $F1,SP
      MOVW  [D,Y], $F3F4,SP
      MOVW  [D,Y], [$F4F5,SP]
      MOVW  [D,Y], A,SP
      MOVW  [D,Y], B,SP
      MOVW  [D,Y], D,SP
      MOVW  [D,Y], [D,SP]
      MOVW  [D,Y], $4503,PC
      MOVW  [D,Y], <$440F,PC
      MOVW  [D,Y], $4011,PC
      MOVW  [D,Y], >$431B,PC
      MOVW  [D,Y], [$411E,PC]
      MOVW  [D,Y], A,PC
      MOVW  [D,Y], B,PC
      MOVW  [D,Y], D,PC
      MOVW  [D,Y], [D,PC]
      MOVW  [D,Y], 0,X
      MOVW  [D,Y], 1,+X
      MOVW  [D,Y], 8,-X
      MOVW  [D,Y], 1,X+
      MOVW  [D,Y], 8,X-
      MOVW  [D,Y], 0,Y
      MOVW  [D,Y], 1,+Y
      MOVW  [D,Y], 8,-Y
      MOVW  [D,Y], 1,Y+
      MOVW  [D,Y], 8,Y-
      MOVW  [D,Y], 0,SP
      MOVW  [D,Y], 1,+SP
      MOVW  [D,Y], 8,-SP
      MOVW  [D,Y], 1,SP+
      MOVW  [D,Y], 8,SP-
      MOVW  [D,Y], $4471,PC
      MOVW  [D,Y], $E1,X
      MOVW  [D,Y], $E3E4,X
      MOVW  [D,Y], [$E4E5,X]
      MOVW  [D,Y], A,X
      MOVW  [D,Y], B,X
      MOVW  [D,Y], D,X
      MOVW  [D,Y], [D,X]
      MOVW  [D,Y], $E9,Y
      MOVW  [D,Y], $EBEC,Y
      MOVW  [D,Y], [$ECED,Y]
      MOVW  [D,Y], A,Y
      MOVW  [D,Y], B,Y
      MOVW  [D,Y], D,Y
      MOVW  [D,Y], [D,Y]
      MOVW  $F1,SP, $F3F4,SP
      MOVW  $F1,SP, [$F4F5,SP]
      MOVW  $F1,SP, A,SP
      MOVW  $F1,SP, B,SP
      MOVW  $F1,SP, D,SP
      MOVW  $F1,SP, [D,SP]
      MOVW  $F8,SP, <$44D5,PC
      MOVW  $F9,SP, $40DE,PC
      MOVW  $F9,SP, >$43E9,PC
      MOVW  $F9,SP, [$41ED,PC]
      MOVW  $F9,SP, A,PC
      MOVW  $F9,SP, B,PC
      MOVW  $F9,SP, D,PC
      MOVW  $F9,SP, [D,PC]
      MOVW  $F9,SP, 1,+X
      MOVW  $F9,SP, 8,-X
      MOVW  $F9,SP, 1,X+
      MOVW  $F9,SP, 8,X-
      MOVW  $F9,SP, 1,+Y
      MOVW  $F9,SP, 8,-Y
      MOVW  $F9,SP, 1,Y+
      MOVW  $F9,SP, 8,Y-
      MOVW  $F9,SP, 1,+SP
      MOVW  $F9,SP, 8,-SP
      MOVW  $F9,SP, 1,SP+
      MOVW  $F9,SP, 8,SP-
      MOVW  $F3F4,SP, B,SP
      MOVW  $F3F4,SP, D,SP
      MOVW  $F3F4,SP, [D,SP]
      MOVW  $F3F8,SP, <$4553,PC
      MOVW  $F3F9,SP, $415D,PC
      MOVW  $F3F9,SP, >$4469,PC
      MOVW  $F3F9,SP, [$426E,PC]
      MOVW  $F3F9,SP, A,PC
      MOVW  $F3F9,SP, B,PC
      MOVW  $F3F9,SP, D,PC
      MOVW  $F3F9,SP, [D,PC]
      MOVW  [$F4F5,SP], D,SP
      MOVW  [$F4F5,SP], [D,SP]
      MOVW  [$F4F5,SP], $4695,PC
      MOVW  [$F4F5,SP], <$45A3,PC
      MOVW  [$F4F5,SP], $41A7,PC
      MOVW  [$F4F5,SP], >$44B3,PC
      MOVW  [$F4F5,SP], [$42B8,PC]
      MOVW  [$F4F5,SP], A,PC
      MOVW  [$F4F5,SP], B,PC
      MOVW  [$F4F5,SP], D,PC
      MOVW  [$F4F5,SP], [D,PC]
      MOVW  [$F4F5,SP], 0,X
      MOVW  [$F4F5,SP], 1,+X
      MOVW  [$F4F5,SP], 8,-X
      MOVW  [$F4F5,SP], 1,X+
      MOVW  [$F4F5,SP], 8,X-
      MOVW  [$F4F5,SP], 0,Y
      MOVW  [$F4F5,SP], 1,+Y
      MOVW  [$F4F5,SP], 8,-Y
      MOVW  [$F4F5,SP], 1,Y+
      MOVW  [$F4F5,SP], 8,Y-
      MOVW  [$F4F5,SP], 0,SP
      MOVW  [$F4F5,SP], 1,+SP
      MOVW  [$F4F5,SP], 8,-SP
      MOVW  [$F4F5,SP], 1,SP+
      MOVW  [$F4F5,SP], 8,SP-
      MOVW  [$F4F5,SP], $4633,PC
      MOVW  [$F4F5,SP], $E1,X
      MOVW  [$F4F5,SP], $E3E4,X
      MOVW  [$F4F5,SP], [$E4E5,X]
      MOVW  [$F4F5,SP], A,X
      MOVW  [$F4F5,SP], B,X
      MOVW  [$F4F5,SP], D,X
      MOVW  [$F4F5,SP], [D,X]
      MOVW  [$F4F5,SP], $E9,Y
      MOVW  [$F4F5,SP], $EBEC,Y
      MOVW  [$F4F5,SP], [$ECED,Y]
      MOVW  [$F4F5,SP], A,Y
      MOVW  [$F4F5,SP], B,Y
      MOVW  [$F4F5,SP], D,Y
      MOVW  [$F4F5,SP], [D,Y]
      MOVW  [$F4F5,SP], $F1,SP
      MOVW  [$F4F5,SP], $F3F4,SP
      MOVW  [$F4F5,SP], [$F4F5,SP]
      MOVW  [$F4F5,SP], A,SP
      MOVW  [$F4F5,SP], B,SP
      MOVW  A,SP, B,SP
      MOVW  A,SP, D,SP
      MOVW  A,SP, [D,SP]
      MOVW  A,SP, $47BE,PC
      MOVW  A,SP, <$46CA,PC
      MOVW  A,SP, $42CC,PC
      MOVW  A,SP, >$45D6,PC
      MOVW  A,SP, [$43D9,PC]
      MOVW  A,SP, A,PC
      MOVW  A,SP, B,PC
      MOVW  A,SP, D,PC
      MOVW  A,SP, [D,PC]
      MOVW  A,SP, 0,X
      MOVW  A,SP, 1,+X
      MOVW  A,SP, 8,-X
      MOVW  A,SP, 1,X+
      MOVW  A,SP, 8,X-
      MOVW  A,SP, 0,Y
      MOVW  A,SP, 1,+Y
      MOVW  A,SP, 8,-Y
      MOVW  A,SP, 1,Y+
      MOVW  A,SP, 8,Y-
      MOVW  A,SP, 0,SP
      MOVW  A,SP, 1,+SP
      MOVW  A,SP, 8,-SP
      MOVW  A,SP, 1,SP+
      MOVW  A,SP, 8,SP-
      MOVW  A,SP, $472C,PC
      MOVW  A,SP, $E1,X
      MOVW  A,SP, $E3E4,X
      MOVW  A,SP, [$E4E5,X]
      MOVW  A,SP, A,X
      MOVW  A,SP, B,X
      MOVW  A,SP, D,X
      MOVW  A,SP, [D,X]
      MOVW  A,SP, $E9,Y
      MOVW  A,SP, $EBEC,Y
      MOVW  A,SP, [$ECED,Y]
      MOVW  A,SP, A,Y
      MOVW  A,SP, B,Y
      MOVW  A,SP, D,Y
      MOVW  A,SP, [D,Y]
      MOVW  A,SP, $F1,SP
      MOVW  A,SP, $F3F4,SP
      MOVW  A,SP, [$F4F5,SP]
      MOVW  A,SP, A,SP
      MOVW  B,SP, D,SP
      MOVW  B,SP, [D,SP]
      MOVW  B,SP, $4889,PC
      MOVW  B,SP, <$4795,PC
      MOVW  B,SP, $4397,PC
      MOVW  B,SP, >$46A1,PC
      MOVW  B,SP, [$44A4,PC]
      MOVW  B,SP, A,PC
      MOVW  B,SP, B,PC
      MOVW  B,SP, D,PC
      MOVW  B,SP, [D,PC]
      MOVW  B,SP, 0,X
      MOVW  B,SP, 1,+X
      MOVW  B,SP, 8,-X
      MOVW  B,SP, 1,X+
      MOVW  B,SP, 8,X-
      MOVW  B,SP, 0,Y
      MOVW  B,SP, 1,+Y
      MOVW  B,SP, 8,-Y
      MOVW  B,SP, 1,Y+
      MOVW  B,SP, 8,Y-
      MOVW  B,SP, 0,SP
      MOVW  B,SP, 1,+SP
      MOVW  B,SP, 8,-SP
      MOVW  B,SP, 1,SP+
      MOVW  B,SP, 8,SP-
      MOVW  B,SP, $47F7,PC
      MOVW  B,SP, $E1,X
      MOVW  B,SP, $E3E4,X
      MOVW  B,SP, [$E4E5,X]
      MOVW  B,SP, A,X
      MOVW  B,SP, B,X
      MOVW  B,SP, D,X
      MOVW  B,SP, [D,X]
      MOVW  B,SP, $E9,Y
      MOVW  B,SP, $EBEC,Y
      MOVW  B,SP, [$ECED,Y]
      MOVW  B,SP, A,Y
      MOVW  B,SP, B,Y
      MOVW  B,SP, D,Y
      MOVW  B,SP, [D,Y]
      MOVW  B,SP, $F1,SP
      MOVW  B,SP, $F3F4,SP
      MOVW  B,SP, [$F4F5,SP]
      MOVW  B,SP, A,SP
      MOVW  B,SP, B,SP
      MOVW  D,SP, [D,SP]
      MOVW  D,SP, $4954,PC
      MOVW  D,SP, <$4860,PC
      MOVW  D,SP, $4462,PC
      MOVW  D,SP, >$476C,PC
      MOVW  D,SP, [$456F,PC]
      MOVW  D,SP, A,PC
      MOVW  D,SP, B,PC
      MOVW  D,SP, D,PC
      MOVW  D,SP, [D,PC]
      MOVW  D,SP, 0,X
      MOVW  D,SP, 1,+X
      MOVW  D,SP, 8,-X
      MOVW  D,SP, 1,X+
      MOVW  D,SP, 8,X-
      MOVW  D,SP, 0,Y
      MOVW  D,SP, 1,+Y
      MOVW  D,SP, 8,-Y
      MOVW  D,SP, 1,Y+
      MOVW  D,SP, 8,Y-
      MOVW  D,SP, 0,SP
      MOVW  D,SP, 1,+SP
      MOVW  D,SP, 8,-SP
      MOVW  D,SP, 1,SP+
      MOVW  D,SP, 8,SP-
      MOVW  D,SP, $48C2,PC
      MOVW  D,SP, $E1,X
      MOVW  D,SP, $E3E4,X
      MOVW  D,SP, [$E4E5,X]
      MOVW  D,SP, A,X
      MOVW  D,SP, B,X
      MOVW  D,SP, D,X
      MOVW  D,SP, [D,X]
      MOVW  D,SP, $E9,Y
      MOVW  D,SP, $EBEC,Y
      MOVW  D,SP, [$ECED,Y]
      MOVW  D,SP, A,Y
      MOVW  D,SP, B,Y
      MOVW  D,SP, D,Y
      MOVW  D,SP, [D,Y]
      MOVW  D,SP, $F1,SP
      MOVW  D,SP, $F3F4,SP
      MOVW  D,SP, [$F4F5,SP]
      MOVW  D,SP, A,SP
      MOVW  D,SP, B,SP
      MOVW  D,SP, D,SP
      MOVW  [D,SP], $4A1F,PC
      MOVW  [D,SP], <$492B,PC
      MOVW  [D,SP], $452D,PC
      MOVW  [D,SP], >$4837,PC
      MOVW  [D,SP], [$463A,PC]
      MOVW  [D,SP], A,PC
      MOVW  [D,SP], B,PC
      MOVW  [D,SP], D,PC
      MOVW  [D,SP], [D,PC]
      MOVW  [D,SP], 0,X
      MOVW  [D,SP], 1,+X
      MOVW  [D,SP], 8,-X
      MOVW  [D,SP], 1,X+
      MOVW  [D,SP], 8,X-
      MOVW  [D,SP], 0,Y
      MOVW  [D,SP], 1,+Y
      MOVW  [D,SP], 8,-Y
      MOVW  [D,SP], 1,Y+
      MOVW  [D,SP], 8,Y-
      MOVW  [D,SP], 0,SP
      MOVW  [D,SP], 1,+SP
      MOVW  [D,SP], 8,-SP
      MOVW  [D,SP], 1,SP+
      MOVW  [D,SP], 8,SP-
      MOVW  [D,SP], $498D,PC
      MOVW  [D,SP], $E1,X
      MOVW  [D,SP], $E3E4,X
      MOVW  [D,SP], [$E4E5,X]
      MOVW  [D,SP], A,X
      MOVW  [D,SP], B,X
      MOVW  [D,SP], D,X
      MOVW  [D,SP], [D,X]
      MOVW  [D,SP], $E9,Y
      MOVW  [D,SP], $EBEC,Y
      MOVW  [D,SP], [$ECED,Y]
      MOVW  [D,SP], A,Y
      MOVW  [D,SP], B,Y
      MOVW  [D,SP], D,Y
      MOVW  [D,SP], [D,Y]
      MOVW  [D,SP], $F1,SP
      MOVW  [D,SP], $F3F4,SP
      MOVW  [D,SP], [$F4F5,SP]
      MOVW  [D,SP], A,SP
      MOVW  [D,SP], B,SP
      MOVW  [D,SP], D,SP
      MOVW  [D,SP], [D,SP]
      MOVW  $4AEE,PC, $45F3,PC
      MOVW  $4AF5,PC, >$48FE,PC
      MOVW  $4AFC,PC, [$4702,PC]
      MOVW  $4B03,PC, A,PC
      MOVW  $4B08,PC, B,PC
      MOVW  $4B0D,PC, D,PC
      MOVW  $4B12,PC, [D,PC]
      MOVW  $4B17,PC, 1,+X
      MOVW  $4B1C,PC, 8,-X
      MOVW  $4B21,PC, 1,X+
      MOVW  $4B26,PC, 8,X-
      MOVW  $4B2B,PC, 1,+Y
      MOVW  $4B30,PC, 8,-Y
      MOVW  $4B35,PC, 1,Y+
      MOVW  $4B3A,PC, 8,Y-
      MOVW  $4B3F,PC, 1,+SP
      MOVW  $4B44,PC, 8,-SP
      MOVW  $4B49,PC, 1,SP+
      MOVW  $4B4E,PC, 8,SP-
      MOVW  <$4A5A,PC, 1,X
      MOVW  <$4A5F,PC, 1,+X
      MOVW  <$4A64,PC, 8,-X
      MOVW  <$4A69,PC, 1,X+
      MOVW  <$4A6E,PC, 8,X-
      MOVW  <$4A73,PC, 0,Y
      MOVW  <$4A78,PC, 1,+Y
      MOVW  <$4A7D,PC, 8,-Y
      MOVW  <$4A82,PC, 1,Y+
      MOVW  <$4A87,PC, 8,Y-
      MOVW  <$4A8C,PC, 0,SP
      MOVW  <$4A91,PC, 1,+SP
      MOVW  <$4A96,PC, 8,-SP
      MOVW  <$4A9B,PC, 1,SP+
      MOVW  <$4AA0,PC, 8,SP-
      MOVW  <$4AA5,PC, $4AA5,PC
      MOVW  <$4AAA,PC, $E1,X
      MOVW  <$4AB0,PC, $E3E4,X
      MOVW  <$4AB7,PC, [$E4E5,X]
      MOVW  <$4ABE,PC, A,X
      MOVW  <$4AC3,PC, B,X
      MOVW  <$4AC8,PC, D,X
      MOVW  <$4ACD,PC, [D,X]
      MOVW  <$4AD2,PC, $E9,Y
      MOVW  <$4AD8,PC, $EBEC,Y
      MOVW  <$4ADF,PC, [$ECED,Y]
      MOVW  <$4AE6,PC, A,Y
      MOVW  <$4AEB,PC, B,Y
      MOVW  <$4AF0,PC, D,Y
      MOVW  <$4AF5,PC, [D,Y]
      MOVW  <$4AFA,PC, $F1,SP
      MOVW  <$4B00,PC, $F3F4,SP
      MOVW  <$4B07,PC, [$F4F5,SP]
      MOVW  <$4B0E,PC, A,SP
      MOVW  <$4B13,PC, B,SP
      MOVW  <$4B18,PC, D,SP
      MOVW  <$4B1D,PC, [D,SP]
      MOVW  <$4B22,PC, $4C1C,PC
      MOVW  <$4B28,PC, <$4B29,PC
      MOVW  <$4B2E,PC, $472C,PC
      MOVW  <$4B35,PC, >$4A37,PC
      MOVW  <$4B3C,PC, [$483B,PC]
      MOVW  <$4B43,PC, A,PC
      MOVW  <$4B48,PC, B,PC
      MOVW  <$4B4D,PC, D,PC
      MOVW  <$4B52,PC, [D,PC]
      MOVW  $4C38,PC, $E3E4,X
      MOVW  $4C3F,PC, [$E4E5,X]
      MOVW  $4C46,PC, A,X
      MOVW  $4C4B,PC, B,X
      MOVW  $4C50,PC, D,X
      MOVW  $4C55,PC, [D,X]
      MOVW  $4C62,PC, $EBEC,Y
      MOVW  $4C69,PC, [$ECED,Y]
      MOVW  $4C70,PC, A,Y
      MOVW  $4C75,PC, B,Y
      MOVW  $4C7A,PC, D,Y
      MOVW  $4C7F,PC, [D,Y]
      MOVW  $4C8C,PC, $F3F4,SP
      MOVW  $4C93,PC, [$F4F5,SP]
      MOVW  $4C9A,PC, A,SP
      MOVW  $4C9F,PC, B,SP
      MOVW  $4CA4,PC, D,SP
      MOVW  $4CA9,PC, [D,SP]
      MOVW  $4CB5,PC, <$4BB8,PC
      MOVW  $47C0,PC, B,PC
      MOVW  $47C6,PC, D,PC
      MOVW  $47CC,PC, [D,PC]
      MOVW  [$48D3,PC], D,PC
      MOVW  [$48D9,PC], [D,PC]
      MOVW  [$48DF,PC], 0,X
      MOVW  [$48E5,PC], 1,+X
      MOVW  [$48EB,PC], 8,-X
      MOVW  [$48F1,PC], 1,X+
      MOVW  [$48F7,PC], 8,X-
      MOVW  [$48FD,PC], 0,Y
      MOVW  [$4903,PC], 1,+Y
      MOVW  [$4909,PC], 8,-Y
      MOVW  [$490F,PC], 1,Y+
      MOVW  [$4915,PC], 8,Y-
      MOVW  [$491B,PC], 0,SP
      MOVW  [$4921,PC], 1,+SP
      MOVW  [$4927,PC], 8,-SP
      MOVW  [$492D,PC], 1,SP+
      MOVW  [$4933,PC], 8,SP-
      MOVW  [$4939,PC], $4C3C,PC
      MOVW  [$493F,PC], $E1,X
      MOVW  [$4946,PC], $E3E4,X
      MOVW  [$494E,PC], [$E4E5,X]
      MOVW  [$4956,PC], A,X
      MOVW  [$495C,PC], B,X
      MOVW  [$4962,PC], D,X
      MOVW  [$4968,PC], [D,X]
      MOVW  [$496E,PC], $E9,Y
      MOVW  [$4975,PC], $EBEC,Y
      MOVW  [$497D,PC], [$ECED,Y]
      MOVW  [$4985,PC], A,Y
      MOVW  [$498B,PC], B,Y
      MOVW  [$4991,PC], D,Y
      MOVW  [$4997,PC], [D,Y]
      MOVW  [$499D,PC], $F1,SP
      MOVW  [$49A4,PC], $F3F4,SP
      MOVW  [$49AC,PC], [$F4F5,SP]
      MOVW  [$49B4,PC], A,SP
      MOVW  [$49BA,PC], B,SP
      MOVW  [$49C0,PC], D,SP
      MOVW  [$49C6,PC], [D,SP]
      MOVW  [$49CC,PC], $4DC9,PC
      MOVW  [$49D3,PC], <$4CD7,PC
      MOVW  [$49DA,PC], $48DB,PC
      MOVW  [$49E2,PC], >$4BE7,PC
      MOVW  [$49EA,PC], [$49EC,PC]
      MOVW  [$49F2,PC], A,PC
      MOVW  [$49F8,PC], B,PC
      MOVW  A,PC, B,PC
      MOVW  A,PC, D,PC
      MOVW  A,PC, [D,PC]
      MOVW  A,PC, 0,X
      MOVW  A,PC, 1,+X
      MOVW  A,PC, 8,-X
      MOVW  A,PC, 1,X+
      MOVW  A,PC, 8,X-
      MOVW  A,PC, 0,Y
      MOVW  A,PC, 1,+Y
      MOVW  A,PC, 8,-Y
      MOVW  A,PC, 1,Y+
      MOVW  A,PC, 8,Y-
      MOVW  A,PC, 0,SP
      MOVW  A,PC, 1,+SP
      MOVW  A,PC, 8,-SP
      MOVW  A,PC, 1,SP+
      MOVW  A,PC, 8,SP-
      MOVW  A,PC, $4D47,PC
      MOVW  A,PC, $E1,X
      MOVW  A,PC, $E3E4,X
      MOVW  A,PC, [$E4E5,X]
      MOVW  A,PC, A,X
      MOVW  A,PC, B,X
      MOVW  A,PC, D,X
      MOVW  A,PC, [D,X]
      MOVW  A,PC, $E9,Y
      MOVW  A,PC, $EBEC,Y
      MOVW  A,PC, [$ECED,Y]
      MOVW  A,PC, A,Y
      MOVW  A,PC, B,Y
      MOVW  A,PC, D,Y
      MOVW  A,PC, [D,Y]
      MOVW  A,PC, $F1,SP
      MOVW  A,PC, $F3F4,SP
      MOVW  A,PC, [$F4F5,SP]
      MOVW  A,PC, A,SP
      MOVW  A,PC, B,SP
      MOVW  A,PC, D,SP
      MOVW  A,PC, [D,SP]
      MOVW  A,PC, $4EA8,PC
      MOVW  A,PC, <$4DB4,PC
      MOVW  A,PC, $49B6,PC
      MOVW  A,PC, >$4CC0,PC
      MOVW  A,PC, [$4AC3,PC]
      MOVW  A,PC, A,PC
      MOVW  B,PC, D,PC
      MOVW  B,PC, [D,PC]
      MOVW  B,PC, 0,X
      MOVW  B,PC, 1,+X
      MOVW  B,PC, 8,-X
      MOVW  B,PC, 1,X+
      MOVW  B,PC, 8,X-
      MOVW  B,PC, 0,Y
      MOVW  B,PC, 1,+Y
      MOVW  B,PC, 8,-Y
      MOVW  B,PC, 1,Y+
      MOVW  B,PC, 8,Y-
      MOVW  B,PC, 0,SP
      MOVW  B,PC, 1,+SP
      MOVW  B,PC, 8,-SP
      MOVW  B,PC, 1,SP+
      MOVW  B,PC, 8,SP-
      MOVW  B,PC, $4E12,PC
      MOVW  B,PC, $E1,X
      MOVW  B,PC, $E3E4,X
      MOVW  B,PC, [$E4E5,X]
      MOVW  B,PC, A,X
      MOVW  B,PC, B,X
      MOVW  B,PC, D,X
      MOVW  B,PC, [D,X]
      MOVW  B,PC, $E9,Y
      MOVW  B,PC, $EBEC,Y
      MOVW  B,PC, [$ECED,Y]
      MOVW  B,PC, A,Y
      MOVW  B,PC, B,Y
      MOVW  B,PC, D,Y
      MOVW  B,PC, [D,Y]
      MOVW  B,PC, $F1,SP
      MOVW  B,PC, $F3F4,SP
      MOVW  B,PC, [$F4F5,SP]
      MOVW  B,PC, A,SP
      MOVW  B,PC, B,SP
      MOVW  B,PC, D,SP
      MOVW  B,PC, [D,SP]
      MOVW  B,PC, $4F73,PC
      MOVW  B,PC, <$4E7F,PC
      MOVW  B,PC, $4A81,PC
      MOVW  B,PC, >$4D8B,PC
      MOVW  B,PC, [$4B8E,PC]
      MOVW  B,PC, A,PC
      MOVW  B,PC, B,PC
      MOVW  D,PC, [D,PC]
      MOVW  D,PC, 0,X
      MOVW  D,PC, 1,+X
      MOVW  D,PC, 8,-X
      MOVW  D,PC, 1,X+
      MOVW  D,PC, 8,X-
      MOVW  D,PC, 0,Y
      MOVW  D,PC, 1,+Y
      MOVW  D,PC, 8,-Y
      MOVW  D,PC, 1,Y+
      MOVW  D,PC, 8,Y-
      MOVW  D,PC, 0,SP
      MOVW  D,PC, 1,+SP
      MOVW  D,PC, 8,-SP
      MOVW  D,PC, 1,SP+
      MOVW  D,PC, 8,SP-
      MOVW  D,PC, $4EDD,PC
      MOVW  D,PC, $E1,X
      MOVW  D,PC, $E3E4,X
      MOVW  D,PC, [$E4E5,X]
      MOVW  D,PC, A,X
      MOVW  D,PC, B,X
      MOVW  D,PC, D,X
      MOVW  D,PC, [D,X]
      MOVW  D,PC, $E9,Y
      MOVW  D,PC, $EBEC,Y
      MOVW  D,PC, [$ECED,Y]
      MOVW  D,PC, A,Y
      MOVW  D,PC, B,Y
      MOVW  D,PC, D,Y
      MOVW  D,PC, [D,Y]
      MOVW  D,PC, $F1,SP
      MOVW  D,PC, $F3F4,SP
      MOVW  D,PC, [$F4F5,SP]
      MOVW  D,PC, A,SP
      MOVW  D,PC, B,SP
      MOVW  D,PC, D,SP
      MOVW  D,PC, [D,SP]
      MOVW  D,PC, $503E,PC
      MOVW  D,PC, <$4F4A,PC
      MOVW  D,PC, $4B4C,PC
      MOVW  D,PC, >$4E56,PC
      MOVW  D,PC, [$4C59,PC]
      MOVW  D,PC, A,PC
      MOVW  D,PC, B,PC
      MOVW  D,PC, D,PC
      MOVW  [D,PC], 0,X
      MOVW  [D,PC], 1,+X
      MOVW  [D,PC], 8,-X
      MOVW  [D,PC], 1,X+
      MOVW  [D,PC], 8,X-
      MOVW  [D,PC], 0,Y
      MOVW  [D,PC], 1,+Y
      MOVW  [D,PC], 8,-Y
      MOVW  [D,PC], 1,Y+
      MOVW  [D,PC], 8,Y-
      MOVW  [D,PC], 0,SP
      MOVW  [D,PC], 1,+SP
      MOVW  [D,PC], 8,-SP
      MOVW  [D,PC], 1,SP+
      MOVW  [D,PC], 8,SP-
      MOVW  [D,PC], $4FA8,PC
      MOVW  [D,PC], $E1,X
      MOVW  [D,PC], $E3E4,X
      MOVW  [D,PC], [$E4E5,X]
      MOVW  [D,PC], A,X
      MOVW  [D,PC], B,X
      MOVW  [D,PC], D,X
      MOVW  [D,PC], [D,X]
      MOVW  [D,PC], $E9,Y
      MOVW  [D,PC], $EBEC,Y
      MOVW  [D,PC], [$ECED,Y]
      MOVW  [D,PC], A,Y
      MOVW  [D,PC], B,Y
      MOVW  [D,PC], D,Y
      MOVW  [D,PC], [D,Y]
      MOVW  [D,PC], $F1,SP
      MOVW  [D,PC], $F3F4,SP
      MOVW  [D,PC], [$F4F5,SP]
      MOVW  [D,PC], A,SP
      MOVW  [D,PC], B,SP
      MOVW  [D,PC], D,SP
      MOVW  [D,PC], [D,SP]
      MOVW  [D,PC], $5109,PC
      MOVW  [D,PC], <$5015,PC
      MOVW  [D,PC], $4C17,PC
      MOVW  [D,PC], >$4F21,PC
      MOVW  [D,PC], [$4D24,PC]
      MOVW  [D,PC], A,PC
      MOVW  [D,PC], B,PC
      MOVW  [D,PC], D,PC
      MOVW  [D,PC], [D,PC]
      MOVW  #$0405, $0607
      MOVW  #$0405, >$0001
      MOVW  $0506, $0708
      MOVW  $0506, >$0001
      MOVW  >$0001, $0203
      MOVW  >$0001, >$0001
      MOVW  6,X, $0708
      MOVW  6,X, >$0001
      MOVW  1,+X, $2122
      MOVW  1,+X, >$0001
      MOVW  8,-X, $292A
      MOVW  8,-X, >$0001
      MOVW  1,X+, $3132
      MOVW  1,X+, >$0001
      MOVW  8,X-, $393A
      MOVW  8,X-, >$0001
      MOVW  0,Y, $4142
      MOVW  0,Y, >$0001
      MOVW  1,+Y, $6162
      MOVW  1,+Y, >$0001
      MOVW  8,-Y, $696A
      MOVW  8,-Y, >$0001
      MOVW  1,Y+, $7172
      MOVW  1,Y+, >$0001
      MOVW  8,Y-, $797A
      MOVW  8,Y-, >$0001
      MOVW  0,SP, $8182
      MOVW  0,SP, >$0001
      MOVW  1,+SP, $A1A2
      MOVW  1,+SP, >$0001
      MOVW  8,-SP, $A9AA
      MOVW  8,-SP, >$0001
      MOVW  1,SP+, $B1B2
      MOVW  1,SP+, >$0001
      MOVW  8,SP-, $B9BA
      MOVW  8,SP-, >$0001
      MOVW  $50F6,PC, $C1C2
      MOVW  $50FB,PC, >$0001
      MOVW  $E1,X, $E2E3
      MOVW  $E1,X, >$0001
      MOVW  $E3E4,X, $E5E6
      MOVW  $E3E4,X, >$0001
      MOVW  [$E4E5,X], $E6E7
      MOVW  [$E4E5,X], >$0001
      MOVW  A,X, $E5E6
      MOVW  A,X, >$0001
      MOVW  B,X, $E6E7
      MOVW  B,X, >$0001
      MOVW  D,X, $E7E8
      MOVW  D,X, >$0001
      MOVW  [D,X], $E8E9
      MOVW  [D,X], >$0001
      MOVW  $E9,Y, $EAEB
      MOVW  $E9,Y, >$0001
      MOVW  $EBEC,Y, $EDEE
      MOVW  $EBEC,Y, >$0001
      MOVW  [$ECED,Y], $EEEF
      MOVW  [$ECED,Y], >$0001
      MOVW  A,Y, $EDEE
      MOVW  A,Y, >$0001
      MOVW  B,Y, $EEEF
      MOVW  B,Y, >$0001
      MOVW  D,Y, $EFF0
      MOVW  D,Y, >$0001
      MOVW  [D,Y], $F0F1
      MOVW  [D,Y], >$0001
      MOVW  $F1,SP, $F2F3
      MOVW  $F1,SP, >$0001
      MOVW  $F3F4,SP, $F5F6
      MOVW  $F3F4,SP, >$0001
      MOVW  [$F4F5,SP], $F6F7
      MOVW  [$F4F5,SP], >$0001
      MOVW  A,SP, $F5F6
      MOVW  A,SP, >$0001
      MOVW  B,SP, $F6F7
      MOVW  B,SP, >$0001
      MOVW  D,SP, $F7F8
      MOVW  D,SP, >$0001
      MOVW  [D,SP], $F8F9
      MOVW  [D,SP], >$0001
      MOVW  $52EA,PC, $FAFB
      MOVW  $52F0,PC, >$0001
      MOVW  <$51FD,PC, $0102
      MOVW  <$5203,PC, >$0001
      MOVW  $4E06,PC, $FDFE
      MOVW  $4E0D,PC, >$0001
      MOVW  >$5118,PC, $0102
      MOVW  >$511F,PC, >$0001
      MOVW  [$4F23,PC], $FEFF
      MOVW  [$4F2A,PC], >$0001
      MOVW  A,PC, $FDFE
      MOVW  A,PC, >$0001
      MOVW  B,PC, $FEFF
      MOVW  B,PC, >$0001
      MOVW  D,PC, $FF00
      MOVW  D,PC, >$0001
      MOVW  [D,PC], >$0001
      MOVW  [D,PC], $0102
      ABA
      DAA
      MOVB  #10, 9,X
      MOVB  #$21, 1,+X
      MOVB  #$29, 8,-X
      MOVB  #$31, 1,X+
      MOVB  #$39, 8,X-
      MOVB  #$41, 0,Y
      MOVB  #$61, 1,+Y
      MOVB  #$69, 8,-Y
      MOVB  #$71, 1,Y+
      MOVB  #$79, 8,Y-
      MOVB  #$81, 0,SP
      MOVB  #$A1, 1,+SP
      MOVB  #$A9, 8,-SP
      MOVB  #$B1, 1,SP+
      MOVB  #$B9, 8,SP-
      MOVB  #$C1, $5299,PC
      MOVB  #$E2, $E1,X
      MOVB  #$E5, $E3E4,X
      MOVB  #$E6, [$E4E5,X]
      MOVB  #$E5, A,X
      MOVB  #$E6, B,X
      MOVB  #$E7, D,X
      MOVB  #$E8, [D,X]
      MOVB  #$EA, $E9,Y
      MOVB  #$ED, $EBEC,Y
      MOVB  #$EE, [$ECED,Y]
      MOVB  #$ED, A,Y
      MOVB  #$EE, B,Y
      MOVB  #$EF, D,Y
      MOVB  #$F0, [D,Y]
      MOVB  #$F2, $F1,SP
      MOVB  #$F5, $F3F4,SP
      MOVB  #$F6, [$F4F5,SP]
      MOVB  #$F5, A,SP
      MOVB  #$F6, B,SP
      MOVB  #$F7, D,SP
      MOVB  #$F8, [D,SP]
      MOVB  #$FA, $53FA,PC
      MOVB  #1, <$5306,PC
      MOVB  #$FD, $4F08,PC
      MOVB  #1, >$5212,PC
      MOVB  #$FE, [$5015,PC]
      MOVB  #$FD, A,PC
      MOVB  #$FE, B,PC
      MOVB  #$FF, D,PC
      MOVB  #0, [D,PC]
      MOVB  $0B0C, 10,X
      MOVB  >$0001, 10,X
      MOVB  $2122, 1,+X
      MOVB  >$0001, 1,+X
      MOVB  $292A, 8,-X
      MOVB  >$0001, 8,-X
      MOVB  $3132, 1,X+
      MOVB  >$0001, 1,X+
      MOVB  $393A, 8,X-
      MOVB  >$0001, 8,X-
      MOVB  $4142, 0,Y
      MOVB  >$0001, 0,Y
      MOVB  $6162, 1,+Y
      MOVB  >$0001, 1,+Y
      MOVB  $696A, 8,-Y
      MOVB  >$0001, 8,-Y
      MOVB  $7172, 1,Y+
      MOVB  >$0001, 1,Y+
      MOVB  $797A, 8,Y-
      MOVB  >$0001, 8,Y-
      MOVB  $8182, 0,SP
      MOVB  >$0001, 0,SP
      MOVB  $A1A2, 1,+SP
      MOVB  >$0001, 1,+SP
      MOVB  $A9AA, 8,-SP
      MOVB  >$0001, 8,-SP
      MOVB  $B1B2, 1,SP+
      MOVB  >$0001, 1,SP+
      MOVB  $B9BA, 8,SP-
      MOVB  >$0001, 8,SP-
      MOVB  $C1C2, $53C3,PC
      MOVB  >$0001, $53C8,PC
      MOVB  $E2E3, $E1,X
      MOVB  >$0001, $E1,X
      MOVB  $E5E6, $E3E4,X
      MOVB  >$0001, $E3E4,X
      MOVB  $E6E7, [$E4E5,X]
      MOVB  >$0001, [$E4E5,X]
      MOVB  $E5E6, A,X
      MOVB  >$0001, A,X
      MOVB  $E6E7, B,X
      MOVB  >$0001, B,X
      MOVB  $E7E8, D,X
      MOVB  >$0001, D,X
      MOVB  $E8E9, [D,X]
      MOVB  >$0001, [D,X]
      MOVB  $EAEB, $E9,Y
      MOVB  >$0001, $E9,Y
      MOVB  $EDEE, $EBEC,Y
      MOVB  >$0001, $EBEC,Y
      MOVB  $EEEF, [$ECED,Y]
      MOVB  >$0001, [$ECED,Y]
      MOVB  $EDEE, A,Y
      MOVB  >$0001, A,Y
      MOVB  $EEEF, B,Y
      MOVB  >$0001, B,Y
      MOVB  $EFF0, D,Y
      MOVB  >$0001, D,Y
      MOVB  $F0F1, [D,Y]
      MOVB  >$0001, [D,Y]
      MOVB  $F2F3, $F1,SP
      MOVB  >$0001, $F1,SP
      MOVB  $F5F6, $F3F4,SP
      MOVB  >$0001, $F3F4,SP
      MOVB  $F6F7, [$F4F5,SP]
      MOVB  >$0001, [$F4F5,SP]
      MOVB  $F5F6, A,SP
      MOVB  >$0001, A,SP
      MOVB  $F6F7, B,SP
      MOVB  >$0001, B,SP
      MOVB  $F7F8, D,SP
      MOVB  >$0001, D,SP
      MOVB  $F8F9, [D,SP]
      MOVB  >$0001, [D,SP]
      MOVB  $FAFB, $55B7,PC
      MOVB  >$0001, $55BD,PC
      MOVB  $0102, <$54CA,PC
      MOVB  >$0001, <$54D0,PC
      MOVB  $FDFE, $50D3,PC
      MOVB  >$0001, $50DA,PC
      MOVB  $0102, >$53E5,PC
      MOVB  >$0001, >$53EC,PC
      MOVB  $FEFF, [$51F0,PC]
      MOVB  >$0001, [$51F7,PC]
      MOVB  $FDFE, A,PC
      MOVB  >$0001, A,PC
      MOVB  $FEFF, B,PC
      MOVB  >$0001, B,PC
      MOVB  $FF00, D,PC
      MOVB  >$0001, D,PC
      MOVB  >$0001, [D,PC]
      MOVB  $0102, [D,PC]
      MOVB  11,X, 12,X
      MOVB  11,X, 1,+X
      MOVB  11,X, 8,-X
      MOVB  11,X, 1,X+
      MOVB  11,X, 8,X-
      MOVB  11,X, 0,Y
      MOVB  11,X, 1,+Y
      MOVB  11,X, 8,-Y
      MOVB  11,X, 1,Y+
      MOVB  11,X, 8,Y-
      MOVB  11,X, 0,SP
      MOVB  11,X, 1,+SP
      MOVB  11,X, 8,-SP
      MOVB  11,X, 1,SP+
      MOVB  11,X, 8,SP-
      MOVB  11,X, $5562,PC
      MOVB  11,X, $E1,X
      MOVB  11,X, $E3E4,X
      MOVB  11,X, [$E4E5,X]
      MOVB  11,X, A,X
      MOVB  11,X, B,X
      MOVB  11,X, D,X
      MOVB  11,X, [D,X]
      MOVB  11,X, $E9,Y
      MOVB  11,X, $EBEC,Y
      MOVB  11,X, [$ECED,Y]
      MOVB  11,X, A,Y
      MOVB  11,X, B,Y
      MOVB  11,X, D,Y
      MOVB  11,X, [D,Y]
      MOVB  11,X, $F1,SP
      MOVB  11,X, $F3F4,SP
      MOVB  11,X, [$F4F5,SP]
      MOVB  11,X, A,SP
      MOVB  11,X, B,SP
      MOVB  11,X, D,SP
      MOVB  11,X, [D,SP]
      MOVB  11,X, $56C3,PC
      MOVB  11,X, <$55CF,PC
      MOVB  11,X, $51D1,PC
      MOVB  11,X, >$54DB,PC
      MOVB  11,X, [$52DE,PC]
      MOVB  11,X, A,PC
      MOVB  11,X, B,PC
      MOVB  11,X, D,PC
      MOVB  11,X, [D,PC]
      MOVB  1,+X, 2,+X
      MOVB  1,+X, 8,-X
      MOVB  1,+X, 1,X+
      MOVB  1,+X, 8,X-
      MOVB  1,+X, 0,Y
      MOVB  1,+X, 1,+Y
      MOVB  1,+X, 8,-Y
      MOVB  1,+X, 1,Y+
      MOVB  1,+X, 8,Y-
      MOVB  1,+X, 0,SP
      MOVB  1,+X, 1,+SP
      MOVB  1,+X, 8,-SP
      MOVB  1,+X, 1,SP+
      MOVB  1,+X, 8,SP-
      MOVB  1,+X, $562D,PC
      MOVB  1,+X, $E1,X
      MOVB  1,+X, $E3E4,X
      MOVB  1,+X, [$E4E5,X]
      MOVB  1,+X, A,X
      MOVB  1,+X, B,X
      MOVB  1,+X, D,X
      MOVB  1,+X, [D,X]
      MOVB  1,+X, $E9,Y
      MOVB  1,+X, $EBEC,Y
      MOVB  1,+X, [$ECED,Y]
      MOVB  1,+X, A,Y
      MOVB  1,+X, B,Y
      MOVB  1,+X, D,Y
      MOVB  1,+X, [D,Y]
      MOVB  1,+X, $F1,SP
      MOVB  1,+X, $F3F4,SP
      MOVB  1,+X, [$F4F5,SP]
      MOVB  1,+X, A,SP
      MOVB  1,+X, B,SP
      MOVB  1,+X, D,SP
      MOVB  1,+X, [D,SP]
      MOVB  1,+X, $578E,PC
      MOVB  1,+X, <$569A,PC
      MOVB  1,+X, $529C,PC
      MOVB  1,+X, >$55A6,PC
      MOVB  1,+X, [$53A9,PC]
      MOVB  1,+X, A,PC
      MOVB  1,+X, B,PC
      MOVB  1,+X, D,PC
      MOVB  1,+X, [D,PC]
      MOVB  1,+X, 0,X
      MOVB  8,-X, 7,-X
      MOVB  8,-X, 1,X+
      MOVB  8,-X, 8,X-
      MOVB  8,-X, 0,Y
      MOVB  8,-X, 1,+Y
      MOVB  8,-X, 8,-Y
      MOVB  8,-X, 1,Y+
      MOVB  8,-X, 8,Y-
      MOVB  8,-X, 0,SP
      MOVB  8,-X, 1,+SP
      MOVB  8,-X, 8,-SP
      MOVB  8,-X, 1,SP+
      MOVB  8,-X, 8,SP-
      MOVB  8,-X, $56F8,PC
      MOVB  8,-X, $E1,X
      MOVB  8,-X, $E3E4,X
      MOVB  8,-X, [$E4E5,X]
      MOVB  8,-X, A,X
      MOVB  8,-X, B,X
      MOVB  8,-X, D,X
      MOVB  8,-X, [D,X]
      MOVB  8,-X, $E9,Y
      MOVB  8,-X, $EBEC,Y
      MOVB  8,-X, [$ECED,Y]
      MOVB  8,-X, A,Y
      MOVB  8,-X, B,Y
      MOVB  8,-X, D,Y
      MOVB  8,-X, [D,Y]
      MOVB  8,-X, $F1,SP
      MOVB  8,-X, $F3F4,SP
      MOVB  8,-X, [$F4F5,SP]
      MOVB  8,-X, A,SP
      MOVB  8,-X, B,SP
      MOVB  8,-X, D,SP
      MOVB  8,-X, [D,SP]
      MOVB  8,-X, $5859,PC
      MOVB  8,-X, <$5765,PC
      MOVB  8,-X, $5367,PC
      MOVB  8,-X, >$5671,PC
      MOVB  8,-X, [$5474,PC]
      MOVB  8,-X, A,PC
      MOVB  8,-X, B,PC
      MOVB  8,-X, D,PC
      MOVB  8,-X, [D,PC]
      MOVB  8,-X, 0,X
      MOVB  8,-X, 1,+X
      MOVB  1,X+, 2,X+
      MOVB  1,X+, 8,X-
      MOVB  1,X+, 0,Y
      MOVB  1,X+, 1,+Y
      MOVB  1,X+, 8,-Y
      MOVB  1,X+, 1,Y+
      MOVB  1,X+, 8,Y-
      MOVB  1,X+, 0,SP
      MOVB  1,X+, 1,+SP
      MOVB  1,X+, 8,-SP
      MOVB  1,X+, 1,SP+
      MOVB  1,X+, 8,SP-
      MOVB  1,X+, $57C3,PC
      MOVB  1,X+, $E1,X
      MOVB  1,X+, $E3E4,X
      MOVB  1,X+, [$E4E5,X]
      MOVB  1,X+, A,X
      MOVB  1,X+, B,X
      MOVB  1,X+, D,X
      MOVB  1,X+, [D,X]
      MOVB  1,X+, $E9,Y
      MOVB  1,X+, $EBEC,Y
      MOVB  1,X+, [$ECED,Y]
      MOVB  1,X+, A,Y
      MOVB  1,X+, B,Y
      MOVB  1,X+, D,Y
      MOVB  1,X+, [D,Y]
      MOVB  1,X+, $F1,SP
      MOVB  1,X+, $F3F4,SP
      MOVB  1,X+, [$F4F5,SP]
      MOVB  1,X+, A,SP
      MOVB  1,X+, B,SP
      MOVB  1,X+, D,SP
      MOVB  1,X+, [D,SP]
      MOVB  1,X+, $5924,PC
      MOVB  1,X+, <$5830,PC
      MOVB  1,X+, $5432,PC
      MOVB  1,X+, >$573C,PC
      MOVB  1,X+, [$553F,PC]
      MOVB  1,X+, A,PC
      MOVB  1,X+, B,PC
      MOVB  1,X+, D,PC
      MOVB  1,X+, [D,PC]
      MOVB  1,X+, 0,X
      MOVB  1,X+, 1,+X
      MOVB  1,X+, 8,-X
      MOVB  8,X-, 7,X-
      MOVB  8,X-, 0,Y
      MOVB  8,X-, 1,+Y
      MOVB  8,X-, 8,-Y
      MOVB  8,X-, 1,Y+
      MOVB  8,X-, 8,Y-
      MOVB  8,X-, 0,SP
      MOVB  8,X-, 1,+SP
      MOVB  8,X-, 8,-SP
      MOVB  8,X-, 1,SP+
      MOVB  8,X-, 8,SP-
      MOVB  8,X-, $588E,PC
      MOVB  8,X-, $E1,X
      MOVB  8,X-, $E3E4,X
      MOVB  8,X-, [$E4E5,X]
      MOVB  8,X-, A,X
      MOVB  8,X-, B,X
      MOVB  8,X-, D,X
      MOVB  8,X-, [D,X]
      MOVB  8,X-, $E9,Y
      MOVB  8,X-, $EBEC,Y
      MOVB  8,X-, [$ECED,Y]
      MOVB  8,X-, A,Y
      MOVB  8,X-, B,Y
      MOVB  8,X-, D,Y
      MOVB  8,X-, [D,Y]
      MOVB  8,X-, $F1,SP
      MOVB  8,X-, $F3F4,SP
      MOVB  8,X-, [$F4F5,SP]
      MOVB  8,X-, A,SP
      MOVB  8,X-, B,SP
      MOVB  8,X-, D,SP
      MOVB  8,X-, [D,SP]
      MOVB  8,X-, $59EF,PC
      MOVB  8,X-, <$58FB,PC
      MOVB  8,X-, $54FD,PC
      MOVB  8,X-, >$5807,PC
      MOVB  8,X-, [$560A,PC]
      MOVB  8,X-, A,PC
      MOVB  8,X-, B,PC
      MOVB  8,X-, D,PC
      MOVB  8,X-, [D,PC]
      MOVB  8,X-, 0,X
      MOVB  8,X-, 1,+X
      MOVB  8,X-, 8,-X
      MOVB  8,X-, 1,X+
      MOVB  0,Y, 1,Y
      MOVB  0,Y, 1,+Y
      MOVB  0,Y, 8,-Y
      MOVB  0,Y, 1,Y+
      MOVB  0,Y, 8,Y-
      MOVB  0,Y, 0,SP
      MOVB  0,Y, 1,+SP
      MOVB  0,Y, 8,-SP
      MOVB  0,Y, 1,SP+
      MOVB  0,Y, 8,SP-
      MOVB  0,Y, $5959,PC
      MOVB  0,Y, $E1,X
      MOVB  0,Y, $E3E4,X
      MOVB  0,Y, [$E4E5,X]
      MOVB  0,Y, A,X
      MOVB  0,Y, B,X
      MOVB  0,Y, D,X
      MOVB  0,Y, [D,X]
      MOVB  0,Y, $E9,Y
      MOVB  0,Y, $EBEC,Y
      MOVB  0,Y, [$ECED,Y]
      MOVB  0,Y, A,Y
      MOVB  0,Y, B,Y
      MOVB  0,Y, D,Y
      MOVB  0,Y, [D,Y]
      MOVB  0,Y, $F1,SP
      MOVB  0,Y, $F3F4,SP
      MOVB  0,Y, [$F4F5,SP]
      MOVB  0,Y, A,SP
      MOVB  0,Y, B,SP
      MOVB  0,Y, D,SP
      MOVB  0,Y, [D,SP]
      MOVB  0,Y, $5ABA,PC
      MOVB  0,Y, <$59C6,PC
      MOVB  0,Y, $55C8,PC
      MOVB  0,Y, >$58D2,PC
      MOVB  0,Y, [$56D5,PC]
      MOVB  0,Y, A,PC
      MOVB  0,Y, B,PC
      MOVB  0,Y, D,PC
      MOVB  0,Y, [D,PC]
      MOVB  0,Y, 0,X
      MOVB  0,Y, 1,+X
      MOVB  0,Y, 8,-X
      MOVB  0,Y, 1,X+
      MOVB  0,Y, 8,X-
      MOVB  1,+Y, 2,+Y
      MOVB  1,+Y, 8,-Y
      MOVB  1,+Y, 1,Y+
      MOVB  1,+Y, 8,Y-
      MOVB  1,+Y, 0,SP
      MOVB  1,+Y, 1,+SP
      MOVB  1,+Y, 8,-SP
      MOVB  1,+Y, 1,SP+
      MOVB  1,+Y, 8,SP-
      MOVB  1,+Y, $5A24,PC
      MOVB  1,+Y, $E1,X
      MOVB  1,+Y, $E3E4,X
      MOVB  1,+Y, [$E4E5,X]
      MOVB  1,+Y, A,X
      MOVB  1,+Y, B,X
      MOVB  1,+Y, D,X
      MOVB  1,+Y, [D,X]
      MOVB  1,+Y, $E9,Y
      MOVB  1,+Y, $EBEC,Y
      MOVB  1,+Y, [$ECED,Y]
      MOVB  1,+Y, A,Y
      MOVB  1,+Y, B,Y
      MOVB  1,+Y, D,Y
      MOVB  1,+Y, [D,Y]
      MOVB  1,+Y, $F1,SP
      MOVB  1,+Y, $F3F4,SP
      MOVB  1,+Y, [$F4F5,SP]
      MOVB  1,+Y, A,SP
      MOVB  1,+Y, B,SP
      MOVB  1,+Y, D,SP
      MOVB  1,+Y, [D,SP]
      MOVB  1,+Y, $5B85,PC
      MOVB  1,+Y, <$5A91,PC
      MOVB  1,+Y, $5693,PC
      MOVB  1,+Y, >$599D,PC
      MOVB  1,+Y, [$57A0,PC]
      MOVB  1,+Y, A,PC
      MOVB  1,+Y, B,PC
      MOVB  1,+Y, D,PC
      MOVB  1,+Y, [D,PC]
      MOVB  1,+Y, 0,X
      MOVB  1,+Y, 1,+X
      MOVB  1,+Y, 8,-X
      MOVB  1,+Y, 1,X+
      MOVB  1,+Y, 8,X-
      MOVB  1,+Y, 0,Y
      MOVB  8,-Y, 7,-Y
      MOVB  8,-Y, 1,Y+
      MOVB  8,-Y, 8,Y-
      MOVB  8,-Y, 0,SP
      MOVB  8,-Y, 1,+SP
      MOVB  8,-Y, 8,-SP
      MOVB  8,-Y, 1,SP+
      MOVB  8,-Y, 8,SP-
      MOVB  8,-Y, $5AEF,PC
      MOVB  8,-Y, $E1,X
      MOVB  8,-Y, $E3E4,X
      MOVB  8,-Y, [$E4E5,X]
      MOVB  8,-Y, A,X
      MOVB  8,-Y, B,X
      MOVB  8,-Y, D,X
      MOVB  8,-Y, [D,X]
      MOVB  8,-Y, $E9,Y
      MOVB  8,-Y, $EBEC,Y
      MOVB  8,-Y, [$ECED,Y]
      MOVB  8,-Y, A,Y
      MOVB  8,-Y, B,Y
      MOVB  8,-Y, D,Y
      MOVB  8,-Y, [D,Y]
      MOVB  8,-Y, $F1,SP
      MOVB  8,-Y, $F3F4,SP
      MOVB  8,-Y, [$F4F5,SP]
      MOVB  8,-Y, A,SP
      MOVB  8,-Y, B,SP
      MOVB  8,-Y, D,SP
      MOVB  8,-Y, [D,SP]
      MOVB  8,-Y, $5C50,PC
      MOVB  8,-Y, <$5B5C,PC
      MOVB  8,-Y, $575E,PC
      MOVB  8,-Y, >$5A68,PC
      MOVB  8,-Y, [$586B,PC]
      MOVB  8,-Y, A,PC
      MOVB  8,-Y, B,PC
      MOVB  8,-Y, D,PC
      MOVB  8,-Y, [D,PC]
      MOVB  8,-Y, 0,X
      MOVB  8,-Y, 1,+X
      MOVB  8,-Y, 8,-X
      MOVB  8,-Y, 1,X+
      MOVB  8,-Y, 8,X-
      MOVB  8,-Y, 0,Y
      MOVB  8,-Y, 1,+Y
      MOVB  1,Y+, 2,Y+
      MOVB  1,Y+, 8,Y-
      MOVB  1,Y+, 0,SP
      MOVB  1,Y+, 1,+SP
      MOVB  1,Y+, 8,-SP
      MOVB  1,Y+, 1,SP+
      MOVB  1,Y+, 8,SP-
      MOVB  1,Y+, $5BBA,PC
      MOVB  1,Y+, $E1,X
      MOVB  1,Y+, $E3E4,X
      MOVB  1,Y+, [$E4E5,X]
      MOVB  1,Y+, A,X
      MOVB  1,Y+, B,X
      MOVB  1,Y+, D,X
      MOVB  1,Y+, [D,X]
      MOVB  1,Y+, $E9,Y
      MOVB  1,Y+, $EBEC,Y
      MOVB  1,Y+, [$ECED,Y]
      MOVB  1,Y+, A,Y
      MOVB  1,Y+, B,Y
      MOVB  1,Y+, D,Y
      MOVB  1,Y+, [D,Y]
      MOVB  1,Y+, $F1,SP
      MOVB  1,Y+, $F3F4,SP
      MOVB  1,Y+, [$F4F5,SP]
      MOVB  1,Y+, A,SP
      MOVB  1,Y+, B,SP
      MOVB  1,Y+, D,SP
      MOVB  1,Y+, [D,SP]
      MOVB  1,Y+, $5D1B,PC
      MOVB  1,Y+, <$5C27,PC
      MOVB  1,Y+, $5829,PC
      MOVB  1,Y+, >$5B33,PC
      MOVB  1,Y+, [$5936,PC]
      MOVB  1,Y+, A,PC
      MOVB  1,Y+, B,PC
      MOVB  1,Y+, D,PC
      MOVB  1,Y+, [D,PC]
      MOVB  1,Y+, 0,X
      MOVB  1,Y+, 1,+X
      MOVB  1,Y+, 8,-X
      MOVB  1,Y+, 1,X+
      MOVB  1,Y+, 8,X-
      MOVB  1,Y+, 0,Y
      MOVB  1,Y+, 1,+Y
      MOVB  1,Y+, 8,-Y
      MOVB  8,Y-, 7,Y-
      MOVB  8,Y-, 0,SP
      MOVB  8,Y-, 1,+SP
      MOVB  8,Y-, 8,-SP
      MOVB  8,Y-, 1,SP+
      MOVB  8,Y-, 8,SP-
      MOVB  8,Y-, $5C85,PC
      MOVB  8,Y-, $E1,X
      MOVB  8,Y-, $E3E4,X
      MOVB  8,Y-, [$E4E5,X]
      MOVB  8,Y-, A,X
      MOVB  8,Y-, B,X
      MOVB  8,Y-, D,X
      MOVB  8,Y-, [D,X]
      MOVB  8,Y-, $E9,Y
      MOVB  8,Y-, $EBEC,Y
      MOVB  8,Y-, [$ECED,Y]
      MOVB  8,Y-, A,Y
      MOVB  8,Y-, B,Y
      MOVB  8,Y-, D,Y
      MOVB  8,Y-, [D,Y]
      MOVB  8,Y-, $F1,SP
      MOVB  8,Y-, $F3F4,SP
      MOVB  8,Y-, [$F4F5,SP]
      MOVB  8,Y-, A,SP
      MOVB  8,Y-, B,SP
      MOVB  8,Y-, D,SP
      MOVB  8,Y-, [D,SP]
      MOVB  8,Y-, $5DE6,PC
      MOVB  8,Y-, <$5CF2,PC
      MOVB  8,Y-, $58F4,PC
      MOVB  8,Y-, >$5BFE,PC
      MOVB  8,Y-, [$5A01,PC]
      MOVB  8,Y-, A,PC
      MOVB  8,Y-, B,PC
      MOVB  8,Y-, D,PC
      MOVB  8,Y-, [D,PC]
      MOVB  8,Y-, 0,X
      MOVB  8,Y-, 1,+X
      MOVB  8,Y-, 8,-X
      MOVB  8,Y-, 1,X+
      MOVB  8,Y-, 8,X-
      MOVB  8,Y-, 0,Y
      MOVB  8,Y-, 1,+Y
      MOVB  8,Y-, 8,-Y
      MOVB  8,Y-, 1,Y+
      MOVB  0,SP, 1,SP
      MOVB  0,SP, 1,+SP
      MOVB  0,SP, 8,-SP
      MOVB  0,SP, 1,SP+
      MOVB  0,SP, 8,SP-
      MOVB  0,SP, $5D50,PC
      MOVB  0,SP, $E1,X
      MOVB  0,SP, $E3E4,X
      MOVB  0,SP, [$E4E5,X]
      MOVB  0,SP, A,X
      MOVB  0,SP, B,X
      MOVB  0,SP, D,X
      MOVB  0,SP, [D,X]
      MOVB  0,SP, $E9,Y
      MOVB  0,SP, $EBEC,Y
      MOVB  0,SP, [$ECED,Y]
      MOVB  0,SP, A,Y
      MOVB  0,SP, B,Y
      MOVB  0,SP, D,Y
      MOVB  0,SP, [D,Y]
      MOVB  0,SP, $F1,SP
      MOVB  0,SP, $F3F4,SP
      MOVB  0,SP, [$F4F5,SP]
      MOVB  0,SP, A,SP
      MOVB  0,SP, B,SP
      MOVB  0,SP, D,SP
      MOVB  0,SP, [D,SP]
      MOVB  0,SP, $5EB1,PC
      MOVB  0,SP, <$5DBD,PC
      MOVB  0,SP, $59BF,PC
      MOVB  0,SP, >$5CC9,PC
      MOVB  0,SP, [$5ACC,PC]
      MOVB  0,SP, A,PC
      MOVB  0,SP, B,PC
      MOVB  0,SP, D,PC
      MOVB  0,SP, [D,PC]
      MOVB  0,SP, 0,X
      MOVB  0,SP, 1,+X
      MOVB  0,SP, 8,-X
      MOVB  0,SP, 1,X+
      MOVB  0,SP, 8,X-
      MOVB  0,SP, 0,Y
      MOVB  0,SP, 1,+Y
      MOVB  0,SP, 8,-Y
      MOVB  0,SP, 1,Y+
      MOVB  0,SP, 8,Y-
      MOVB  1,+SP, 2,+SP
      MOVB  1,+SP, 8,-SP
      MOVB  1,+SP, 1,SP+
      MOVB  1,+SP, 8,SP-
      MOVB  1,+SP, $5E1B,PC
      MOVB  1,+SP, $E1,X
      MOVB  1,+SP, $E3E4,X
      MOVB  1,+SP, [$E4E5,X]
      MOVB  1,+SP, A,X
      MOVB  1,+SP, B,X
      MOVB  1,+SP, D,X
      MOVB  1,+SP, [D,X]
      MOVB  1,+SP, $E9,Y
      MOVB  1,+SP, $EBEC,Y
      MOVB  1,+SP, [$ECED,Y]
      MOVB  1,+SP, A,Y
      MOVB  1,+SP, B,Y
      MOVB  1,+SP, D,Y
      MOVB  1,+SP, [D,Y]
      MOVB  1,+SP, $F1,SP
      MOVB  1,+SP, $F3F4,SP
      MOVB  1,+SP, [$F4F5,SP]
      MOVB  1,+SP, A,SP
      MOVB  1,+SP, B,SP
      MOVB  1,+SP, D,SP
      MOVB  1,+SP, [D,SP]
      MOVB  1,+SP, $5F7C,PC
      MOVB  1,+SP, <$5E88,PC
      MOVB  1,+SP, $5A8A,PC
      MOVB  1,+SP, >$5D94,PC
      MOVB  1,+SP, [$5B97,PC]
      MOVB  1,+SP, A,PC
      MOVB  1,+SP, B,PC
      MOVB  1,+SP, D,PC
      MOVB  1,+SP, [D,PC]
      MOVB  1,+SP, 0,X
      MOVB  1,+SP, 1,+X
      MOVB  1,+SP, 8,-X
      MOVB  1,+SP, 1,X+
      MOVB  1,+SP, 8,X-
      MOVB  1,+SP, 0,Y
      MOVB  1,+SP, 1,+Y
      MOVB  1,+SP, 8,-Y
      MOVB  1,+SP, 1,Y+
      MOVB  1,+SP, 8,Y-
      MOVB  1,+SP, 0,SP
      MOVB  8,-SP, 7,-SP
      MOVB  8,-SP, 1,SP+
      MOVB  8,-SP, 8,SP-
      MOVB  8,-SP, $5EE6,PC
      MOVB  8,-SP, $E1,X
      MOVB  8,-SP, $E3E4,X
      MOVB  8,-SP, [$E4E5,X]
      MOVB  8,-SP, A,X
      MOVB  8,-SP, B,X
      MOVB  8,-SP, D,X
      MOVB  8,-SP, [D,X]
      MOVB  8,-SP, $E9,Y
      MOVB  8,-SP, $EBEC,Y
      MOVB  8,-SP, [$ECED,Y]
      MOVB  8,-SP, A,Y
      MOVB  8,-SP, B,Y
      MOVB  8,-SP, D,Y
      MOVB  8,-SP, [D,Y]
      MOVB  8,-SP, $F1,SP
      MOVB  8,-SP, $F3F4,SP
      MOVB  8,-SP, [$F4F5,SP]
      MOVB  8,-SP, A,SP
      MOVB  8,-SP, B,SP
      MOVB  8,-SP, D,SP
      MOVB  8,-SP, [D,SP]
      MOVB  8,-SP, $6047,PC
      MOVB  8,-SP, <$5F53,PC
      MOVB  8,-SP, $5B55,PC
      MOVB  8,-SP, >$5E5F,PC
      MOVB  8,-SP, [$5C62,PC]
      MOVB  8,-SP, A,PC
      MOVB  8,-SP, B,PC
      MOVB  8,-SP, D,PC
      MOVB  8,-SP, [D,PC]
      MOVB  8,-SP, 0,X
      MOVB  8,-SP, 1,+X
      MOVB  8,-SP, 8,-X
      MOVB  8,-SP, 1,X+
      MOVB  8,-SP, 8,X-
      MOVB  8,-SP, 0,Y
      MOVB  8,-SP, 1,+Y
      MOVB  8,-SP, 8,-Y
      MOVB  8,-SP, 1,Y+
      MOVB  8,-SP, 8,Y-
      MOVB  8,-SP, 0,SP
      MOVB  8,-SP, 1,+SP
      MOVB  1,SP+, 2,SP+
      MOVB  1,SP+, 8,SP-
      MOVB  1,SP+, $5FB1,PC
      MOVB  1,SP+, $E1,X
      MOVB  1,SP+, $E3E4,X
      MOVB  1,SP+, [$E4E5,X]
      MOVB  1,SP+, A,X
      MOVB  1,SP+, B,X
      MOVB  1,SP+, D,X
      MOVB  1,SP+, [D,X]
      MOVB  1,SP+, $E9,Y
      MOVB  1,SP+, $EBEC,Y
      MOVB  1,SP+, [$ECED,Y]
      MOVB  1,SP+, A,Y
      MOVB  1,SP+, B,Y
      MOVB  1,SP+, D,Y
      MOVB  1,SP+, [D,Y]
      MOVB  1,SP+, $F1,SP
      MOVB  1,SP+, $F3F4,SP
      MOVB  1,SP+, [$F4F5,SP]
      MOVB  1,SP+, A,SP
      MOVB  1,SP+, B,SP
      MOVB  1,SP+, D,SP
      MOVB  1,SP+, [D,SP]
      MOVB  1,SP+, $6112,PC
      MOVB  1,SP+, <$601E,PC
      MOVB  1,SP+, $5C20,PC
      MOVB  1,SP+, >$5F2A,PC
      MOVB  1,SP+, [$5D2D,PC]
      MOVB  1,SP+, A,PC
      MOVB  1,SP+, B,PC
      MOVB  1,SP+, D,PC
      MOVB  1,SP+, [D,PC]
      MOVB  1,SP+, 0,X
      MOVB  1,SP+, 1,+X
      MOVB  1,SP+, 8,-X
      MOVB  1,SP+, 1,X+
      MOVB  1,SP+, 8,X-
      MOVB  1,SP+, 0,Y
      MOVB  1,SP+, 1,+Y
      MOVB  1,SP+, 8,-Y
      MOVB  1,SP+, 1,Y+
      MOVB  1,SP+, 8,Y-
      MOVB  1,SP+, 0,SP
      MOVB  1,SP+, 1,+SP
      MOVB  1,SP+, 8,-SP
      MOVB  8,SP-, 7,SP-
      MOVB  8,SP-, $607C,PC
      MOVB  8,SP-, $E1,X
      MOVB  8,SP-, $E3E4,X
      MOVB  8,SP-, [$E4E5,X]
      MOVB  8,SP-, A,X
      MOVB  8,SP-, B,X
      MOVB  8,SP-, D,X
      MOVB  8,SP-, [D,X]
      MOVB  8,SP-, $E9,Y
      MOVB  8,SP-, $EBEC,Y
      MOVB  8,SP-, [$ECED,Y]
      MOVB  8,SP-, A,Y
      MOVB  8,SP-, B,Y
      MOVB  8,SP-, D,Y
      MOVB  8,SP-, [D,Y]
      MOVB  8,SP-, $F1,SP
      MOVB  8,SP-, $F3F4,SP
      MOVB  8,SP-, [$F4F5,SP]
      MOVB  8,SP-, A,SP
      MOVB  8,SP-, B,SP
      MOVB  8,SP-, D,SP
      MOVB  8,SP-, [D,SP]
      MOVB  8,SP-, $61DD,PC
      MOVB  8,SP-, <$60E9,PC
      MOVB  8,SP-, $5CEB,PC
      MOVB  8,SP-, >$5FF5,PC
      MOVB  8,SP-, [$5DF8,PC]
      MOVB  8,SP-, A,PC
      MOVB  8,SP-, B,PC
      MOVB  8,SP-, D,PC
      MOVB  8,SP-, [D,PC]
      MOVB  8,SP-, 0,X
      MOVB  8,SP-, 1,+X
      MOVB  8,SP-, 8,-X
      MOVB  8,SP-, 1,X+
      MOVB  8,SP-, 8,X-
      MOVB  8,SP-, 0,Y
      MOVB  8,SP-, 1,+Y
      MOVB  8,SP-, 8,-Y
      MOVB  8,SP-, 1,Y+
      MOVB  8,SP-, 8,Y-
      MOVB  8,SP-, 0,SP
      MOVB  8,SP-, 1,+SP
      MOVB  8,SP-, 8,-SP
      MOVB  8,SP-, 1,SP+
      MOVB  $6147,PC, $6148,PC
      MOVB  $614B,PC, $E1,X
      MOVB  $6150,PC, $E3E4,X
      MOVB  $6156,PC, [$E4E5,X]
      MOVB  $615C,PC, A,X
      MOVB  $6160,PC, B,X
      MOVB  $6164,PC, D,X
      MOVB  $6168,PC, [D,X]
      MOVB  $616C,PC, $E9,Y
      MOVB  $6171,PC, $EBEC,Y
      MOVB  $6177,PC, [$ECED,Y]
      MOVB  $617D,PC, A,Y
      MOVB  $6181,PC, B,Y
      MOVB  $6185,PC, D,Y
      MOVB  $6189,PC, [D,Y]
      MOVB  $618D,PC, $F1,SP
      MOVB  $6192,PC, $F3F4,SP
      MOVB  $6198,PC, [$F4F5,SP]
      MOVB  $619E,PC, A,SP
      MOVB  $61A2,PC, B,SP
      MOVB  $61A6,PC, D,SP
      MOVB  $61AA,PC, [D,SP]
      MOVB  $61AE,PC, $62A8,PC
      MOVB  $61B3,PC, <$61B4,PC
      MOVB  $61B8,PC, $5DB6,PC
      MOVB  $61BE,PC, >$60C0,PC
      MOVB  $61C4,PC, [$5EC3,PC]
      MOVB  $61CA,PC, A,PC
      MOVB  $61CE,PC, B,PC
      MOVB  $61D2,PC, D,PC
      MOVB  $61D6,PC, [D,PC]
      MOVB  $61DA,PC, 0,X
      MOVB  $61DE,PC, 1,+X
      MOVB  $61E2,PC, 8,-X
      MOVB  $61E6,PC, 1,X+
      MOVB  $61EA,PC, 8,X-
      MOVB  $61EE,PC, 0,Y
      MOVB  $61F2,PC, 1,+Y
      MOVB  $61F6,PC, 8,-Y
      MOVB  $61FA,PC, 1,Y+
      MOVB  $61FE,PC, 8,Y-
      MOVB  $6202,PC, 0,SP
      MOVB  $6206,PC, 1,+SP
      MOVB  $620A,PC, 8,-SP
      MOVB  $620E,PC, 1,SP+
      MOVB  $6212,PC, 8,SP-
      MOVB  $E1,X, $E3E4,X
      MOVB  $E1,X, [$E4E5,X]
      MOVB  $E1,X, A,X
      MOVB  $E1,X, B,X
      MOVB  $E1,X, D,X
      MOVB  $E1,X, [D,X]
      MOVB  $E9,X, $EBEC,Y
      MOVB  $E9,X, [$ECED,Y]
      MOVB  $E9,X, A,Y
      MOVB  $E9,X, B,Y
      MOVB  $E9,X, D,Y
      MOVB  $E9,X, [D,Y]
      MOVB  $F1,X, $F3F4,SP
      MOVB  $F1,X, [$F4F5,SP]
      MOVB  $F1,X, A,SP
      MOVB  $F1,X, B,SP
      MOVB  $F1,X, D,SP
      MOVB  $F1,X, [D,SP]
      MOVB  $F8,X, <$6278,PC
      MOVB  $F9,X, $5E81,PC
      MOVB  $F9,X, >$618C,PC
      MOVB  $F9,X, [$5F90,PC]
      MOVB  $F9,X, A,PC
      MOVB  $F9,X, B,PC
      MOVB  $F9,X, D,PC
      MOVB  $F9,X, [D,PC]
      MOVB  $F9,X, 1,+X
      MOVB  $F9,X, 8,-X
      MOVB  $F9,X, 1,X+
      MOVB  $F9,X, 8,X-
      MOVB  $F9,X, 1,+Y
      MOVB  $F9,X, 8,-Y
      MOVB  $F9,X, 1,Y+
      MOVB  $F9,X, 8,Y-
      MOVB  $F9,X, 1,+SP
      MOVB  $F9,X, 8,-SP
      MOVB  $F9,X, 1,SP+
      MOVB  $F9,X, 8,SP-
      MOVB  $E3E4,X, B,X
      MOVB  $E3E4,X, D,X
      MOVB  $E3E4,X, [D,X]
      MOVB  $E3E9,X, $EBEC,Y
      MOVB  $E3E9,X, [$ECED,Y]
      MOVB  $E3E9,X, A,Y
      MOVB  $E3E9,X, B,Y
      MOVB  $E3E9,X, D,Y
      MOVB  $E3E9,X, [D,Y]
      MOVB  $E3F1,X, $F3F4,SP
      MOVB  $E3F1,X, [$F4F5,SP]
      MOVB  $E3F1,X, A,SP
      MOVB  $E3F1,X, B,SP
      MOVB  $E3F1,X, D,SP
      MOVB  $E3F1,X, [D,SP]
      MOVB  $E3F8,X, <$6346,PC
      MOVB  $E3F9,X, $5F50,PC
      MOVB  $E3F9,X, >$625C,PC
      MOVB  $E3F9,X, [$6061,PC]
      MOVB  $E3F9,X, A,PC
      MOVB  $E3F9,X, B,PC
      MOVB  $E3F9,X, D,PC
      MOVB  $E3F9,X, [D,PC]
      MOVB  [$E4E5,X], D,X
      MOVB  [$E4E5,X], [D,X]
      MOVB  [$E4E5,X], $E9,Y
      MOVB  [$E4E5,X], $EBEC,Y
      MOVB  [$E4E5,X], [$ECED,Y]
      MOVB  [$E4E5,X], A,Y
      MOVB  [$E4E5,X], B,Y
      MOVB  [$E4E5,X], D,Y
      MOVB  [$E4E5,X], [D,Y]
      MOVB  [$E4E5,X], $F1,SP
      MOVB  [$E4E5,X], $F3F4,SP
      MOVB  [$E4E5,X], [$F4F5,SP]
      MOVB  [$E4E5,X], A,SP
      MOVB  [$E4E5,X], B,SP
      MOVB  [$E4E5,X], D,SP
      MOVB  [$E4E5,X], [D,SP]
      MOVB  [$E4E5,X], $64E6,PC
      MOVB  [$E4E5,X], <$63F4,PC
      MOVB  [$E4E5,X], $5FF8,PC
      MOVB  [$E4E5,X], >$6304,PC
      MOVB  [$E4E5,X], [$6109,PC]
      MOVB  [$E4E5,X], A,PC
      MOVB  [$E4E5,X], B,PC
      MOVB  [$E4E5,X], D,PC
      MOVB  [$E4E5,X], [D,PC]
      MOVB  [$E4E5,X], 0,X
      MOVB  [$E4E5,X], 1,+X
      MOVB  [$E4E5,X], 8,-X
      MOVB  [$E4E5,X], 1,X+
      MOVB  [$E4E5,X], 8,X-
      MOVB  [$E4E5,X], 0,Y
      MOVB  [$E4E5,X], 1,+Y
      MOVB  [$E4E5,X], 8,-Y
      MOVB  [$E4E5,X], 1,Y+
      MOVB  [$E4E5,X], 8,Y-
      MOVB  [$E4E5,X], 0,SP
      MOVB  [$E4E5,X], 1,+SP
      MOVB  [$E4E5,X], 8,-SP
      MOVB  [$E4E5,X], 1,SP+
      MOVB  [$E4E5,X], 8,SP-
      MOVB  [$E4E5,X], $6484,PC
      MOVB  [$E4E5,X], $E1,X
      MOVB  [$E4E5,X], $E3E4,X
      MOVB  [$E4E5,X], [$E4E5,X]
      MOVB  [$E4E5,X], A,X
      MOVB  [$E4E5,X], B,X
      MOVB  A,X, B,X
      MOVB  A,X, D,X
      MOVB  A,X, [D,X]
      MOVB  A,X, $E9,Y
      MOVB  A,X, $EBEC,Y
      MOVB  A,X, [$ECED,Y]
      MOVB  A,X, A,Y
      MOVB  A,X, B,Y
      MOVB  A,X, D,Y
      MOVB  A,X, [D,Y]
      MOVB  A,X, $F1,SP
      MOVB  A,X, $F3F4,SP
      MOVB  A,X, [$F4F5,SP]
      MOVB  A,X, A,SP
      MOVB  A,X, B,SP
      MOVB  A,X, D,SP
      MOVB  A,X, [D,SP]
      MOVB  A,X, $65F3,PC
      MOVB  A,X, <$64FF,PC
      MOVB  A,X, $6101,PC
      MOVB  A,X, >$640B,PC
      MOVB  A,X, [$620E,PC]
      MOVB  A,X, A,PC
      MOVB  A,X, B,PC
      MOVB  A,X, D,PC
      MOVB  A,X, [D,PC]
      MOVB  A,X, 0,X
      MOVB  A,X, 1,+X
      MOVB  A,X, 8,-X
      MOVB  A,X, 1,X+
      MOVB  A,X, 8,X-
      MOVB  A,X, 0,Y
      MOVB  A,X, 1,+Y
      MOVB  A,X, 8,-Y
      MOVB  A,X, 1,Y+
      MOVB  A,X, 8,Y-
      MOVB  A,X, 0,SP
      MOVB  A,X, 1,+SP
      MOVB  A,X, 8,-SP
      MOVB  A,X, 1,SP+
      MOVB  A,X, 8,SP-
      MOVB  A,X, $6561,PC
      MOVB  A,X, $E1,X
      MOVB  A,X, $E3E4,X
      MOVB  A,X, [$E4E5,X]
      MOVB  A,X, A,X
      MOVB  B,X, D,X
      MOVB  B,X, [D,X]
      MOVB  B,X, $E9,Y
      MOVB  B,X, $EBEC,Y
      MOVB  B,X, [$ECED,Y]
      MOVB  B,X, A,Y
      MOVB  B,X, B,Y
      MOVB  B,X, D,Y
      MOVB  B,X, [D,Y]
      MOVB  B,X, $F1,SP
      MOVB  B,X, $F3F4,SP
      MOVB  B,X, [$F4F5,SP]
      MOVB  B,X, A,SP
      MOVB  B,X, B,SP
      MOVB  B,X, D,SP
      MOVB  B,X, [D,SP]
      MOVB  B,X, $66BE,PC
      MOVB  B,X, <$65CA,PC
      MOVB  B,X, $61CC,PC
      MOVB  B,X, >$64D6,PC
      MOVB  B,X, [$62D9,PC]
      MOVB  B,X, A,PC
      MOVB  B,X, B,PC
      MOVB  B,X, D,PC
      MOVB  B,X, [D,PC]
      MOVB  B,X, 0,X
      MOVB  B,X, 1,+X
      MOVB  B,X, 8,-X
      MOVB  B,X, 1,X+
      MOVB  B,X, 8,X-
      MOVB  B,X, 0,Y
      MOVB  B,X, 1,+Y
      MOVB  B,X, 8,-Y
      MOVB  B,X, 1,Y+
      MOVB  B,X, 8,Y-
      MOVB  B,X, 0,SP
      MOVB  B,X, 1,+SP
      MOVB  B,X, 8,-SP
      MOVB  B,X, 1,SP+
      MOVB  B,X, 8,SP-
      MOVB  B,X, $662C,PC
      MOVB  B,X, $E1,X
      MOVB  B,X, $E3E4,X
      MOVB  B,X, [$E4E5,X]
      MOVB  B,X, A,X
      MOVB  B,X, B,X
      MOVB  D,X, [D,X]
      MOVB  D,X, $E9,Y
      MOVB  D,X, $EBEC,Y
      MOVB  D,X, [$ECED,Y]
      MOVB  D,X, A,Y
      MOVB  D,X, B,Y
      MOVB  D,X, D,Y
      MOVB  D,X, [D,Y]
      MOVB  D,X, $F1,SP
      MOVB  D,X, $F3F4,SP
      MOVB  D,X, [$F4F5,SP]
      MOVB  D,X, A,SP
      MOVB  D,X, B,SP
      MOVB  D,X, D,SP
      MOVB  D,X, [D,SP]
      MOVB  D,X, $6789,PC
      MOVB  D,X, <$6695,PC
      MOVB  D,X, $6297,PC
      MOVB  D,X, >$65A1,PC
      MOVB  D,X, [$63A4,PC]
      MOVB  D,X, A,PC
      MOVB  D,X, B,PC
      MOVB  D,X, D,PC
      MOVB  D,X, [D,PC]
      MOVB  D,X, 0,X
      MOVB  D,X, 1,+X
      MOVB  D,X, 8,-X
      MOVB  D,X, 1,X+
      MOVB  D,X, 8,X-
      MOVB  D,X, 0,Y
      MOVB  D,X, 1,+Y
      MOVB  D,X, 8,-Y
      MOVB  D,X, 1,Y+
      MOVB  D,X, 8,Y-
      MOVB  D,X, 0,SP
      MOVB  D,X, 1,+SP
      MOVB  D,X, 8,-SP
      MOVB  D,X, 1,SP+
      MOVB  D,X, 8,SP-
      MOVB  D,X, $66F7,PC
      MOVB  D,X, $E1,X
      MOVB  D,X, $E3E4,X
      MOVB  D,X, [$E4E5,X]
      MOVB  D,X, A,X
      MOVB  D,X, B,X
      MOVB  D,X, D,X
      MOVB  [D,X], $E9,Y
      MOVB  [D,X], $EBEC,Y
      MOVB  [D,X], [$ECED,Y]
      MOVB  [D,X], A,Y
      MOVB  [D,X], B,Y
      MOVB  [D,X], D,Y
      MOVB  [D,X], [D,Y]
      MOVB  [D,X], $F1,SP
      MOVB  [D,X], $F3F4,SP
      MOVB  [D,X], [$F4F5,SP]
      MOVB  [D,X], A,SP
      MOVB  [D,X], B,SP
      MOVB  [D,X], D,SP
      MOVB  [D,X], [D,SP]
      MOVB  [D,X], $6854,PC
      MOVB  [D,X], <$6760,PC
      MOVB  [D,X], $6362,PC
      MOVB  [D,X], >$666C,PC
      MOVB  [D,X], [$646F,PC]
      MOVB  [D,X], A,PC
      MOVB  [D,X], B,PC
      MOVB  [D,X], D,PC
      MOVB  [D,X], [D,PC]
      MOVB  [D,X], 0,X
      MOVB  [D,X], 1,+X
      MOVB  [D,X], 8,-X
      MOVB  [D,X], 1,X+
      MOVB  [D,X], 8,X-
      MOVB  [D,X], 0,Y
      MOVB  [D,X], 1,+Y
      MOVB  [D,X], 8,-Y
      MOVB  [D,X], 1,Y+
      MOVB  [D,X], 8,Y-
      MOVB  [D,X], 0,SP
      MOVB  [D,X], 1,+SP
      MOVB  [D,X], 8,-SP
      MOVB  [D,X], 1,SP+
      MOVB  [D,X], 8,SP-
      MOVB  [D,X], $67C2,PC
      MOVB  [D,X], $E1,X
      MOVB  [D,X], $E3E4,X
      MOVB  [D,X], [$E4E5,X]
      MOVB  [D,X], A,X
      MOVB  [D,X], B,X
      MOVB  [D,X], D,X
      MOVB  [D,X], [D,X]
      MOVB  $E9,Y, $EBEC,Y
      MOVB  $E9,Y, [$ECED,Y]
      MOVB  $E9,Y, A,Y
      MOVB  $E9,Y, B,Y
      MOVB  $E9,Y, D,Y
      MOVB  $E9,Y, [D,Y]
      MOVB  $F1,Y, $F3F4,SP
      MOVB  $F1,Y, [$F4F5,SP]
      MOVB  $F1,Y, A,SP
      MOVB  $F1,Y, B,SP
      MOVB  $F1,Y, D,SP
      MOVB  $F1,Y, [D,SP]
      MOVB  $F8,Y, <$6827,PC
      MOVB  $F9,Y, $6430,PC
      MOVB  $F9,Y, >$673B,PC
      MOVB  $F9,Y, [$653F,PC]
      MOVB  $F9,Y, A,PC
      MOVB  $F9,Y, B,PC
      MOVB  $F9,Y, D,PC
      MOVB  $F9,Y, [D,PC]
      MOVB  $F9,Y, 1,+X
      MOVB  $F9,Y, 8,-X
      MOVB  $F9,Y, 1,X+
      MOVB  $F9,Y, 8,X-
      MOVB  $F9,Y, 1,+Y
      MOVB  $F9,Y, 8,-Y
      MOVB  $F9,Y, 1,Y+
      MOVB  $F9,Y, 8,Y-
      MOVB  $F9,Y, 1,+SP
      MOVB  $F9,Y, 8,-SP
      MOVB  $F9,Y, 1,SP+
      MOVB  $F9,Y, 8,SP-
      MOVB  $EBEC,Y, B,Y
      MOVB  $EBEC,Y, D,Y
      MOVB  $EBEC,Y, [D,Y]
      MOVB  $EBF1,Y, $F3F4,SP
      MOVB  $EBF1,Y, [$F4F5,SP]
      MOVB  $EBF1,Y, A,SP
      MOVB  $EBF1,Y, B,SP
      MOVB  $EBF1,Y, D,SP
      MOVB  $EBF1,Y, [D,SP]
      MOVB  $EBF8,Y, <$68CD,PC
      MOVB  $EBF9,Y, $64D7,PC
      MOVB  $EBF9,Y, >$67E3,PC
      MOVB  $EBF9,Y, [$65E8,PC]
      MOVB  $EBF9,Y, A,PC
      MOVB  $EBF9,Y, B,PC
      MOVB  $EBF9,Y, D,PC
      MOVB  $EBF9,Y, [D,PC]
      MOVB  [$ECED,Y], D,Y
      MOVB  [$ECED,Y], [D,Y]
      MOVB  [$ECED,Y], $F1,SP
      MOVB  [$ECED,Y], $F3F4,SP
      MOVB  [$ECED,Y], [$F4F5,SP]
      MOVB  [$ECED,Y], A,SP
      MOVB  [$ECED,Y], B,SP
      MOVB  [$ECED,Y], D,SP
      MOVB  [$ECED,Y], [D,SP]
      MOVB  [$ECED,Y], $6A3E,PC
      MOVB  [$ECED,Y], <$694C,PC
      MOVB  [$ECED,Y], $6550,PC
      MOVB  [$ECED,Y], >$685C,PC
      MOVB  [$ECED,Y], [$6661,PC]
      MOVB  [$ECED,Y], A,PC
      MOVB  [$ECED,Y], B,PC
      MOVB  [$ECED,Y], D,PC
      MOVB  [$ECED,Y], [D,PC]
      MOVB  [$ECED,Y], 0,X
      MOVB  [$ECED,Y], 1,+X
      MOVB  [$ECED,Y], 8,-X
      MOVB  [$ECED,Y], 1,X+
      MOVB  [$ECED,Y], 8,X-
      MOVB  [$ECED,Y], 0,Y
      MOVB  [$ECED,Y], 1,+Y
      MOVB  [$ECED,Y], 8,-Y
      MOVB  [$ECED,Y], 1,Y+
      MOVB  [$ECED,Y], 8,Y-
      MOVB  [$ECED,Y], 0,SP
      MOVB  [$ECED,Y], 1,+SP
      MOVB  [$ECED,Y], 8,-SP
      MOVB  [$ECED,Y], 1,SP+
      MOVB  [$ECED,Y], 8,SP-
      MOVB  [$ECED,Y], $69DC,PC
      MOVB  [$ECED,Y], $E1,X
      MOVB  [$ECED,Y], $E3E4,X
      MOVB  [$ECED,Y], [$E4E5,X]
      MOVB  [$ECED,Y], A,X
      MOVB  [$ECED,Y], B,X
      MOVB  [$ECED,Y], D,X
      MOVB  [$ECED,Y], [D,X]
      MOVB  [$ECED,Y], $E9,Y
      MOVB  [$ECED,Y], $EBEC,Y
      MOVB  [$ECED,Y], [$ECED,Y]
      MOVB  [$ECED,Y], A,Y
      MOVB  [$ECED,Y], B,Y
      MOVB  A,Y, B,Y
      MOVB  A,Y, D,Y
      MOVB  A,Y, [D,Y]
      MOVB  A,Y, $F1,SP
      MOVB  A,Y, $F3F4,SP
      MOVB  A,Y, [$F4F5,SP]
      MOVB  A,Y, A,SP
      MOVB  A,Y, B,SP
      MOVB  A,Y, D,SP
      MOVB  A,Y, [D,SP]
      MOVB  A,Y, $6B59,PC
      MOVB  A,Y, <$6A65,PC
      MOVB  A,Y, $6667,PC
      MOVB  A,Y, >$6971,PC
      MOVB  A,Y, [$6774,PC]
      MOVB  A,Y, A,PC
      MOVB  A,Y, B,PC
      MOVB  A,Y, D,PC
      MOVB  A,Y, [D,PC]
      MOVB  A,Y, 0,X
      MOVB  A,Y, 1,+X
      MOVB  A,Y, 8,-X
      MOVB  A,Y, 1,X+
      MOVB  A,Y, 8,X-
      MOVB  A,Y, 0,Y
      MOVB  A,Y, 1,+Y
      MOVB  A,Y, 8,-Y
      MOVB  A,Y, 1,Y+
      MOVB  A,Y, 8,Y-
      MOVB  A,Y, 0,SP
      MOVB  A,Y, 1,+SP
      MOVB  A,Y, 8,-SP
      MOVB  A,Y, 1,SP+
      MOVB  A,Y, 8,SP-
      MOVB  A,Y, $6AC7,PC
      MOVB  A,Y, $E1,X
      MOVB  A,Y, $E3E4,X
      MOVB  A,Y, [$E4E5,X]
      MOVB  A,Y, A,X
      MOVB  A,Y, B,X
      MOVB  A,Y, D,X
      MOVB  A,Y, [D,X]
      MOVB  A,Y, $E9,Y
      MOVB  A,Y, $EBEC,Y
      MOVB  A,Y, [$ECED,Y]
      MOVB  A,Y, A,Y
      MOVB  B,Y, D,Y
      MOVB  B,Y, [D,Y]
      MOVB  B,Y, $F1,SP
      MOVB  B,Y, $F3F4,SP
      MOVB  B,Y, [$F4F5,SP]
      MOVB  B,Y, A,SP
      MOVB  B,Y, B,SP
      MOVB  B,Y, D,SP
      MOVB  B,Y, [D,SP]
      MOVB  B,Y, $6C24,PC
      MOVB  B,Y, <$6B30,PC
      MOVB  B,Y, $6732,PC
      MOVB  B,Y, >$6A3C,PC
      MOVB  B,Y, [$683F,PC]
      MOVB  B,Y, A,PC
      MOVB  B,Y, B,PC
      MOVB  B,Y, D,PC
      MOVB  B,Y, [D,PC]
      MOVB  B,Y, 0,X
      MOVB  B,Y, 1,+X
      MOVB  B,Y, 8,-X
      MOVB  B,Y, 1,X+
      MOVB  B,Y, 8,X-
      MOVB  B,Y, 0,Y
      MOVB  B,Y, 1,+Y
      MOVB  B,Y, 8,-Y
      MOVB  B,Y, 1,Y+
      MOVB  B,Y, 8,Y-
      MOVB  B,Y, 0,SP
      MOVB  B,Y, 1,+SP
      MOVB  B,Y, 8,-SP
      MOVB  B,Y, 1,SP+
      MOVB  B,Y, 8,SP-
      MOVB  B,Y, $6B92,PC
      MOVB  B,Y, $E1,X
      MOVB  B,Y, $E3E4,X
      MOVB  B,Y, [$E4E5,X]
      MOVB  B,Y, A,X
      MOVB  B,Y, B,X
      MOVB  B,Y, D,X
      MOVB  B,Y, [D,X]
      MOVB  B,Y, $E9,Y
      MOVB  B,Y, $EBEC,Y
      MOVB  B,Y, [$ECED,Y]
      MOVB  B,Y, A,Y
      MOVB  B,Y, B,Y
      MOVB  D,Y, [D,Y]
      MOVB  D,Y, $F1,SP
      MOVB  D,Y, $F3F4,SP
      MOVB  D,Y, [$F4F5,SP]
      MOVB  D,Y, A,SP
      MOVB  D,Y, B,SP
      MOVB  D,Y, D,SP
      MOVB  D,Y, [D,SP]
      MOVB  D,Y, $6CEF,PC
      MOVB  D,Y, <$6BFB,PC
      MOVB  D,Y, $67FD,PC
      MOVB  D,Y, >$6B07,PC
      MOVB  D,Y, [$690A,PC]
      MOVB  D,Y, A,PC
      MOVB  D,Y, B,PC
      MOVB  D,Y, D,PC
      MOVB  D,Y, [D,PC]
      MOVB  D,Y, 0,X
      MOVB  D,Y, 1,+X
      MOVB  D,Y, 8,-X
      MOVB  D,Y, 1,X+
      MOVB  D,Y, 8,X-
      MOVB  D,Y, 0,Y
      MOVB  D,Y, 1,+Y
      MOVB  D,Y, 8,-Y
      MOVB  D,Y, 1,Y+
      MOVB  D,Y, 8,Y-
      MOVB  D,Y, 0,SP
      MOVB  D,Y, 1,+SP
      MOVB  D,Y, 8,-SP
      MOVB  D,Y, 1,SP+
      MOVB  D,Y, 8,SP-
      MOVB  D,Y, $6C5D,PC
      MOVB  D,Y, $E1,X
      MOVB  D,Y, $E3E4,X
      MOVB  D,Y, [$E4E5,X]
      MOVB  D,Y, A,X
      MOVB  D,Y, B,X
      MOVB  D,Y, D,X
      MOVB  D,Y, [D,X]
      MOVB  D,Y, $E9,Y
      MOVB  D,Y, $EBEC,Y
      MOVB  D,Y, [$ECED,Y]
      MOVB  D,Y, A,Y
      MOVB  D,Y, B,Y
      MOVB  D,Y, D,Y
      MOVB  [D,Y], $F1,SP
      MOVB  [D,Y], $F3F4,SP
      MOVB  [D,Y], [$F4F5,SP]
      MOVB  [D,Y], A,SP
      MOVB  [D,Y], B,SP
      MOVB  [D,Y], D,SP
      MOVB  [D,Y], [D,SP]
      MOVB  [D,Y], $6DBA,PC
      MOVB  [D,Y], <$6CC6,PC
      MOVB  [D,Y], $68C8,PC
      MOVB  [D,Y], >$6BD2,PC
      MOVB  [D,Y], [$69D5,PC]
      MOVB  [D,Y], A,PC
      MOVB  [D,Y], B,PC
      MOVB  [D,Y], D,PC
      MOVB  [D,Y], [D,PC]
      MOVB  [D,Y], 0,X
      MOVB  [D,Y], 1,+X
      MOVB  [D,Y], 8,-X
      MOVB  [D,Y], 1,X+
      MOVB  [D,Y], 8,X-
      MOVB  [D,Y], 0,Y
      MOVB  [D,Y], 1,+Y
      MOVB  [D,Y], 8,-Y
      MOVB  [D,Y], 1,Y+
      MOVB  [D,Y], 8,Y-
      MOVB  [D,Y], 0,SP
      MOVB  [D,Y], 1,+SP
      MOVB  [D,Y], 8,-SP
      MOVB  [D,Y], 1,SP+
      MOVB  [D,Y], 8,SP-
      MOVB  [D,Y], $6D28,PC
      MOVB  [D,Y], $E1,X
      MOVB  [D,Y], $E3E4,X
      MOVB  [D,Y], [$E4E5,X]
      MOVB  [D,Y], A,X
      MOVB  [D,Y], B,X
      MOVB  [D,Y], D,X
      MOVB  [D,Y], [D,X]
      MOVB  [D,Y], $E9,Y
      MOVB  [D,Y], $EBEC,Y
      MOVB  [D,Y], [$ECED,Y]
      MOVB  [D,Y], A,Y
      MOVB  [D,Y], B,Y
      MOVB  [D,Y], D,Y
      MOVB  [D,Y], [D,Y]
      MOVB  $F1,SP, $F3F4,SP
      MOVB  $F1,SP, [$F4F5,SP]
      MOVB  $F1,SP, A,SP
      MOVB  $F1,SP, B,SP
      MOVB  $F1,SP, D,SP
      MOVB  $F1,SP, [D,SP]
      MOVB  $F8,SP, <$6D8C,PC
      MOVB  $F9,SP, $6995,PC
      MOVB  $F9,SP, >$6CA0,PC
      MOVB  $F9,SP, [$6AA4,PC]
      MOVB  $F9,SP, A,PC
      MOVB  $F9,SP, B,PC
      MOVB  $F9,SP, D,PC
      MOVB  $F9,SP, [D,PC]
      MOVB  $F9,SP, 1,+X
      MOVB  $F9,SP, 8,-X
      MOVB  $F9,SP, 1,X+
      MOVB  $F9,SP, 8,X-
      MOVB  $F9,SP, 1,+Y
      MOVB  $F9,SP, 8,-Y
      MOVB  $F9,SP, 1,Y+
      MOVB  $F9,SP, 8,Y-
      MOVB  $F9,SP, 1,+SP
      MOVB  $F9,SP, 8,-SP
      MOVB  $F9,SP, 1,SP+
      MOVB  $F9,SP, 8,SP-
      MOVB  $F3F4,SP, B,SP
      MOVB  $F3F4,SP, D,SP
      MOVB  $F3F4,SP, [D,SP]
      MOVB  $F3F8,SP, <$6E0A,PC
      MOVB  $F3F9,SP, $6A14,PC
      MOVB  $F3F9,SP, >$6D20,PC
      MOVB  $F3F9,SP, [$6B25,PC]
      MOVB  $F3F9,SP, A,PC
      MOVB  $F3F9,SP, B,PC
      MOVB  $F3F9,SP, D,PC
      MOVB  $F3F9,SP, [D,PC]
      MOVB  [$F4F5,SP], D,SP
      MOVB  [$F4F5,SP], [D,SP]
      MOVB  [$F4F5,SP], $6F4C,PC
      MOVB  [$F4F5,SP], <$6E5A,PC
      MOVB  [$F4F5,SP], $6A5E,PC
      MOVB  [$F4F5,SP], >$6D6A,PC
      MOVB  [$F4F5,SP], [$6B6F,PC]
      MOVB  [$F4F5,SP], A,PC
      MOVB  [$F4F5,SP], B,PC
      MOVB  [$F4F5,SP], D,PC
      MOVB  [$F4F5,SP], [D,PC]
      MOVB  [$F4F5,SP], 0,X
      MOVB  [$F4F5,SP], 1,+X
      MOVB  [$F4F5,SP], 8,-X
      MOVB  [$F4F5,SP], 1,X+
      MOVB  [$F4F5,SP], 8,X-
      MOVB  [$F4F5,SP], 0,Y
      MOVB  [$F4F5,SP], 1,+Y
      MOVB  [$F4F5,SP], 8,-Y
      MOVB  [$F4F5,SP], 1,Y+
      MOVB  [$F4F5,SP], 8,Y-
      MOVB  [$F4F5,SP], 0,SP
      MOVB  [$F4F5,SP], 1,+SP
      MOVB  [$F4F5,SP], 8,-SP
      MOVB  [$F4F5,SP], 1,SP+
      MOVB  [$F4F5,SP], 8,SP-
      MOVB  [$F4F5,SP], $6EEA,PC
      MOVB  [$F4F5,SP], $E1,X
      MOVB  [$F4F5,SP], $E3E4,X
      MOVB  [$F4F5,SP], [$E4E5,X]
      MOVB  [$F4F5,SP], A,X
      MOVB  [$F4F5,SP], B,X
      MOVB  [$F4F5,SP], D,X
      MOVB  [$F4F5,SP], [D,X]
      MOVB  [$F4F5,SP], $E9,Y
      MOVB  [$F4F5,SP], $EBEC,Y
      MOVB  [$F4F5,SP], [$ECED,Y]
      MOVB  [$F4F5,SP], A,Y
      MOVB  [$F4F5,SP], B,Y
      MOVB  [$F4F5,SP], D,Y
      MOVB  [$F4F5,SP], [D,Y]
      MOVB  [$F4F5,SP], $F1,SP
      MOVB  [$F4F5,SP], $F3F4,SP
      MOVB  [$F4F5,SP], [$F4F5,SP]
      MOVB  [$F4F5,SP], A,SP
      MOVB  [$F4F5,SP], B,SP
      MOVB  A,SP, B,SP
      MOVB  A,SP, D,SP
      MOVB  A,SP, [D,SP]
      MOVB  A,SP, $7075,PC
      MOVB  A,SP, <$6F81,PC
      MOVB  A,SP, $6B83,PC
      MOVB  A,SP, >$6E8D,PC
      MOVB  A,SP, [$6C90,PC]
      MOVB  A,SP, A,PC
      MOVB  A,SP, B,PC
      MOVB  A,SP, D,PC
      MOVB  A,SP, [D,PC]
      MOVB  A,SP, 0,X
      MOVB  A,SP, 1,+X
      MOVB  A,SP, 8,-X
      MOVB  A,SP, 1,X+
      MOVB  A,SP, 8,X-
      MOVB  A,SP, 0,Y
      MOVB  A,SP, 1,+Y
      MOVB  A,SP, 8,-Y
      MOVB  A,SP, 1,Y+
      MOVB  A,SP, 8,Y-
      MOVB  A,SP, 0,SP
      MOVB  A,SP, 1,+SP
      MOVB  A,SP, 8,-SP
      MOVB  A,SP, 1,SP+
      MOVB  A,SP, 8,SP-
      MOVB  A,SP, $6FE3,PC
      MOVB  A,SP, $E1,X
      MOVB  A,SP, $E3E4,X
      MOVB  A,SP, [$E4E5,X]
      MOVB  A,SP, A,X
      MOVB  A,SP, B,X
      MOVB  A,SP, D,X
      MOVB  A,SP, [D,X]
      MOVB  A,SP, $E9,Y
      MOVB  A,SP, $EBEC,Y
      MOVB  A,SP, [$ECED,Y]
      MOVB  A,SP, A,Y
      MOVB  A,SP, B,Y
      MOVB  A,SP, D,Y
      MOVB  A,SP, [D,Y]
      MOVB  A,SP, $F1,SP
      MOVB  A,SP, $F3F4,SP
      MOVB  A,SP, [$F4F5,SP]
      MOVB  A,SP, A,SP
      MOVB  B,SP, D,SP
      MOVB  B,SP, [D,SP]
      MOVB  B,SP, $7140,PC
      MOVB  B,SP, <$704C,PC
      MOVB  B,SP, $6C4E,PC
      MOVB  B,SP, >$6F58,PC
      MOVB  B,SP, [$6D5B,PC]
      MOVB  B,SP, A,PC
      MOVB  B,SP, B,PC
      MOVB  B,SP, D,PC
      MOVB  B,SP, [D,PC]
      MOVB  B,SP, 0,X
      MOVB  B,SP, 1,+X
      MOVB  B,SP, 8,-X
      MOVB  B,SP, 1,X+
      MOVB  B,SP, 8,X-
      MOVB  B,SP, 0,Y
      MOVB  B,SP, 1,+Y
      MOVB  B,SP, 8,-Y
      MOVB  B,SP, 1,Y+
      MOVB  B,SP, 8,Y-
      MOVB  B,SP, 0,SP
      MOVB  B,SP, 1,+SP
      MOVB  B,SP, 8,-SP
      MOVB  B,SP, 1,SP+
      MOVB  B,SP, 8,SP-
      MOVB  B,SP, $70AE,PC
      MOVB  B,SP, $E1,X
      MOVB  B,SP, $E3E4,X
      MOVB  B,SP, [$E4E5,X]
      MOVB  B,SP, A,X
      MOVB  B,SP, B,X
      MOVB  B,SP, D,X
      MOVB  B,SP, [D,X]
      MOVB  B,SP, $E9,Y
      MOVB  B,SP, $EBEC,Y
      MOVB  B,SP, [$ECED,Y]
      MOVB  B,SP, A,Y
      MOVB  B,SP, B,Y
      MOVB  B,SP, D,Y
      MOVB  B,SP, [D,Y]
      MOVB  B,SP, $F1,SP
      MOVB  B,SP, $F3F4,SP
      MOVB  B,SP, [$F4F5,SP]
      MOVB  B,SP, A,SP
      MOVB  B,SP, B,SP
      MOVB  D,SP, [D,SP]
      MOVB  D,SP, $720B,PC
      MOVB  D,SP, <$7117,PC
      MOVB  D,SP, $6D19,PC
      MOVB  D,SP, >$7023,PC
      MOVB  D,SP, [$6E26,PC]
      MOVB  D,SP, A,PC
      MOVB  D,SP, B,PC
      MOVB  D,SP, D,PC
      MOVB  D,SP, [D,PC]
      MOVB  D,SP, 0,X
      MOVB  D,SP, 1,+X
      MOVB  D,SP, 8,-X
      MOVB  D,SP, 1,X+
      MOVB  D,SP, 8,X-
      MOVB  D,SP, 0,Y
      MOVB  D,SP, 1,+Y
      MOVB  D,SP, 8,-Y
      MOVB  D,SP, 1,Y+
      MOVB  D,SP, 8,Y-
      MOVB  D,SP, 0,SP
      MOVB  D,SP, 1,+SP
      MOVB  D,SP, 8,-SP
      MOVB  D,SP, 1,SP+
      MOVB  D,SP, 8,SP-
      MOVB  D,SP, $7179,PC
      MOVB  D,SP, $E1,X
      MOVB  D,SP, $E3E4,X
      MOVB  D,SP, [$E4E5,X]
      MOVB  D,SP, A,X
      MOVB  D,SP, B,X
      MOVB  D,SP, D,X
      MOVB  D,SP, [D,X]
      MOVB  D,SP, $E9,Y
      MOVB  D,SP, $EBEC,Y
      MOVB  D,SP, [$ECED,Y]
      MOVB  D,SP, A,Y
      MOVB  D,SP, B,Y
      MOVB  D,SP, D,Y
      MOVB  D,SP, [D,Y]
      MOVB  D,SP, $F1,SP
      MOVB  D,SP, $F3F4,SP
      MOVB  D,SP, [$F4F5,SP]
      MOVB  D,SP, A,SP
      MOVB  D,SP, B,SP
      MOVB  D,SP, D,SP
      MOVB  [D,SP], $72D6,PC
      MOVB  [D,SP], <$71E2,PC
      MOVB  [D,SP], $6DE4,PC
      MOVB  [D,SP], >$70EE,PC
      MOVB  [D,SP], [$6EF1,PC]
      MOVB  [D,SP], A,PC
      MOVB  [D,SP], B,PC
      MOVB  [D,SP], D,PC
      MOVB  [D,SP], [D,PC]
      MOVB  [D,SP], 0,X
      MOVB  [D,SP], 1,+X
      MOVB  [D,SP], 8,-X
      MOVB  [D,SP], 1,X+
      MOVB  [D,SP], 8,X-
      MOVB  [D,SP], 0,Y
      MOVB  [D,SP], 1,+Y
      MOVB  [D,SP], 8,-Y
      MOVB  [D,SP], 1,Y+
      MOVB  [D,SP], 8,Y-
      MOVB  [D,SP], 0,SP
      MOVB  [D,SP], 1,+SP
      MOVB  [D,SP], 8,-SP
      MOVB  [D,SP], 1,SP+
      MOVB  [D,SP], 8,SP-
      MOVB  [D,SP], $7244,PC
      MOVB  [D,SP], $E1,X
      MOVB  [D,SP], $E3E4,X
      MOVB  [D,SP], [$E4E5,X]
      MOVB  [D,SP], A,X
      MOVB  [D,SP], B,X
      MOVB  [D,SP], D,X
      MOVB  [D,SP], [D,X]
      MOVB  [D,SP], $E9,Y
      MOVB  [D,SP], $EBEC,Y
      MOVB  [D,SP], [$ECED,Y]
      MOVB  [D,SP], A,Y
      MOVB  [D,SP], B,Y
      MOVB  [D,SP], D,Y
      MOVB  [D,SP], [D,Y]
      MOVB  [D,SP], $F1,SP
      MOVB  [D,SP], $F3F4,SP
      MOVB  [D,SP], [$F4F5,SP]
      MOVB  [D,SP], A,SP
      MOVB  [D,SP], B,SP
      MOVB  [D,SP], D,SP
      MOVB  [D,SP], [D,SP]
      MOVB  $73A5,PC, $6EAA,PC
      MOVB  $73AC,PC, >$71B5,PC
      MOVB  $73B3,PC, [$6FB9,PC]
      MOVB  $73BA,PC, A,PC
      MOVB  $73BF,PC, B,PC
      MOVB  $73C4,PC, D,PC
      MOVB  $73C9,PC, [D,PC]
      MOVB  $73CE,PC, 1,+X
      MOVB  $73D3,PC, 8,-X
      MOVB  $73D8,PC, 1,X+
      MOVB  $73DD,PC, 8,X-
      MOVB  $73E2,PC, 1,+Y
      MOVB  $73E7,PC, 8,-Y
      MOVB  $73EC,PC, 1,Y+
      MOVB  $73F1,PC, 8,Y-
      MOVB  $73F6,PC, 1,+SP
      MOVB  $73FB,PC, 8,-SP
      MOVB  $7400,PC, 1,SP+
      MOVB  $7405,PC, 8,SP-
      MOVB  <$7311,PC, 1,X
      MOVB  <$7316,PC, 1,+X
      MOVB  <$731B,PC, 8,-X
      MOVB  <$7320,PC, 1,X+
      MOVB  <$7325,PC, 8,X-
      MOVB  <$732A,PC, 0,Y
      MOVB  <$732F,PC, 1,+Y
      MOVB  <$7334,PC, 8,-Y
      MOVB  <$7339,PC, 1,Y+
      MOVB  <$733E,PC, 8,Y-
      MOVB  <$7343,PC, 0,SP
      MOVB  <$7348,PC, 1,+SP
      MOVB  <$734D,PC, 8,-SP
      MOVB  <$7352,PC, 1,SP+
      MOVB  <$7357,PC, 8,SP-
      MOVB  <$735C,PC, $735C,PC
      MOVB  <$7361,PC, $E1,X
      MOVB  <$7367,PC, $E3E4,X
      MOVB  <$736E,PC, [$E4E5,X]
      MOVB  <$7375,PC, A,X
      MOVB  <$737A,PC, B,X
      MOVB  <$737F,PC, D,X
      MOVB  <$7384,PC, [D,X]
      MOVB  <$7389,PC, $E9,Y
      MOVB  <$738F,PC, $EBEC,Y
      MOVB  <$7396,PC, [$ECED,Y]
      MOVB  <$739D,PC, A,Y
      MOVB  <$73A2,PC, B,Y
      MOVB  <$73A7,PC, D,Y
      MOVB  <$73AC,PC, [D,Y]
      MOVB  <$73B1,PC, $F1,SP
      MOVB  <$73B7,PC, $F3F4,SP
      MOVB  <$73BE,PC, [$F4F5,SP]
      MOVB  <$73C5,PC, A,SP
      MOVB  <$73CA,PC, B,SP
      MOVB  <$73CF,PC, D,SP
      MOVB  <$73D4,PC, [D,SP]
      MOVB  <$73D9,PC, $74D3,PC
      MOVB  <$73DF,PC, <$73E0,PC
      MOVB  <$73E5,PC, $6FE3,PC
      MOVB  <$73EC,PC, >$72EE,PC
      MOVB  <$73F3,PC, [$70F2,PC]
      MOVB  <$73FA,PC, A,PC
      MOVB  <$73FF,PC, B,PC
      MOVB  <$7404,PC, D,PC
      MOVB  <$7409,PC, [D,PC]
      MOVB  $74EF,PC, $E3E4,X
      MOVB  $74F6,PC, [$E4E5,X]
      MOVB  $74FD,PC, A,X
      MOVB  $7502,PC, B,X
      MOVB  $7507,PC, D,X
      MOVB  $750C,PC, [D,X]
      MOVB  $7519,PC, $EBEC,Y
      MOVB  $7520,PC, [$ECED,Y]
      MOVB  $7527,PC, A,Y
      MOVB  $752C,PC, B,Y
      MOVB  $7531,PC, D,Y
      MOVB  $7536,PC, [D,Y]
      MOVB  $7543,PC, $F3F4,SP
      MOVB  $754A,PC, [$F4F5,SP]
      MOVB  $7551,PC, A,SP
      MOVB  $7556,PC, B,SP
      MOVB  $755B,PC, D,SP
      MOVB  $7560,PC, [D,SP]
      MOVB  $756C,PC, <$746F,PC
      MOVB  $7077,PC, B,PC
      MOVB  $707D,PC, D,PC
      MOVB  $7083,PC, [D,PC]
      MOVB  [$718A,PC], D,PC
      MOVB  [$7190,PC], [D,PC]
      MOVB  [$7196,PC], 0,X
      MOVB  [$719C,PC], 1,+X
      MOVB  [$71A2,PC], 8,-X
      MOVB  [$71A8,PC], 1,X+
      MOVB  [$71AE,PC], 8,X-
      MOVB  [$71B4,PC], 0,Y
      MOVB  [$71BA,PC], 1,+Y
      MOVB  [$71C0,PC], 8,-Y
      MOVB  [$71C6,PC], 1,Y+
      MOVB  [$71CC,PC], 8,Y-
      MOVB  [$71D2,PC], 0,SP
      MOVB  [$71D8,PC], 1,+SP
      MOVB  [$71DE,PC], 8,-SP
      MOVB  [$71E4,PC], 1,SP+
      MOVB  [$71EA,PC], 8,SP-
      MOVB  [$71F0,PC], $74F3,PC
      MOVB  [$71F6,PC], $E1,X
      MOVB  [$71FD,PC], $E3E4,X
      MOVB  [$7205,PC], [$E4E5,X]
      MOVB  [$720D,PC], A,X
      MOVB  [$7213,PC], B,X
      MOVB  [$7219,PC], D,X
      MOVB  [$721F,PC], [D,X]
      MOVB  [$7225,PC], $E9,Y
      MOVB  [$722C,PC], $EBEC,Y
      MOVB  [$7234,PC], [$ECED,Y]
      MOVB  [$723C,PC], A,Y
      MOVB  [$7242,PC], B,Y
      MOVB  [$7248,PC], D,Y
      MOVB  [$724E,PC], [D,Y]
      MOVB  [$7254,PC], $F1,SP
      MOVB  [$725B,PC], $F3F4,SP
      MOVB  [$7263,PC], [$F4F5,SP]
      MOVB  [$726B,PC], A,SP
      MOVB  [$7271,PC], B,SP
      MOVB  [$7277,PC], D,SP
      MOVB  [$727D,PC], [D,SP]
      MOVB  [$7283,PC], $7680,PC
      MOVB  [$728A,PC], <$758E,PC
      MOVB  [$7291,PC], $7192,PC
      MOVB  [$7299,PC], >$749E,PC
      MOVB  [$72A1,PC], [$72A3,PC]
      MOVB  [$72A9,PC], A,PC
      MOVB  [$72AF,PC], B,PC
      MOVB  A,PC, B,PC
      MOVB  A,PC, D,PC
      MOVB  A,PC, [D,PC]
      MOVB  A,PC, 0,X
      MOVB  A,PC, 1,+X
      MOVB  A,PC, 8,-X
      MOVB  A,PC, 1,X+
      MOVB  A,PC, 8,X-
      MOVB  A,PC, 0,Y
      MOVB  A,PC, 1,+Y
      MOVB  A,PC, 8,-Y
      MOVB  A,PC, 1,Y+
      MOVB  A,PC, 8,Y-
      MOVB  A,PC, 0,SP
      MOVB  A,PC, 1,+SP
      MOVB  A,PC, 8,-SP
      MOVB  A,PC, 1,SP+
      MOVB  A,PC, 8,SP-
      MOVB  A,PC, $75FE,PC
      MOVB  A,PC, $E1,X
      MOVB  A,PC, $E3E4,X
      MOVB  A,PC, [$E4E5,X]
      MOVB  A,PC, A,X
      MOVB  A,PC, B,X
      MOVB  A,PC, D,X
      MOVB  A,PC, [D,X]
      MOVB  A,PC, $E9,Y
      MOVB  A,PC, $EBEC,Y
      MOVB  A,PC, [$ECED,Y]
      MOVB  A,PC, A,Y
      MOVB  A,PC, B,Y
      MOVB  A,PC, D,Y
      MOVB  A,PC, [D,Y]
      MOVB  A,PC, $F1,SP
      MOVB  A,PC, $F3F4,SP
      MOVB  A,PC, [$F4F5,SP]
      MOVB  A,PC, A,SP
      MOVB  A,PC, B,SP
      MOVB  A,PC, D,SP
      MOVB  A,PC, [D,SP]
      MOVB  A,PC, $775F,PC
      MOVB  A,PC, <$766B,PC
      MOVB  A,PC, $726D,PC
      MOVB  A,PC, >$7577,PC
      MOVB  A,PC, [$737A,PC]
      MOVB  A,PC, A,PC
      MOVB  B,PC, D,PC
      MOVB  B,PC, [D,PC]
      MOVB  B,PC, 0,X
      MOVB  B,PC, 1,+X
      MOVB  B,PC, 8,-X
      MOVB  B,PC, 1,X+
      MOVB  B,PC, 8,X-
      MOVB  B,PC, 0,Y
      MOVB  B,PC, 1,+Y
      MOVB  B,PC, 8,-Y
      MOVB  B,PC, 1,Y+
      MOVB  B,PC, 8,Y-
      MOVB  B,PC, 0,SP
      MOVB  B,PC, 1,+SP
      MOVB  B,PC, 8,-SP
      MOVB  B,PC, 1,SP+
      MOVB  B,PC, 8,SP-
      MOVB  B,PC, $76C9,PC
      MOVB  B,PC, $E1,X
      MOVB  B,PC, $E3E4,X
      MOVB  B,PC, [$E4E5,X]
      MOVB  B,PC, A,X
      MOVB  B,PC, B,X
      MOVB  B,PC, D,X
      MOVB  B,PC, [D,X]
      MOVB  B,PC, $E9,Y
      MOVB  B,PC, $EBEC,Y
      MOVB  B,PC, [$ECED,Y]
      MOVB  B,PC, A,Y
      MOVB  B,PC, B,Y
      MOVB  B,PC, D,Y
      MOVB  B,PC, [D,Y]
      MOVB  B,PC, $F1,SP
      MOVB  B,PC, $F3F4,SP
      MOVB  B,PC, [$F4F5,SP]
      MOVB  B,PC, A,SP
      MOVB  B,PC, B,SP
      MOVB  B,PC, D,SP
      MOVB  B,PC, [D,SP]
      MOVB  B,PC, $782A,PC
      MOVB  B,PC, <$7736,PC
      MOVB  B,PC, $7338,PC
      MOVB  B,PC, >$7642,PC
      MOVB  B,PC, [$7445,PC]
      MOVB  B,PC, A,PC
      MOVB  B,PC, B,PC
      MOVB  D,PC, [D,PC]
      MOVB  D,PC, 0,X
      MOVB  D,PC, 1,+X
      MOVB  D,PC, 8,-X
      MOVB  D,PC, 1,X+
      MOVB  D,PC, 8,X-
      MOVB  D,PC, 0,Y
      MOVB  D,PC, 1,+Y
      MOVB  D,PC, 8,-Y
      MOVB  D,PC, 1,Y+
      MOVB  D,PC, 8,Y-
      MOVB  D,PC, 0,SP
      MOVB  D,PC, 1,+SP
      MOVB  D,PC, 8,-SP
      MOVB  D,PC, 1,SP+
      MOVB  D,PC, 8,SP-
      MOVB  D,PC, $7794,PC
      MOVB  D,PC, $E1,X
      MOVB  D,PC, $E3E4,X
      MOVB  D,PC, [$E4E5,X]
      MOVB  D,PC, A,X
      MOVB  D,PC, B,X
      MOVB  D,PC, D,X
      MOVB  D,PC, [D,X]
      MOVB  D,PC, $E9,Y
      MOVB  D,PC, $EBEC,Y
      MOVB  D,PC, [$ECED,Y]
      MOVB  D,PC, A,Y
      MOVB  D,PC, B,Y
      MOVB  D,PC, D,Y
      MOVB  D,PC, [D,Y]
      MOVB  D,PC, $F1,SP
      MOVB  D,PC, $F3F4,SP
      MOVB  D,PC, [$F4F5,SP]
      MOVB  D,PC, A,SP
      MOVB  D,PC, B,SP
      MOVB  D,PC, D,SP
      MOVB  D,PC, [D,SP]
      MOVB  D,PC, $78F5,PC
      MOVB  D,PC, <$7801,PC
      MOVB  D,PC, $7403,PC
      MOVB  D,PC, >$770D,PC
      MOVB  D,PC, [$7510,PC]
      MOVB  D,PC, A,PC
      MOVB  D,PC, B,PC
      MOVB  D,PC, D,PC
      MOVB  [D,PC], 0,X
      MOVB  [D,PC], 1,+X
      MOVB  [D,PC], 8,-X
      MOVB  [D,PC], 1,X+
      MOVB  [D,PC], 8,X-
      MOVB  [D,PC], 0,Y
      MOVB  [D,PC], 1,+Y
      MOVB  [D,PC], 8,-Y
      MOVB  [D,PC], 1,Y+
      MOVB  [D,PC], 8,Y-
      MOVB  [D,PC], 0,SP
      MOVB  [D,PC], 1,+SP
      MOVB  [D,PC], 8,-SP
      MOVB  [D,PC], 1,SP+
      MOVB  [D,PC], 8,SP-
      MOVB  [D,PC], $785F,PC
      MOVB  [D,PC], $E1,X
      MOVB  [D,PC], $E3E4,X
      MOVB  [D,PC], [$E4E5,X]
      MOVB  [D,PC], A,X
      MOVB  [D,PC], B,X
      MOVB  [D,PC], D,X
      MOVB  [D,PC], [D,X]
      MOVB  [D,PC], $E9,Y
      MOVB  [D,PC], $EBEC,Y
      MOVB  [D,PC], [$ECED,Y]
      MOVB  [D,PC], A,Y
      MOVB  [D,PC], B,Y
      MOVB  [D,PC], D,Y
      MOVB  [D,PC], [D,Y]
      MOVB  [D,PC], $F1,SP
      MOVB  [D,PC], $F3F4,SP
      MOVB  [D,PC], [$F4F5,SP]
      MOVB  [D,PC], A,SP
      MOVB  [D,PC], B,SP
      MOVB  [D,PC], D,SP
      MOVB  [D,PC], [D,SP]
      MOVB  [D,PC], $79C0,PC
      MOVB  [D,PC], <$78CC,PC
      MOVB  [D,PC], $74CE,PC
      MOVB  [D,PC], >$77D8,PC
      MOVB  [D,PC], [$75DB,PC]
      MOVB  [D,PC], A,PC
      MOVB  [D,PC], B,PC
      MOVB  [D,PC], D,PC
      MOVB  [D,PC], [D,PC]
      MOVB  #12, $0D0E
      MOVB  #12, >$0001
      MOVB  $0D0E, $0F10
      MOVB  $0D0E, >$0001
      MOVB  >$0001, $0203
      MOVB  >$0001, >$0001
      MOVB  14,X, $0F10
      MOVB  14,X, >$0001
      MOVB  1,+X, $2122
      MOVB  1,+X, >$0001
      MOVB  8,-X, $292A
      MOVB  8,-X, >$0001
      MOVB  1,X+, $3132
      MOVB  1,X+, >$0001
      MOVB  8,X-, $393A
      MOVB  8,X-, >$0001
      MOVB  0,Y, $4142
      MOVB  0,Y, >$0001
      MOVB  1,+Y, $6162
      MOVB  1,+Y, >$0001
      MOVB  8,-Y, $696A
      MOVB  8,-Y, >$0001
      MOVB  1,Y+, $7172
      MOVB  1,Y+, >$0001
      MOVB  8,Y-, $797A
      MOVB  8,Y-, >$0001
      MOVB  0,SP, $8182
      MOVB  0,SP, >$0001
      MOVB  1,+SP, $A1A2
      MOVB  1,+SP, >$0001
      MOVB  8,-SP, $A9AA
      MOVB  8,-SP, >$0001
      MOVB  1,SP+, $B1B2
      MOVB  1,SP+, >$0001
      MOVB  8,SP-, $B9BA
      MOVB  8,SP-, >$0001
      MOVB  $79AB,PC, $C1C2
      MOVB  $79B0,PC, >$0001
      MOVB  $E1,X, $E2E3
      MOVB  $E1,X, >$0001
      MOVB  $E3E4,X, $E5E6
      MOVB  $E3E4,X, >$0001
      MOVB  [$E4E5,X], $E6E7
      MOVB  [$E4E5,X], >$0001
      MOVB  A,X, $E5E6
      MOVB  A,X, >$0001
      MOVB  B,X, $E6E7
      MOVB  B,X, >$0001
      MOVB  D,X, $E7E8
      MOVB  D,X, >$0001
      MOVB  [D,X], $E8E9
      MOVB  [D,X], >$0001
      MOVB  $E9,Y, $EAEB
      MOVB  $E9,Y, >$0001
      MOVB  $EBEC,Y, $EDEE
      MOVB  $EBEC,Y, >$0001
      MOVB  [$ECED,Y], $EEEF
      MOVB  [$ECED,Y], >$0001
      MOVB  A,Y, $EDEE
      MOVB  A,Y, >$0001
      MOVB  B,Y, $EEEF
      MOVB  B,Y, >$0001
      MOVB  D,Y, $EFF0
      MOVB  D,Y, >$0001
      MOVB  [D,Y], $F0F1
      MOVB  [D,Y], >$0001
      MOVB  $F1,SP, $F2F3
      MOVB  $F1,SP, >$0001
      MOVB  $F3F4,SP, $F5F6
      MOVB  $F3F4,SP, >$0001
      MOVB  [$F4F5,SP], $F6F7
      MOVB  [$F4F5,SP], >$0001
      MOVB  A,SP, $F5F6
      MOVB  A,SP, >$0001
      MOVB  B,SP, $F6F7
      MOVB  B,SP, >$0001
      MOVB  D,SP, $F7F8
      MOVB  D,SP, >$0001
      MOVB  [D,SP], $F8F9
      MOVB  [D,SP], >$0001
      MOVB  $7B9F,PC, $FAFB
      MOVB  $7BA5,PC, >$0001
      MOVB  <$7AB2,PC, $0102
      MOVB  <$7AB8,PC, >$0001
      MOVB  $76BB,PC, $FDFE
      MOVB  $76C2,PC, >$0001
      MOVB  >$79CD,PC, $0102
      MOVB  >$79D4,PC, >$0001
      MOVB  [$77D8,PC], $FEFF
      MOVB  [$77DF,PC], >$0001
      MOVB  A,PC, $FDFE
      MOVB  A,PC, >$0001
      MOVB  B,PC, $FEFF
      MOVB  B,PC, >$0001
      MOVB  D,PC, $FF00
      MOVB  D,PC, >$0001
      MOVB  [D,PC], >$0001
      MOVB  [D,PC], $0102
      TAB
      TBA
      IDIV
      FDIV
      EMACS $1314
      EMACS >$0001
      EMULS
      EDIVS
      IDIVS
      SBA
      CBA
      MAXA  -7,X
      MAXA  1,+X
      MAXA  8,-X
      MAXA  1,X+
      MAXA  8,X-
      MAXA  0,Y
      MAXA  1,+Y
      MAXA  8,-Y
      MAXA  1,Y+
      MAXA  8,Y-
      MAXA  0,SP
      MAXA  1,+SP
      MAXA  8,-SP
      MAXA  1,SP+
      MAXA  8,SP-
      MAXA  $7B54,PC
      MAXA  $E1,X
      MAXA  $E3E4,X
      MAXA  [$E4E5,X]
      MAXA  A,X
      MAXA  B,X
      MAXA  D,X
      MAXA  [D,X]
      MAXA  $E9,Y
      MAXA  $EBEC,Y
      MAXA  [$ECED,Y]
      MAXA  A,Y
      MAXA  B,Y
      MAXA  D,Y
      MAXA  [D,Y]
      MAXA  $F1,SP
      MAXA  $F3F4,SP
      MAXA  [$F4F5,SP]
      MAXA  A,SP
      MAXA  B,SP
      MAXA  D,SP
      MAXA  [D,SP]
      MAXA  $7C9F,PC
      MAXA  <$7BAA,PC
      MAXA  $77AB,PC
      MAXA  >$7AB4,PC
      MAXA  [$78B6,PC]
      MAXA  A,PC
      MAXA  B,PC
      MAXA  D,PC
      MAXA  [D,PC]
      LEAY  -6,X
      LEAY  1,+X
      LEAY  8,-X
      LEAY  1,X+
      LEAY  8,X-
      LEAY  0,Y
      LEAY  1,+Y
      LEAY  8,-Y
      LEAY  1,Y+
      LEAY  8,Y-
      LEAY  0,SP
      LEAY  1,+SP
      LEAY  8,-SP
      LEAY  1,SP+
      LEAY  8,SP-
      LEAY  $7BE5,PC
      LEAY  $E1,X
      LEAY  $E3E4,X
      LEAY  A,X
      LEAY  B,X
      LEAY  D,X
      LEAY  $E9,Y
      LEAY  $EBEC,Y
      LEAY  A,Y
      LEAY  B,Y
      LEAY  D,Y
      LEAY  $F1,SP
      LEAY  $F3F4,SP
      LEAY  A,SP
      LEAY  B,SP
      LEAY  D,SP
      LEAY  $7D08,PC
      LEAY  <$7C12,PC
      LEAY  $7812,PC
      LEAY  >$7B1A,PC
      LEAY  A,PC
      LEAY  B,PC
      LEAY  D,PC
      LEAX  -5,X
      LEAX  1,+X
      LEAX  8,-X
      LEAX  1,X+
      LEAX  8,X-
      LEAX  0,Y
      LEAX  1,+Y
      LEAX  8,-Y
      LEAX  1,Y+
      LEAX  8,Y-
      LEAX  0,SP
      LEAX  1,+SP
      LEAX  8,-SP
      LEAX  1,SP+
      LEAX  8,SP-
      LEAX  $7C40,PC
      LEAX  $E1,X
      LEAX  $E3E4,X
      LEAX  A,X
      LEAX  B,X
      LEAX  D,X
      LEAX  $E9,Y
      LEAX  $EBEC,Y
      LEAX  A,Y
      LEAX  B,Y
      LEAX  D,Y
      LEAX  $F1,SP
      LEAX  $F3F4,SP
      LEAX  A,SP
      LEAX  B,SP
      LEAX  D,SP
      LEAX  $7D63,PC
      LEAX  <$7C6D,PC
      LEAX  $786D,PC
      LEAX  >$7B75,PC
      LEAX  A,PC
      LEAX  B,PC
      LEAX  D,PC
      LEAS  -4,X
      LEAS  1,+X
      LEAS  8,-X
      LEAS  1,X+
      LEAS  8,X-
      LEAS  0,Y
      LEAS  1,+Y
      LEAS  8,-Y
      LEAS  1,Y+
      LEAS  8,Y-
      LEAS  0,SP
      LEAS  1,+SP
      LEAS  8,-SP
      LEAS  1,SP+
      LEAS  8,SP-
      LEAS  $7C9B,PC
      LEAS  $E1,X
      LEAS  $E3E4,X
      LEAS  A,X
      LEAS  B,X
      LEAS  D,X
      LEAS  $E9,Y
      LEAS  $EBEC,Y
      LEAS  A,Y
      LEAS  B,Y
      LEAS  D,Y
      LEAS  $F1,SP
      LEAS  $F3F4,SP
      LEAS  A,SP
      LEAS  B,SP
      LEAS  D,SP
      LEAS  $7DBE,PC
      LEAS  <$7CC8,PC
      LEAS  $78C8,PC
      LEAS  >$7BD0,PC
      LEAS  A,PC
      LEAS  B,PC
      LEAS  D,PC
      BSET  $1D1E, #31
      BSET  >$0001, #2
      BCLR  $1E1F, #32
      BCLR  >$0001, #2
      BRSET $1F20, #$21, *+39
      BRSET >$0001, #2, *+8
      BRCLR $2021, #$22, *+40
      BRCLR >$0001, #2, *+8
      BRA   *+35
      BRN   *+36
      BHI   *+37
      BLS   *+38
      BCC   *+39
      BCS   *+40
      BNE   *+41
      BEQ   *+42
      BVC   *+43
      BVS   *+44
      BPL   *+45
      BMI   *+46
      BGE   *+47
      BLT   *+48
      BGT   *+49
      BLE   *+50
      PULX
      PULY
      PULA
      PULB
      PSHX
      PSHY
      PSHA
      PSHB
      PULC
      PSHC
      PULD
      PSHD
      RTS
      WAI
      SWI
      NEGA
      COMA
      INCA
      DECA
      LSRA
      ROLA
      RORA
      ASRA
      ASLA
      LSRD
      CALL  $4B4C, $4D
      CALL  >$0001, 2
      CALL  12,Y, $4D
      CALL  1,+Y, $61
      CALL  8,-Y, $69
      CALL  1,Y+, $71
      CALL  8,Y-, $79
      CALL  0,SP, $81
      CALL  1,+SP, $A1
      CALL  8,-SP, $A9
      CALL  1,SP+, $B1
      CALL  8,SP-, $B9
      CALL  $7D5C,PC, $C1
      CALL  $E1,X, $E2
      CALL  $E3E4,X, $E5
      CALL  [$E4E5,X]
      CALL  A,X, $E5
      CALL  B,X, $E6
      CALL  D,X, $E7
      CALL  [D,X]
      CALL  $E9,Y, $EA
      CALL  $EBEC,Y, $ED
      CALL  [$ECED,Y]
      CALL  A,Y, $ED
      CALL  B,Y, $EE
      CALL  D,Y, $EF
      CALL  [D,Y]
      CALL  $F1,SP, $F2
      CALL  $F3F4,SP, $F5
      CALL  [$F4F5,SP]
      CALL  A,SP, $F5
      CALL  B,SP, $F6
      CALL  D,SP, $F7
      CALL  [D,SP]
      CALL  $7EA1,PC, $FA
      CALL  <$7DAC,PC, 1
      CALL  $79AD,PC, $FD
      CALL  >$7CB6,PC, 1
      CALL  [$7AB7,PC]
      CALL  A,PC, $FD
      CALL  B,PC, $FE
      CALL  D,PC, $FF
      CALL  [D,PC]
      CALL  0,X, 1
      CALL  1,+X, $21
      CALL  8,-X, $29
      CALL  1,X+, $31
      CALL  8,X-, $39
      BSET  $4D, #$4E
      BCLR  $4E, #$4F
      BRSET $4F, #$50, *+85
      BRCLR $50, #$51, *+86
      NEGB
      COMB
      INCB
      DECB
      LSRB
      ROLB
      RORB
      ASRB
      ASLB
      ASLD
      STAA  $5B
      STAB  $5C
      STD   $5D
      STY   $5E
      STX   $5F
      STS   $60
      NEG   2,+Y
      NEG   8,-Y
      NEG   1,Y+
      NEG   8,Y-
      NEG   0,SP
      NEG   1,+SP
      NEG   8,-SP
      NEG   1,SP+
      NEG   8,SP-
      NEG   $7E0C,PC
      NEG   $E1,X
      NEG   $E3E4,X
      NEG   [$E4E5,X]
      NEG   A,X
      NEG   B,X
      NEG   D,X
      NEG   [D,X]
      NEG   $E9,Y
      NEG   $EBEC,Y
      NEG   [$ECED,Y]
      NEG   A,Y
      NEG   B,Y
      NEG   D,Y
      NEG   [D,Y]
      NEG   $F1,SP
      NEG   $F3F4,SP
      NEG   [$F4F5,SP]
      NEG   A,SP
      NEG   B,SP
      NEG   D,SP
      NEG   [D,SP]
      NEG   $7F41,PC
      NEG   <$7E4B,PC
      NEG   $7A4B,PC
      NEG   >$7D53,PC
      NEG   [$7B54,PC]
      NEG   A,PC
      NEG   B,PC
      NEG   D,PC
      NEG   [D,PC]
      NEG   0,X
      NEG   1,+X
      NEG   8,-X
      NEG   1,X+
      NEG   8,X-
      NEG   0,Y
      COM   3,+Y
      COM   8,-Y
      COM   1,Y+
      COM   8,Y-
      COM   0,SP
      COM   1,+SP
      COM   8,-SP
      COM   1,SP+
      COM   8,SP-
      COM   $7E7F,PC
      COM   $E1,X
      COM   $E3E4,X
      COM   [$E4E5,X]
      COM   A,X
      COM   B,X
      COM   D,X
      COM   [D,X]
      COM   $E9,Y
      COM   $EBEC,Y
      COM   [$ECED,Y]
      COM   A,Y
      COM   B,Y
      COM   D,Y
      COM   [D,Y]
      COM   $F1,SP
      COM   $F3F4,SP
      COM   [$F4F5,SP]
      COM   A,SP
      COM   B,SP
      COM   D,SP
      COM   [D,SP]
      COM   $7FB4,PC
      COM   <$7EBE,PC
      COM   $7ABE,PC
      COM   >$7DC6,PC
      COM   [$7BC7,PC]
      COM   A,PC
      COM   B,PC
      COM   D,PC
      COM   [D,PC]
      COM   0,X
      COM   1,+X
      COM   8,-X
      COM   1,X+
      COM   8,X-
      COM   0,Y
      INC   4,+Y
      INC   8,-Y
      INC   1,Y+
      INC   8,Y-
      INC   0,SP
      INC   1,+SP
      INC   8,-SP
      INC   1,SP+
      INC   8,SP-
      INC   $7EF2,PC
      INC   $E1,X
      INC   $E3E4,X
      INC   [$E4E5,X]
      INC   A,X
      INC   B,X
      INC   D,X
      INC   [D,X]
      INC   $E9,Y
      INC   $EBEC,Y
      INC   [$ECED,Y]
      INC   A,Y
      INC   B,Y
      INC   D,Y
      INC   [D,Y]
      INC   $F1,SP
      INC   $F3F4,SP
      INC   [$F4F5,SP]
      INC   A,SP
      INC   B,SP
      INC   D,SP
      INC   [D,SP]
      INC   $8027,PC
      INC   <$7F31,PC
      INC   $7B31,PC
      INC   >$7E39,PC
      INC   [$7C3A,PC]
      INC   A,PC
      INC   B,PC
      INC   D,PC
      INC   [D,PC]
      INC   0,X
      INC   1,+X
      INC   8,-X
      INC   1,X+
      INC   8,X-
      INC   0,Y
      DEC   5,+Y
      DEC   8,-Y
      DEC   1,Y+
      DEC   8,Y-
      DEC   0,SP
      DEC   1,+SP
      DEC   8,-SP
      DEC   1,SP+
      DEC   8,SP-
      DEC   $7F65,PC
      DEC   $E1,X
      DEC   $E3E4,X
      DEC   [$E4E5,X]
      DEC   A,X
      DEC   B,X
      DEC   D,X
      DEC   [D,X]
      DEC   $E9,Y
      DEC   $EBEC,Y
      DEC   [$ECED,Y]
      DEC   A,Y
      DEC   B,Y
      DEC   D,Y
      DEC   [D,Y]
      DEC   $F1,SP
      DEC   $F3F4,SP
      DEC   [$F4F5,SP]
      DEC   A,SP
      DEC   B,SP
      DEC   D,SP
      DEC   [D,SP]
      DEC   $809A,PC
      DEC   <$7FA4,PC
      DEC   $7BA4,PC
      DEC   >$7EAC,PC
      DEC   [$7CAD,PC]
      DEC   A,PC
      DEC   B,PC
      DEC   D,PC
      DEC   [D,PC]
      DEC   0,X
      DEC   1,+X
      DEC   8,-X
      DEC   1,X+
      DEC   8,X-
      DEC   0,Y
      LSR   6,+Y
      LSR   8,-Y
      LSR   1,Y+
      LSR   8,Y-
      LSR   0,SP
      LSR   1,+SP
      LSR   8,-SP
      LSR   1,SP+
      LSR   8,SP-
      LSR   $7FD8,PC
      LSR   $E1,X
      LSR   $E3E4,X
      LSR   [$E4E5,X]
      LSR   A,X
      LSR   B,X
      LSR   D,X
      LSR   [D,X]
      LSR   $E9,Y
      LSR   $EBEC,Y
      LSR   [$ECED,Y]
      LSR   A,Y
      LSR   B,Y
      LSR   D,Y
      LSR   [D,Y]
      LSR   $F1,SP
      LSR   $F3F4,SP
      LSR   [$F4F5,SP]
      LSR   A,SP
      LSR   B,SP
      LSR   D,SP
      LSR   [D,SP]
      LSR   $810D,PC
      LSR   <$8017,PC
      LSR   $7C17,PC
      LSR   >$7F1F,PC
      LSR   [$7D20,PC]
      LSR   A,PC
      LSR   B,PC
      LSR   D,PC
      LSR   [D,PC]
      LSR   0,X
      LSR   1,+X
      LSR   8,-X
      LSR   1,X+
      LSR   8,X-
      LSR   0,Y
      ROL   7,+Y
      ROL   8,-Y
      ROL   1,Y+
      ROL   8,Y-
      ROL   0,SP
      ROL   1,+SP
      ROL   8,-SP
      ROL   1,SP+
      ROL   8,SP-
      ROL   $804B,PC
      ROL   $E1,X
      ROL   $E3E4,X
      ROL   [$E4E5,X]
      ROL   A,X
      ROL   B,X
      ROL   D,X
      ROL   [D,X]
      ROL   $E9,Y
      ROL   $EBEC,Y
      ROL   [$ECED,Y]
      ROL   A,Y
      ROL   B,Y
      ROL   D,Y
      ROL   [D,Y]
      ROL   $F1,SP
      ROL   $F3F4,SP
      ROL   [$F4F5,SP]
      ROL   A,SP
      ROL   B,SP
      ROL   D,SP
      ROL   [D,SP]
      ROL   $8180,PC
      ROL   <$808A,PC
      ROL   $7C8A,PC
      ROL   >$7F92,PC
      ROL   [$7D93,PC]
      ROL   A,PC
      ROL   B,PC
      ROL   D,PC
      ROL   [D,PC]
      ROL   0,X
      ROL   1,+X
      ROL   8,-X
      ROL   1,X+
      ROL   8,X-
      ROL   0,Y
      ROR   8,+Y
      ROR   8,-Y
      ROR   1,Y+
      ROR   8,Y-
      ROR   0,SP
      ROR   1,+SP
      ROR   8,-SP
      ROR   1,SP+
      ROR   8,SP-
      ROR   $80BE,PC
      ROR   $E1,X
      ROR   $E3E4,X
      ROR   [$E4E5,X]
      ROR   A,X
      ROR   B,X
      ROR   D,X
      ROR   [D,X]
      ROR   $E9,Y
      ROR   $EBEC,Y
      ROR   [$ECED,Y]
      ROR   A,Y
      ROR   B,Y
      ROR   D,Y
      ROR   [D,Y]
      ROR   $F1,SP
      ROR   $F3F4,SP
      ROR   [$F4F5,SP]
      ROR   A,SP
      ROR   B,SP
      ROR   D,SP
      ROR   [D,SP]
      ROR   $81F3,PC
      ROR   <$80FD,PC
      ROR   $7CFD,PC
      ROR   >$8005,PC
      ROR   [$7E06,PC]
      ROR   A,PC
      ROR   B,PC
      ROR   D,PC
      ROR   [D,PC]
      ROR   0,X
      ROR   1,+X
      ROR   8,-X
      ROR   1,X+
      ROR   8,X-
      ROR   0,Y
      ASR   8,-Y
      ASR   1,Y+
      ASR   8,Y-
      ASR   0,SP
      ASR   1,+SP
      ASR   8,-SP
      ASR   1,SP+
      ASR   8,SP-
      ASR   $812F,PC
      ASR   $E1,X
      ASR   $E3E4,X
      ASR   [$E4E5,X]
      ASR   A,X
      ASR   B,X
      ASR   D,X
      ASR   [D,X]
      ASR   $E9,Y
      ASR   $EBEC,Y
      ASR   [$ECED,Y]
      ASR   A,Y
      ASR   B,Y
      ASR   D,Y
      ASR   [D,Y]
      ASR   $F1,SP
      ASR   $F3F4,SP
      ASR   [$F4F5,SP]
      ASR   A,SP
      ASR   B,SP
      ASR   D,SP
      ASR   [D,SP]
      ASR   $8264,PC
      ASR   <$816E,PC
      ASR   $7D6E,PC
      ASR   >$8076,PC
      ASR   [$7E77,PC]
      ASR   A,PC
      ASR   B,PC
      ASR   D,PC
      ASR   [D,PC]
      ASR   0,X
      ASR   1,+X
      ASR   8,-X
      ASR   1,X+
      ASR   8,X-
      ASR   0,Y
      ASR   1,+Y
      ASL   7,-Y
      ASL   1,Y+
      ASL   8,Y-
      ASL   0,SP
      ASL   1,+SP
      ASL   8,-SP
      ASL   1,SP+
      ASL   8,SP-
      ASL   $81A2,PC
      ASL   $E1,X
      ASL   $E3E4,X
      ASL   [$E4E5,X]
      ASL   A,X
      ASL   B,X
      ASL   D,X
      ASL   [D,X]
      ASL   $E9,Y
      ASL   $EBEC,Y
      ASL   [$ECED,Y]
      ASL   A,Y
      ASL   B,Y
      ASL   D,Y
      ASL   [D,Y]
      ASL   $F1,SP
      ASL   $F3F4,SP
      ASL   [$F4F5,SP]
      ASL   A,SP
      ASL   B,SP
      ASL   D,SP
      ASL   [D,SP]
      ASL   $82D7,PC
      ASL   <$81E1,PC
      ASL   $7DE1,PC
      ASL   >$80E9,PC
      ASL   [$7EEA,PC]
      ASL   A,PC
      ASL   B,PC
      ASL   D,PC
      ASL   [D,PC]
      ASL   0,X
      ASL   1,+X
      ASL   8,-X
      ASL   1,X+
      ASL   8,X-
      ASL   0,Y
      ASL   1,+Y
      CLR   6,-Y
      CLR   1,Y+
      CLR   8,Y-
      CLR   0,SP
      CLR   1,+SP
      CLR   8,-SP
      CLR   1,SP+
      CLR   8,SP-
      CLR   $8215,PC
      CLR   $E1,X
      CLR   $E3E4,X
      CLR   [$E4E5,X]
      CLR   A,X
      CLR   B,X
      CLR   D,X
      CLR   [D,X]
      CLR   $E9,Y
      CLR   $EBEC,Y
      CLR   [$ECED,Y]
      CLR   A,Y
      CLR   B,Y
      CLR   D,Y
      CLR   [D,Y]
      CLR   $F1,SP
      CLR   $F3F4,SP
      CLR   [$F4F5,SP]
      CLR   A,SP
      CLR   B,SP
      CLR   D,SP
      CLR   [D,SP]
      CLR   $834A,PC
      CLR   <$8254,PC
      CLR   $7E54,PC
      CLR   >$815C,PC
      CLR   [$7F5D,PC]
      CLR   A,PC
      CLR   B,PC
      CLR   D,PC
      CLR   [D,PC]
      CLR   0,X
      CLR   1,+X
      CLR   8,-X
      CLR   1,X+
      CLR   8,X-
      CLR   0,Y
      CLR   1,+Y
      STAA  5,-Y
      STAA  1,Y+
      STAA  8,Y-
      STAA  0,SP
      STAA  1,+SP
      STAA  8,-SP
      STAA  1,SP+
      STAA  8,SP-
      STAA  $8288,PC
      STAA  $E1,X
      STAA  $E3E4,X
      STAA  [$E4E5,X]
      STAA  A,X
      STAA  B,X
      STAA  D,X
      STAA  [D,X]
      STAA  $E9,Y
      STAA  $EBEC,Y
      STAA  [$ECED,Y]
      STAA  A,Y
      STAA  B,Y
      STAA  D,Y
      STAA  [D,Y]
      STAA  $F1,SP
      STAA  $F3F4,SP
      STAA  [$F4F5,SP]
      STAA  A,SP
      STAA  B,SP
      STAA  D,SP
      STAA  [D,SP]
      STAA  $83BD,PC
      STAA  <$82C7,PC
      STAA  $7EC7,PC
      STAA  >$81CF,PC
      STAA  [$7FD0,PC]
      STAA  A,PC
      STAA  B,PC
      STAA  D,PC
      STAA  [D,PC]
      STAA  0,X
      STAA  1,+X
      STAA  8,-X
      STAA  1,X+
      STAA  8,X-
      STAA  0,Y
      STAA  1,+Y
      STAB  4,-Y
      STAB  1,Y+
      STAB  8,Y-
      STAB  0,SP
      STAB  1,+SP
      STAB  8,-SP
      STAB  1,SP+
      STAB  8,SP-
      STAB  $82FB,PC
      STAB  $E1,X
      STAB  $E3E4,X
      STAB  [$E4E5,X]
      STAB  A,X
      STAB  B,X
      STAB  D,X
      STAB  [D,X]
      STAB  $E9,Y
      STAB  $EBEC,Y
      STAB  [$ECED,Y]
      STAB  A,Y
      STAB  B,Y
      STAB  D,Y
      STAB  [D,Y]
      STAB  $F1,SP
      STAB  $F3F4,SP
      STAB  [$F4F5,SP]
      STAB  A,SP
      STAB  B,SP
      STAB  D,SP
      STAB  [D,SP]
      STAB  $8430,PC
      STAB  <$833A,PC
      STAB  $7F3A,PC
      STAB  >$8242,PC
      STAB  [$8043,PC]
      STAB  A,PC
      STAB  B,PC
      STAB  D,PC
      STAB  [D,PC]
      STAB  0,X
      STAB  1,+X
      STAB  8,-X
      STAB  1,X+
      STAB  8,X-
      STAB  0,Y
      STAB  1,+Y
      STD   3,-Y
      STD   1,Y+
      STD   8,Y-
      STD   0,SP
      STD   1,+SP
      STD   8,-SP
      STD   1,SP+
      STD   8,SP-
      STD   $836E,PC
      STD   $E1,X
      STD   $E3E4,X
      STD   [$E4E5,X]
      STD   A,X
      STD   B,X
      STD   D,X
      STD   [D,X]
      STD   $E9,Y
      STD   $EBEC,Y
      STD   [$ECED,Y]
      STD   A,Y
      STD   B,Y
      STD   D,Y
      STD   [D,Y]
      STD   $F1,SP
      STD   $F3F4,SP
      STD   [$F4F5,SP]
      STD   A,SP
      STD   B,SP
      STD   D,SP
      STD   [D,SP]
      STD   $84A3,PC
      STD   <$83AD,PC
      STD   $7FAD,PC
      STD   >$82B5,PC
      STD   [$80B6,PC]
      STD   A,PC
      STD   B,PC
      STD   D,PC
      STD   [D,PC]
      STD   0,X
      STD   1,+X
      STD   8,-X
      STD   1,X+
      STD   8,X-
      STD   0,Y
      STD   1,+Y
      STY   2,-Y
      STY   1,Y+
      STY   8,Y-
      STY   0,SP
      STY   1,+SP
      STY   8,-SP
      STY   1,SP+
      STY   8,SP-
      STY   $83E1,PC
      STY   $E1,X
      STY   $E3E4,X
      STY   [$E4E5,X]
      STY   A,X
      STY   B,X
      STY   D,X
      STY   [D,X]
      STY   $E9,Y
      STY   $EBEC,Y
      STY   [$ECED,Y]
      STY   A,Y
      STY   B,Y
      STY   D,Y
      STY   [D,Y]
      STY   $F1,SP
      STY   $F3F4,SP
      STY   [$F4F5,SP]
      STY   A,SP
      STY   B,SP
      STY   D,SP
      STY   [D,SP]
      STY   $8516,PC
      STY   <$8420,PC
      STY   $8020,PC
      STY   >$8328,PC
      STY   [$8129,PC]
      STY   A,PC
      STY   B,PC
      STY   D,PC
      STY   [D,PC]
      STY   0,X
      STY   1,+X
      STY   8,-X
      STY   1,X+
      STY   8,X-
      STY   0,Y
      STY   1,+Y
      STX   1,-Y
      STX   1,Y+
      STX   8,Y-
      STX   0,SP
      STX   1,+SP
      STX   8,-SP
      STX   1,SP+
      STX   8,SP-
      STX   $8454,PC
      STX   $E1,X
      STX   $E3E4,X
      STX   [$E4E5,X]
      STX   A,X
      STX   B,X
      STX   D,X
      STX   [D,X]
      STX   $E9,Y
      STX   $EBEC,Y
      STX   [$ECED,Y]
      STX   A,Y
      STX   B,Y
      STX   D,Y
      STX   [D,Y]
      STX   $F1,SP
      STX   $F3F4,SP
      STX   [$F4F5,SP]
      STX   A,SP
      STX   B,SP
      STX   D,SP
      STX   [D,SP]
      STX   $8589,PC
      STX   <$8493,PC
      STX   $8093,PC
      STX   >$839B,PC
      STX   [$819C,PC]
      STX   A,PC
      STX   B,PC
      STX   D,PC
      STX   [D,PC]
      STX   0,X
      STX   1,+X
      STX   8,-X
      STX   1,X+
      STX   8,X-
      STX   0,Y
      STX   1,+Y
      STS   1,Y+
      STS   8,Y-
      STS   0,SP
      STS   1,+SP
      STS   8,-SP
      STS   1,SP+
      STS   8,SP-
      STS   $84C5,PC
      STS   $E1,X
      STS   $E3E4,X
      STS   [$E4E5,X]
      STS   A,X
      STS   B,X
      STS   D,X
      STS   [D,X]
      STS   $E9,Y
      STS   $EBEC,Y
      STS   [$ECED,Y]
      STS   A,Y
      STS   B,Y
      STS   D,Y
      STS   [D,Y]
      STS   $F1,SP
      STS   $F3F4,SP
      STS   [$F4F5,SP]
      STS   A,SP
      STS   B,SP
      STS   D,SP
      STS   [D,SP]
      STS   $85FA,PC
      STS   <$8504,PC
      STS   $8104,PC
      STS   >$840C,PC
      STS   [$820D,PC]
      STS   A,PC
      STS   B,PC
      STS   D,PC
      STS   [D,PC]
      STS   0,X
      STS   1,+X
      STS   8,-X
      STS   1,X+
      STS   8,X-
      STS   0,Y
      STS   1,+Y
      STS   8,-Y
      NEG   $7172
      NEG   >$0001
      COM   $7273
      COM   >$0001
      INC   $7374
      INC   >$0001
      DEC   $7475
      DEC   >$0001
      LSR   $7576
      LSR   >$0001
      ROL   $7677
      ROL   >$0001
      ROR   $7778
      ROR   >$0001
      ASR   $7879
      ASR   >$0001
      ASL   $797A
      ASL   >$0001
      CLR   $7A7B
      CLR   >$0001
      STAA  $7B7C
      STAA  >$0001
      STAB  $7C7D
      STAB  >$0001
      STD   $7D7E
      STD   >$0001
      STY   $7E7F
      STY   >$0001
      STX   $7F80
      STX   >$0001
      STS   $8081
      STS   >$0001
      SUBA  #$81
      CMPA  #$82
      SBCA  #$83
      SUBD  #$8485
      ANDA  #$85
      BITA  #$86
      LDAA  #$87
      CLRA
      EORA  #$89
      ADCA  #$8A
      ORAA  #$8B
      ADDA  #$8C
      CPD   #$8D8E
      CPY   #$8E8F
      CPX   #$8F90
      CPS   #$9091
      SUBA  $91
      CMPA  $92
      SBCA  $93
      SUBD  $94
      ANDA  $95
      BITA  $96
      LDAA  $97
      TSTA
      EORA  $99
      ADCA  $9A
      ORAA  $9B
      ADDA  $9C
      CPD   $9D
      CPY   $9E
      CPX   $9F
      CPS   $A0
      SUBA  2,+SP
      SUBA  8,-SP
      SUBA  1,SP+
      SUBA  8,SP-
      SUBA  $85D5,PC
      SUBA  $E1,X
      SUBA  $E3E4,X
      SUBA  [$E4E5,X]
      SUBA  A,X
      SUBA  B,X
      SUBA  D,X
      SUBA  [D,X]
      SUBA  $E9,Y
      SUBA  $EBEC,Y
      SUBA  [$ECED,Y]
      SUBA  A,Y
      SUBA  B,Y
      SUBA  D,Y
      SUBA  [D,Y]
      SUBA  $F1,SP
      SUBA  $F3F4,SP
      SUBA  [$F4F5,SP]
      SUBA  A,SP
      SUBA  B,SP
      SUBA  D,SP
      SUBA  [D,SP]
      SUBA  $870A,PC
      SUBA  <$8614,PC
      SUBA  $8214,PC
      SUBA  >$851C,PC
      SUBA  [$831D,PC]
      SUBA  A,PC
      SUBA  B,PC
      SUBA  D,PC
      SUBA  [D,PC]
      SUBA  0,X
      SUBA  1,+X
      SUBA  8,-X
      SUBA  1,X+
      SUBA  8,X-
      SUBA  0,Y
      SUBA  1,+Y
      SUBA  8,-Y
      SUBA  1,Y+
      SUBA  8,Y-
      SUBA  0,SP
      CMPA  3,+SP
      CMPA  8,-SP
      CMPA  1,SP+
      CMPA  8,SP-
      CMPA  $8648,PC
      CMPA  $E1,X
      CMPA  $E3E4,X
      CMPA  [$E4E5,X]
      CMPA  A,X
      CMPA  B,X
      CMPA  D,X
      CMPA  [D,X]
      CMPA  $E9,Y
      CMPA  $EBEC,Y
      CMPA  [$ECED,Y]
      CMPA  A,Y
      CMPA  B,Y
      CMPA  D,Y
      CMPA  [D,Y]
      CMPA  $F1,SP
      CMPA  $F3F4,SP
      CMPA  [$F4F5,SP]
      CMPA  A,SP
      CMPA  B,SP
      CMPA  D,SP
      CMPA  [D,SP]
      CMPA  $877D,PC
      CMPA  <$8687,PC
      CMPA  $8287,PC
      CMPA  >$858F,PC
      CMPA  [$8390,PC]
      CMPA  A,PC
      CMPA  B,PC
      CMPA  D,PC
      CMPA  [D,PC]
      CMPA  0,X
      CMPA  1,+X
      CMPA  8,-X
      CMPA  1,X+
      CMPA  8,X-
      CMPA  0,Y
      CMPA  1,+Y
      CMPA  8,-Y
      CMPA  1,Y+
      CMPA  8,Y-
      CMPA  0,SP
      SBCA  4,+SP
      SBCA  8,-SP
      SBCA  1,SP+
      SBCA  8,SP-
      SBCA  $86BB,PC
      SBCA  $E1,X
      SBCA  $E3E4,X
      SBCA  [$E4E5,X]
      SBCA  A,X
      SBCA  B,X
      SBCA  D,X
      SBCA  [D,X]
      SBCA  $E9,Y
      SBCA  $EBEC,Y
      SBCA  [$ECED,Y]
      SBCA  A,Y
      SBCA  B,Y
      SBCA  D,Y
      SBCA  [D,Y]
      SBCA  $F1,SP
      SBCA  $F3F4,SP
      SBCA  [$F4F5,SP]
      SBCA  A,SP
      SBCA  B,SP
      SBCA  D,SP
      SBCA  [D,SP]
      SBCA  $87F0,PC
      SBCA  <$86FA,PC
      SBCA  $82FA,PC
      SBCA  >$8602,PC
      SBCA  [$8403,PC]
      SBCA  A,PC
      SBCA  B,PC
      SBCA  D,PC
      SBCA  [D,PC]
      SBCA  0,X
      SBCA  1,+X
      SBCA  8,-X
      SBCA  1,X+
      SBCA  8,X-
      SBCA  0,Y
      SBCA  1,+Y
      SBCA  8,-Y
      SBCA  1,Y+
      SBCA  8,Y-
      SBCA  0,SP
      SUBD  5,+SP
      SUBD  8,-SP
      SUBD  1,SP+
      SUBD  8,SP-
      SUBD  $872E,PC
      SUBD  $E1,X
      SUBD  $E3E4,X
      SUBD  [$E4E5,X]
      SUBD  A,X
      SUBD  B,X
      SUBD  D,X
      SUBD  [D,X]
      SUBD  $E9,Y
      SUBD  $EBEC,Y
      SUBD  [$ECED,Y]
      SUBD  A,Y
      SUBD  B,Y
      SUBD  D,Y
      SUBD  [D,Y]
      SUBD  $F1,SP
      SUBD  $F3F4,SP
      SUBD  [$F4F5,SP]
      SUBD  A,SP
      SUBD  B,SP
      SUBD  D,SP
      SUBD  [D,SP]
      SUBD  $8863,PC
      SUBD  <$876D,PC
      SUBD  $836D,PC
      SUBD  >$8675,PC
      SUBD  [$8476,PC]
      SUBD  A,PC
      SUBD  B,PC
      SUBD  D,PC
      SUBD  [D,PC]
      SUBD  0,X
      SUBD  1,+X
      SUBD  8,-X
      SUBD  1,X+
      SUBD  8,X-
      SUBD  0,Y
      SUBD  1,+Y
      SUBD  8,-Y
      SUBD  1,Y+
      SUBD  8,Y-
      SUBD  0,SP
      ANDA  6,+SP
      ANDA  8,-SP
      ANDA  1,SP+
      ANDA  8,SP-
      ANDA  $87A1,PC
      ANDA  $E1,X
      ANDA  $E3E4,X
      ANDA  [$E4E5,X]
      ANDA  A,X
      ANDA  B,X
      ANDA  D,X
      ANDA  [D,X]
      ANDA  $E9,Y
      ANDA  $EBEC,Y
      ANDA  [$ECED,Y]
      ANDA  A,Y
      ANDA  B,Y
      ANDA  D,Y
      ANDA  [D,Y]
      ANDA  $F1,SP
      ANDA  $F3F4,SP
      ANDA  [$F4F5,SP]
      ANDA  A,SP
      ANDA  B,SP
      ANDA  D,SP
      ANDA  [D,SP]
      ANDA  $88D6,PC
      ANDA  <$87E0,PC
      ANDA  $83E0,PC
      ANDA  >$86E8,PC
      ANDA  [$84E9,PC]
      ANDA  A,PC
      ANDA  B,PC
      ANDA  D,PC
      ANDA  [D,PC]
      ANDA  0,X
      ANDA  1,+X
      ANDA  8,-X
      ANDA  1,X+
      ANDA  8,X-
      ANDA  0,Y
      ANDA  1,+Y
      ANDA  8,-Y
      ANDA  1,Y+
      ANDA  8,Y-
      ANDA  0,SP
      BITA  7,+SP
      BITA  8,-SP
      BITA  1,SP+
      BITA  8,SP-
      BITA  $8814,PC
      BITA  $E1,X
      BITA  $E3E4,X
      BITA  [$E4E5,X]
      BITA  A,X
      BITA  B,X
      BITA  D,X
      BITA  [D,X]
      BITA  $E9,Y
      BITA  $EBEC,Y
      BITA  [$ECED,Y]
      BITA  A,Y
      BITA  B,Y
      BITA  D,Y
      BITA  [D,Y]
      BITA  $F1,SP
      BITA  $F3F4,SP
      BITA  [$F4F5,SP]
      BITA  A,SP
      BITA  B,SP
      BITA  D,SP
      BITA  [D,SP]
      BITA  $8949,PC
      BITA  <$8853,PC
      BITA  $8453,PC
      BITA  >$875B,PC
      BITA  [$855C,PC]
      BITA  A,PC
      BITA  B,PC
      BITA  D,PC
      BITA  [D,PC]
      BITA  0,X
      BITA  1,+X
      BITA  8,-X
      BITA  1,X+
      BITA  8,X-
      BITA  0,Y
      BITA  1,+Y
      BITA  8,-Y
      BITA  1,Y+
      BITA  8,Y-
      BITA  0,SP
      LDAA  8,+SP
      LDAA  8,-SP
      LDAA  1,SP+
      LDAA  8,SP-
      LDAA  $8887,PC
      LDAA  $E1,X
      LDAA  $E3E4,X
      LDAA  [$E4E5,X]
      LDAA  A,X
      LDAA  B,X
      LDAA  D,X
      LDAA  [D,X]
      LDAA  $E9,Y
      LDAA  $EBEC,Y
      LDAA  [$ECED,Y]
      LDAA  A,Y
      LDAA  B,Y
      LDAA  D,Y
      LDAA  [D,Y]
      LDAA  $F1,SP
      LDAA  $F3F4,SP
      LDAA  [$F4F5,SP]
      LDAA  A,SP
      LDAA  B,SP
      LDAA  D,SP
      LDAA  [D,SP]
      LDAA  $89BC,PC
      LDAA  <$88C6,PC
      LDAA  $84C6,PC
      LDAA  >$87CE,PC
      LDAA  [$85CF,PC]
      LDAA  A,PC
      LDAA  B,PC
      LDAA  D,PC
      LDAA  [D,PC]
      LDAA  0,X
      LDAA  1,+X
      LDAA  8,-X
      LDAA  1,X+
      LDAA  8,X-
      LDAA  0,Y
      LDAA  1,+Y
      LDAA  8,-Y
      LDAA  1,Y+
      LDAA  8,Y-
      LDAA  0,SP
      NOP
      EORA  7,-SP
      EORA  1,SP+
      EORA  8,SP-
      EORA  $88F9,PC
      EORA  $E1,X
      EORA  $E3E4,X
      EORA  [$E4E5,X]
      EORA  A,X
      EORA  B,X
      EORA  D,X
      EORA  [D,X]
      EORA  $E9,Y
      EORA  $EBEC,Y
      EORA  [$ECED,Y]
      EORA  A,Y
      EORA  B,Y
      EORA  D,Y
      EORA  [D,Y]
      EORA  $F1,SP
      EORA  $F3F4,SP
      EORA  [$F4F5,SP]
      EORA  A,SP
      EORA  B,SP
      EORA  D,SP
      EORA  [D,SP]
      EORA  $8A2E,PC
      EORA  <$8938,PC
      EORA  $8538,PC
      EORA  >$8840,PC
      EORA  [$8641,PC]
      EORA  A,PC
      EORA  B,PC
      EORA  D,PC
      EORA  [D,PC]
      EORA  0,X
      EORA  1,+X
      EORA  8,-X
      EORA  1,X+
      EORA  8,X-
      EORA  0,Y
      EORA  1,+Y
      EORA  8,-Y
      EORA  1,Y+
      EORA  8,Y-
      EORA  0,SP
      EORA  1,+SP
      ADCA  6,-SP
      ADCA  1,SP+
      ADCA  8,SP-
      ADCA  $896C,PC
      ADCA  $E1,X
      ADCA  $E3E4,X
      ADCA  [$E4E5,X]
      ADCA  A,X
      ADCA  B,X
      ADCA  D,X
      ADCA  [D,X]
      ADCA  $E9,Y
      ADCA  $EBEC,Y
      ADCA  [$ECED,Y]
      ADCA  A,Y
      ADCA  B,Y
      ADCA  D,Y
      ADCA  [D,Y]
      ADCA  $F1,SP
      ADCA  $F3F4,SP
      ADCA  [$F4F5,SP]
      ADCA  A,SP
      ADCA  B,SP
      ADCA  D,SP
      ADCA  [D,SP]
      ADCA  $8AA1,PC
      ADCA  <$89AB,PC
      ADCA  $85AB,PC
      ADCA  >$88B3,PC
      ADCA  [$86B4,PC]
      ADCA  A,PC
      ADCA  B,PC
      ADCA  D,PC
      ADCA  [D,PC]
      ADCA  0,X
      ADCA  1,+X
      ADCA  8,-X
      ADCA  1,X+
      ADCA  8,X-
      ADCA  0,Y
      ADCA  1,+Y
      ADCA  8,-Y
      ADCA  1,Y+
      ADCA  8,Y-
      ADCA  0,SP
      ADCA  1,+SP
      ORAA  5,-SP
      ORAA  1,SP+
      ORAA  8,SP-
      ORAA  $89DF,PC
      ORAA  $E1,X
      ORAA  $E3E4,X
      ORAA  [$E4E5,X]
      ORAA  A,X
      ORAA  B,X
      ORAA  D,X
      ORAA  [D,X]
      ORAA  $E9,Y
      ORAA  $EBEC,Y
      ORAA  [$ECED,Y]
      ORAA  A,Y
      ORAA  B,Y
      ORAA  D,Y
      ORAA  [D,Y]
      ORAA  $F1,SP
      ORAA  $F3F4,SP
      ORAA  [$F4F5,SP]
      ORAA  A,SP
      ORAA  B,SP
      ORAA  D,SP
      ORAA  [D,SP]
      ORAA  $8B14,PC
      ORAA  <$8A1E,PC
      ORAA  $861E,PC
      ORAA  >$8926,PC
      ORAA  [$8727,PC]
      ORAA  A,PC
      ORAA  B,PC
      ORAA  D,PC
      ORAA  [D,PC]
      ORAA  0,X
      ORAA  1,+X
      ORAA  8,-X
      ORAA  1,X+
      ORAA  8,X-
      ORAA  0,Y
      ORAA  1,+Y
      ORAA  8,-Y
      ORAA  1,Y+
      ORAA  8,Y-
      ORAA  0,SP
      ORAA  1,+SP
      ADDA  4,-SP
      ADDA  1,SP+
      ADDA  8,SP-
      ADDA  $8A52,PC
      ADDA  $E1,X
      ADDA  $E3E4,X
      ADDA  [$E4E5,X]
      ADDA  A,X
      ADDA  B,X
      ADDA  D,X
      ADDA  [D,X]
      ADDA  $E9,Y
      ADDA  $EBEC,Y
      ADDA  [$ECED,Y]
      ADDA  A,Y
      ADDA  B,Y
      ADDA  D,Y
      ADDA  [D,Y]
      ADDA  $F1,SP
      ADDA  $F3F4,SP
      ADDA  [$F4F5,SP]
      ADDA  A,SP
      ADDA  B,SP
      ADDA  D,SP
      ADDA  [D,SP]
      ADDA  $8B87,PC
      ADDA  <$8A91,PC
      ADDA  $8691,PC
      ADDA  >$8999,PC
      ADDA  [$879A,PC]
      ADDA  A,PC
      ADDA  B,PC
      ADDA  D,PC
      ADDA  [D,PC]
      ADDA  0,X
      ADDA  1,+X
      ADDA  8,-X
      ADDA  1,X+
      ADDA  8,X-
      ADDA  0,Y
      ADDA  1,+Y
      ADDA  8,-Y
      ADDA  1,Y+
      ADDA  8,Y-
      ADDA  0,SP
      ADDA  1,+SP
      CPD   3,-SP
      CPD   1,SP+
      CPD   8,SP-
      CPD   $8AC5,PC
      CPD   $E1,X
      CPD   $E3E4,X
      CPD   [$E4E5,X]
      CPD   A,X
      CPD   B,X
      CPD   D,X
      CPD   [D,X]
      CPD   $E9,Y
      CPD   $EBEC,Y
      CPD   [$ECED,Y]
      CPD   A,Y
      CPD   B,Y
      CPD   D,Y
      CPD   [D,Y]
      CPD   $F1,SP
      CPD   $F3F4,SP
      CPD   [$F4F5,SP]
      CPD   A,SP
      CPD   B,SP
      CPD   D,SP
      CPD   [D,SP]
      CPD   $8BFA,PC
      CPD   <$8B04,PC
      CPD   $8704,PC
      CPD   >$8A0C,PC
      CPD   [$880D,PC]
      CPD   A,PC
      CPD   B,PC
      CPD   D,PC
      CPD   [D,PC]
      CPD   0,X
      CPD   1,+X
      CPD   8,-X
      CPD   1,X+
      CPD   8,X-
      CPD   0,Y
      CPD   1,+Y
      CPD   8,-Y
      CPD   1,Y+
      CPD   8,Y-
      CPD   0,SP
      CPD   1,+SP
      CPY   2,-SP
      CPY   1,SP+
      CPY   8,SP-
      CPY   $8B38,PC
      CPY   $E1,X
      CPY   $E3E4,X
      CPY   [$E4E5,X]
      CPY   A,X
      CPY   B,X
      CPY   D,X
      CPY   [D,X]
      CPY   $E9,Y
      CPY   $EBEC,Y
      CPY   [$ECED,Y]
      CPY   A,Y
      CPY   B,Y
      CPY   D,Y
      CPY   [D,Y]
      CPY   $F1,SP
      CPY   $F3F4,SP
      CPY   [$F4F5,SP]
      CPY   A,SP
      CPY   B,SP
      CPY   D,SP
      CPY   [D,SP]
      CPY   $8C6D,PC
      CPY   <$8B77,PC
      CPY   $8777,PC
      CPY   >$8A7F,PC
      CPY   [$8880,PC]
      CPY   A,PC
      CPY   B,PC
      CPY   D,PC
      CPY   [D,PC]
      CPY   0,X
      CPY   1,+X
      CPY   8,-X
      CPY   1,X+
      CPY   8,X-
      CPY   0,Y
      CPY   1,+Y
      CPY   8,-Y
      CPY   1,Y+
      CPY   8,Y-
      CPY   0,SP
      CPY   1,+SP
      CPX   1,-SP
      CPX   1,SP+
      CPX   8,SP-
      CPX   $8BAB,PC
      CPX   $E1,X
      CPX   $E3E4,X
      CPX   [$E4E5,X]
      CPX   A,X
      CPX   B,X
      CPX   D,X
      CPX   [D,X]
      CPX   $E9,Y
      CPX   $EBEC,Y
      CPX   [$ECED,Y]
      CPX   A,Y
      CPX   B,Y
      CPX   D,Y
      CPX   [D,Y]
      CPX   $F1,SP
      CPX   $F3F4,SP
      CPX   [$F4F5,SP]
      CPX   A,SP
      CPX   B,SP
      CPX   D,SP
      CPX   [D,SP]
      CPX   $8CE0,PC
      CPX   <$8BEA,PC
      CPX   $87EA,PC
      CPX   >$8AF2,PC
      CPX   [$88F3,PC]
      CPX   A,PC
      CPX   B,PC
      CPX   D,PC
      CPX   [D,PC]
      CPX   0,X
      CPX   1,+X
      CPX   8,-X
      CPX   1,X+
      CPX   8,X-
      CPX   0,Y
      CPX   1,+Y
      CPX   8,-Y
      CPX   1,Y+
      CPX   8,Y-
      CPX   0,SP
      CPX   1,+SP
      CPS   1,SP+
      CPS   8,SP-
      CPS   $8C1C,PC
      CPS   $E1,X
      CPS   $E3E4,X
      CPS   [$E4E5,X]
      CPS   A,X
      CPS   B,X
      CPS   D,X
      CPS   [D,X]
      CPS   $E9,Y
      CPS   $EBEC,Y
      CPS   [$ECED,Y]
      CPS   A,Y
      CPS   B,Y
      CPS   D,Y
      CPS   [D,Y]
      CPS   $F1,SP
      CPS   $F3F4,SP
      CPS   [$F4F5,SP]
      CPS   A,SP
      CPS   B,SP
      CPS   D,SP
      CPS   [D,SP]
      CPS   $8D51,PC
      CPS   <$8C5B,PC
      CPS   $885B,PC
      CPS   >$8B63,PC
      CPS   [$8964,PC]
      CPS   A,PC
      CPS   B,PC
      CPS   D,PC
      CPS   [D,PC]
      CPS   0,X
      CPS   1,+X
      CPS   8,-X
      CPS   1,X+
      CPS   8,X-
      CPS   0,Y
      CPS   1,+Y
      CPS   8,-Y
      CPS   1,Y+
      CPS   8,Y-
      CPS   0,SP
      CPS   1,+SP
      CPS   8,-SP
      SUBA  $B1B2
      SUBA  >$0001
      CMPA  $B2B3
      CMPA  >$0001
      SBCA  $B3B4
      SBCA  >$0001
      SUBD  $B4B5
      SUBD  >$0001
      ANDA  $B5B6
      ANDA  >$0001
      BITA  $B6B7
      BITA  >$0001
      LDAA  $B7B8
      LDAA  >$0001
      EXG   D, A
      EXG   D, B
      EXG   D, CCR
      EXG   D, D
      EXG   D, X
      EXG   D, Y
      EXG   D, SP
      EXG   D, CCRW
      EXG   X, A
      EXG   X, B
      EXG   X, CCR
      EXG   X, D
      EXG   X, X
      EXG   X, Y
      EXG   X, SP
      EXG   XH, A
      EXG   XL, B
      EXG   X, CCRW
      EXG   Y, A
      EXG   Y, B
      EXG   Y, CCR
      EXG   Y, D
      EXG   Y, X
      EXG   Y, Y
      EXG   Y, SP
      EXG   YH, A
      EXG   YL, B
      EXG   Y, CCRW
      EXG   SP, A
      EXG   SP, B
      EXG   SP, CCR
      EXG   SP, D
      EXG   SP, X
      EXG   SP, Y
      EXG   SP, SP
      EXG   SPH, A
      EXG   SPL, B
      EXG   SP, CCRW
      TFR   A, A
      TFR   A, B
      TFR   A, CCR
      SEX   A, D
      SEX   A, X
      SEX   A, Y
      SEX   A, SP
      TFR   A, CCRH
      TFR   A, XH
      TFR   A, YH
      TFR   A, SPH
      TFR   B, A
      TFR   B, B
      TFR   B, CCR
      SEX   B, D
      SEX   B, X
      SEX   B, Y
      SEX   B, SP
      TFR   B, XL
      TFR   B, YL
      TFR   B, SPL
      TFR   CCR, A
      TFR   CCR, B
      TFR   CCR, CCR
      SEX   CCR, D
      SEX   CCR, X
      SEX   CCR, Y
      SEX   CCR, SP
      TFR   CCRH, A
      TFR   CCRW, CCRW
      TFR   CCRW, D
      TFR   CCRW, X
      TFR   CCRW, Y
      TFR   CCRW, SP
      TFR   D, A
      TFR   D, B
      TFR   D, CCR
      TFR   D, D
      TFR   D, X
      TFR   D, Y
      TFR   D, SP
      TFR   D, CCRW
      SEX   D, X
      SEX   D, Y
      SEX   D, SP
      TFR   X, A
      TFR   X, B
      TFR   X, CCR
      TFR   X, D
      TFR   X, X
      TFR   X, Y
      TFR   X, SP
      TFR   XH, A
      TFR   X, CCRW
      TFR   Y, A
      TFR   Y, B
      TFR   Y, CCR
      TFR   Y, D
      TFR   Y, X
      TFR   Y, Y
      TFR   Y, SP
      TFR   YH, A
      TFR   Y, CCRW
      TFR   SP, A
      TFR   SP, B
      TFR   SP, CCR
      TFR   SP, D
      TFR   SP, X
      TFR   SP, Y
      TFR   SP, SP
      TFR   SPH, A
      TFR   SP, CCRW
      EXG   A, A
      EXG   A, B
      EXG   A, CCR
      EXG   A, D
      EXG   A, X
      EXG   A, Y
      EXG   A, SP
      EXG   A, CCRH
      EXG   A, XH
      EXG   A, YH
      EXG   A, SPH
      EXG   B, A
      EXG   B, B
      EXG   B, CCR
      EXG   B, D
      EXG   B, X
      EXG   B, Y
      EXG   B, SP
      EXG   B, XL
      EXG   B, YL
      EXG   B, SPL
      EXG   CCR, A
      EXG   CCR, B
      EXG   CCR, CCR
      EXG   CCR, D
      EXG   CCR, X
      EXG   CCR, Y
      EXG   CCR, SP
      EXG   CCRH, A
      EXG   CCRW, CCRW
      EXG   CCRW, D
      EXG   CCRW, X
      EXG   CCRW, Y
      EXG   CCRW, SP
      EORA  $B9BA
      EORA  >$0001
      ADCA  $BABB
      ADCA  >$0001
      ORAA  $BBBC
      ORAA  >$0001
      ADDA  $BCBD
      ADDA  >$0001
      CPD   $BDBE
      CPD   >$0001
      CPY   $BEBF
      CPY   >$0001
      CPX   $BFC0
      CPX   >$0001
      CPS   $C0C1
      CPS   >$0001
      SUBB  #$C1
      CMPB  #$C2
      SBCB  #$C3
      ADDD  #$C4C5
      ANDB  #$C5
      BITB  #$C6
      LDAB  #$C7
      CLRB
      EORB  #$C9
      ADCB  #$CA
      ORAB  #$CB
      ADDB  #$CC
      LDD   #$CDCE
      LDY   #$CECF
      LDX   #$CFD0
      LDS   #$D0D1
      SUBB  $D1
      CMPB  $D2
      SBCB  $D3
      ADDD  $D4
      ANDB  $D5
      BITB  $D6
      LDAB  $D7
      TSTB
      EORB  $D9
      ADCB  $DA
      ORAB  $DB
      ADDB  $DC
      LDD   $DD
      LDY   $DE
      LDX   $DF
      LDS   $E0
      SUBB  -30,X
      SUBB  $E3E4,X
      SUBB  [$E4E5,X]
      SUBB  A,X
      SUBB  B,X
      SUBB  D,X
      SUBB  [D,X]
      SUBB  $E9,Y
      SUBB  $EBEC,Y
      SUBB  [$ECED,Y]
      SUBB  A,Y
      SUBB  B,Y
      SUBB  D,Y
      SUBB  [D,Y]
      SUBB  $F1,SP
      SUBB  $F3F4,SP
      SUBB  [$F4F5,SP]
      SUBB  A,SP
      SUBB  B,SP
      SUBB  D,SP
      SUBB  [D,SP]
      SUBB  $8F7B,PC
      SUBB  <$8E85,PC
      SUBB  $8A85,PC
      SUBB  >$8D8D,PC
      SUBB  [$8B8E,PC]
      SUBB  A,PC
      SUBB  B,PC
      SUBB  D,PC
      SUBB  [D,PC]
      SUBB  0,X
      SUBB  1,+X
      SUBB  8,-X
      SUBB  1,X+
      SUBB  8,X-
      SUBB  0,Y
      SUBB  1,+Y
      SUBB  8,-Y
      SUBB  1,Y+
      SUBB  8,Y-
      SUBB  0,SP
      SUBB  1,+SP
      SUBB  8,-SP
      SUBB  1,SP+
      SUBB  8,SP-
      SUBB  $8EB9,PC
      CMPB  $E3E4,X
      CMPB  [$E4E5,X]
      CMPB  A,X
      CMPB  B,X
      CMPB  D,X
      CMPB  [D,X]
      CMPB  $E9,Y
      CMPB  $EBEC,Y
      CMPB  [$ECED,Y]
      CMPB  A,Y
      CMPB  B,Y
      CMPB  D,Y
      CMPB  [D,Y]
      CMPB  $F1,SP
      CMPB  $F3F4,SP
      CMPB  [$F4F5,SP]
      CMPB  A,SP
      CMPB  B,SP
      CMPB  D,SP
      CMPB  [D,SP]
      CMPB  $8FEB,PC
      CMPB  <$8EF5,PC
      CMPB  $8AF5,PC
      CMPB  >$8DFD,PC
      CMPB  [$8BFE,PC]
      CMPB  A,PC
      CMPB  B,PC
      CMPB  D,PC
      CMPB  [D,PC]
      CMPB  0,X
      CMPB  1,+X
      CMPB  8,-X
      CMPB  1,X+
      CMPB  8,X-
      CMPB  0,Y
      CMPB  1,+Y
      CMPB  8,-Y
      CMPB  1,Y+
      CMPB  8,Y-
      CMPB  0,SP
      CMPB  1,+SP
      CMPB  8,-SP
      CMPB  1,SP+
      CMPB  8,SP-
      CMPB  $8F29,PC
      CMPB  $E1,X
      SBCB  [$E4E5,X]
      SBCB  A,X
      SBCB  B,X
      SBCB  D,X
      SBCB  [D,X]
      SBCB  $E9,Y
      SBCB  $EBEC,Y
      SBCB  [$ECED,Y]
      SBCB  A,Y
      SBCB  B,Y
      SBCB  D,Y
      SBCB  [D,Y]
      SBCB  $F1,SP
      SBCB  $F3F4,SP
      SBCB  [$F4F5,SP]
      SBCB  A,SP
      SBCB  B,SP
      SBCB  D,SP
      SBCB  [D,SP]
      SBCB  $905A,PC
      SBCB  <$8F64,PC
      SBCB  $8B64,PC
      SBCB  >$8E6C,PC
      SBCB  [$8C6D,PC]
      SBCB  A,PC
      SBCB  B,PC
      SBCB  D,PC
      SBCB  [D,PC]
      SBCB  0,X
      SBCB  1,+X
      SBCB  8,-X
      SBCB  1,X+
      SBCB  8,X-
      SBCB  0,Y
      SBCB  1,+Y
      SBCB  8,-Y
      SBCB  1,Y+
      SBCB  8,Y-
      SBCB  0,SP
      SBCB  1,+SP
      SBCB  8,-SP
      SBCB  1,SP+
      SBCB  8,SP-
      SBCB  $8F98,PC
      SBCB  $E1,X
      SBCB  $E3E4,X
      ADDD  A,X
      ADDD  B,X
      ADDD  D,X
      ADDD  [D,X]
      ADDD  $E9,Y
      ADDD  $EBEC,Y
      ADDD  [$ECED,Y]
      ADDD  A,Y
      ADDD  B,Y
      ADDD  D,Y
      ADDD  [D,Y]
      ADDD  $F1,SP
      ADDD  $F3F4,SP
      ADDD  [$F4F5,SP]
      ADDD  A,SP
      ADDD  B,SP
      ADDD  D,SP
      ADDD  [D,SP]
      ADDD  $90C9,PC
      ADDD  <$8FD3,PC
      ADDD  $8BD3,PC
      ADDD  >$8EDB,PC
      ADDD  [$8CDC,PC]
      ADDD  A,PC
      ADDD  B,PC
      ADDD  D,PC
      ADDD  [D,PC]
      ADDD  0,X
      ADDD  1,+X
      ADDD  8,-X
      ADDD  1,X+
      ADDD  8,X-
      ADDD  0,Y
      ADDD  1,+Y
      ADDD  8,-Y
      ADDD  1,Y+
      ADDD  8,Y-
      ADDD  0,SP
      ADDD  1,+SP
      ADDD  8,-SP
      ADDD  1,SP+
      ADDD  8,SP-
      ADDD  $9007,PC
      ADDD  $E1,X
      ADDD  $E3E4,X
      ADDD  [$E4E5,X]
      ANDB  B,X
      ANDB  D,X
      ANDB  [D,X]
      ANDB  $E9,Y
      ANDB  $EBEC,Y
      ANDB  [$ECED,Y]
      ANDB  A,Y
      ANDB  B,Y
      ANDB  D,Y
      ANDB  [D,Y]
      ANDB  $F1,SP
      ANDB  $F3F4,SP
      ANDB  [$F4F5,SP]
      ANDB  A,SP
      ANDB  B,SP
      ANDB  D,SP
      ANDB  [D,SP]
      ANDB  $913A,PC
      ANDB  <$9044,PC
      ANDB  $8C44,PC
      ANDB  >$8F4C,PC
      ANDB  [$8D4D,PC]
      ANDB  A,PC
      ANDB  B,PC
      ANDB  D,PC
      ANDB  [D,PC]
      ANDB  0,X
      ANDB  1,+X
      ANDB  8,-X
      ANDB  1,X+
      ANDB  8,X-
      ANDB  0,Y
      ANDB  1,+Y
      ANDB  8,-Y
      ANDB  1,Y+
      ANDB  8,Y-
      ANDB  0,SP
      ANDB  1,+SP
      ANDB  8,-SP
      ANDB  1,SP+
      ANDB  8,SP-
      ANDB  $9078,PC
      ANDB  $E1,X
      ANDB  $E3E4,X
      ANDB  [$E4E5,X]
      ANDB  A,X
      BITB  D,X
      BITB  [D,X]
      BITB  $E9,Y
      BITB  $EBEC,Y
      BITB  [$ECED,Y]
      BITB  A,Y
      BITB  B,Y
      BITB  D,Y
      BITB  [D,Y]
      BITB  $F1,SP
      BITB  $F3F4,SP
      BITB  [$F4F5,SP]
      BITB  A,SP
      BITB  B,SP
      BITB  D,SP
      BITB  [D,SP]
      BITB  $91AB,PC
      BITB  <$90B5,PC
      BITB  $8CB5,PC
      BITB  >$8FBD,PC
      BITB  [$8DBE,PC]
      BITB  A,PC
      BITB  B,PC
      BITB  D,PC
      BITB  [D,PC]
      BITB  0,X
      BITB  1,+X
      BITB  8,-X
      BITB  1,X+
      BITB  8,X-
      BITB  0,Y
      BITB  1,+Y
      BITB  8,-Y
      BITB  1,Y+
      BITB  8,Y-
      BITB  0,SP
      BITB  1,+SP
      BITB  8,-SP
      BITB  1,SP+
      BITB  8,SP-
      BITB  $90E9,PC
      BITB  $E1,X
      BITB  $E3E4,X
      BITB  [$E4E5,X]
      BITB  A,X
      BITB  B,X
      LDAB  [D,X]
      LDAB  $E9,Y
      LDAB  $EBEC,Y
      LDAB  [$ECED,Y]
      LDAB  A,Y
      LDAB  B,Y
      LDAB  D,Y
      LDAB  [D,Y]
      LDAB  $F1,SP
      LDAB  $F3F4,SP
      LDAB  [$F4F5,SP]
      LDAB  A,SP
      LDAB  B,SP
      LDAB  D,SP
      LDAB  [D,SP]
      LDAB  $921C,PC
      LDAB  <$9126,PC
      LDAB  $8D26,PC
      LDAB  >$902E,PC
      LDAB  [$8E2F,PC]
      LDAB  A,PC
      LDAB  B,PC
      LDAB  D,PC
      LDAB  [D,PC]
      LDAB  0,X
      LDAB  1,+X
      LDAB  8,-X
      LDAB  1,X+
      LDAB  8,X-
      LDAB  0,Y
      LDAB  1,+Y
      LDAB  8,-Y
      LDAB  1,Y+
      LDAB  8,Y-
      LDAB  0,SP
      LDAB  1,+SP
      LDAB  8,-SP
      LDAB  1,SP+
      LDAB  8,SP-
      LDAB  $915A,PC
      LDAB  $E1,X
      LDAB  $E3E4,X
      LDAB  [$E4E5,X]
      LDAB  A,X
      LDAB  B,X
      LDAB  D,X
      TST   $E9,Y
      TST   $EBEC,Y
      TST   [$ECED,Y]
      TST   A,Y
      TST   B,Y
      TST   D,Y
      TST   [D,Y]
      TST   $F1,SP
      TST   $F3F4,SP
      TST   [$F4F5,SP]
      TST   A,SP
      TST   B,SP
      TST   D,SP
      TST   [D,SP]
      TST   $928D,PC
      TST   <$9197,PC
      TST   $8D97,PC
      TST   >$909F,PC
      TST   [$8EA0,PC]
      TST   A,PC
      TST   B,PC
      TST   D,PC
      TST   [D,PC]
      TST   0,X
      TST   1,+X
      TST   8,-X
      TST   1,X+
      TST   8,X-
      TST   0,Y
      TST   1,+Y
      TST   8,-Y
      TST   1,Y+
      TST   8,Y-
      TST   0,SP
      TST   1,+SP
      TST   8,-SP
      TST   1,SP+
      TST   8,SP-
      TST   $91CB,PC
      TST   $E1,X
      TST   $E3E4,X
      TST   [$E4E5,X]
      TST   A,X
      TST   B,X
      TST   D,X
      TST   [D,X]
      EORB  -22,Y
      EORB  $EBEC,Y
      EORB  [$ECED,Y]
      EORB  A,Y
      EORB  B,Y
      EORB  D,Y
      EORB  [D,Y]
      EORB  $F1,SP
      EORB  $F3F4,SP
      EORB  [$F4F5,SP]
      EORB  A,SP
      EORB  B,SP
      EORB  D,SP
      EORB  [D,SP]
      EORB  $9300,PC
      EORB  <$920A,PC
      EORB  $8E0A,PC
      EORB  >$9112,PC
      EORB  [$8F13,PC]
      EORB  A,PC
      EORB  B,PC
      EORB  D,PC
      EORB  [D,PC]
      EORB  0,X
      EORB  1,+X
      EORB  8,-X
      EORB  1,X+
      EORB  8,X-
      EORB  0,Y
      EORB  1,+Y
      EORB  8,-Y
      EORB  1,Y+
      EORB  8,Y-
      EORB  0,SP
      EORB  1,+SP
      EORB  8,-SP
      EORB  1,SP+
      EORB  8,SP-
      EORB  $923E,PC
      EORB  $E1,X
      EORB  $E3E4,X
      EORB  [$E4E5,X]
      EORB  A,X
      EORB  B,X
      EORB  D,X
      EORB  [D,X]
      ADCB  $EBEC,Y
      ADCB  [$ECED,Y]
      ADCB  A,Y
      ADCB  B,Y
      ADCB  D,Y
      ADCB  [D,Y]
      ADCB  $F1,SP
      ADCB  $F3F4,SP
      ADCB  [$F4F5,SP]
      ADCB  A,SP
      ADCB  B,SP
      ADCB  D,SP
      ADCB  [D,SP]
      ADCB  $9370,PC
      ADCB  <$927A,PC
      ADCB  $8E7A,PC
      ADCB  >$9182,PC
      ADCB  [$8F83,PC]
      ADCB  A,PC
      ADCB  B,PC
      ADCB  D,PC
      ADCB  [D,PC]
      ADCB  0,X
      ADCB  1,+X
      ADCB  8,-X
      ADCB  1,X+
      ADCB  8,X-
      ADCB  0,Y
      ADCB  1,+Y
      ADCB  8,-Y
      ADCB  1,Y+
      ADCB  8,Y-
      ADCB  0,SP
      ADCB  1,+SP
      ADCB  8,-SP
      ADCB  1,SP+
      ADCB  8,SP-
      ADCB  $92AE,PC
      ADCB  $E1,X
      ADCB  $E3E4,X
      ADCB  [$E4E5,X]
      ADCB  A,X
      ADCB  B,X
      ADCB  D,X
      ADCB  [D,X]
      ADCB  $E9,Y
      ORAB  [$ECED,Y]
      ORAB  A,Y
      ORAB  B,Y
      ORAB  D,Y
      ORAB  [D,Y]
      ORAB  $F1,SP
      ORAB  $F3F4,SP
      ORAB  [$F4F5,SP]
      ORAB  A,SP
      ORAB  B,SP
      ORAB  D,SP
      ORAB  [D,SP]
      ORAB  $93DF,PC
      ORAB  <$92E9,PC
      ORAB  $8EE9,PC
      ORAB  >$91F1,PC
      ORAB  [$8FF2,PC]
      ORAB  A,PC
      ORAB  B,PC
      ORAB  D,PC
      ORAB  [D,PC]
      ORAB  0,X
      ORAB  1,+X
      ORAB  8,-X
      ORAB  1,X+
      ORAB  8,X-
      ORAB  0,Y
      ORAB  1,+Y
      ORAB  8,-Y
      ORAB  1,Y+
      ORAB  8,Y-
      ORAB  0,SP
      ORAB  1,+SP
      ORAB  8,-SP
      ORAB  1,SP+
      ORAB  8,SP-
      ORAB  $931D,PC
      ORAB  $E1,X
      ORAB  $E3E4,X
      ORAB  [$E4E5,X]
      ORAB  A,X
      ORAB  B,X
      ORAB  D,X
      ORAB  [D,X]
      ORAB  $E9,Y
      ORAB  $EBEC,Y
      ADDB  A,Y
      ADDB  B,Y
      ADDB  D,Y
      ADDB  [D,Y]
      ADDB  $F1,SP
      ADDB  $F3F4,SP
      ADDB  [$F4F5,SP]
      ADDB  A,SP
      ADDB  B,SP
      ADDB  D,SP
      ADDB  [D,SP]
      ADDB  $944E,PC
      ADDB  <$9358,PC
      ADDB  $8F58,PC
      ADDB  >$9260,PC
      ADDB  [$9061,PC]
      ADDB  A,PC
      ADDB  B,PC
      ADDB  D,PC
      ADDB  [D,PC]
      ADDB  0,X
      ADDB  1,+X
      ADDB  8,-X
      ADDB  1,X+
      ADDB  8,X-
      ADDB  0,Y
      ADDB  1,+Y
      ADDB  8,-Y
      ADDB  1,Y+
      ADDB  8,Y-
      ADDB  0,SP
      ADDB  1,+SP
      ADDB  8,-SP
      ADDB  1,SP+
      ADDB  8,SP-
      ADDB  $938C,PC
      ADDB  $E1,X
      ADDB  $E3E4,X
      ADDB  [$E4E5,X]
      ADDB  A,X
      ADDB  B,X
      ADDB  D,X
      ADDB  [D,X]
      ADDB  $E9,Y
      ADDB  $EBEC,Y
      ADDB  [$ECED,Y]
      LDD   B,Y
      LDD   D,Y
      LDD   [D,Y]
      LDD   $F1,SP
      LDD   $F3F4,SP
      LDD   [$F4F5,SP]
      LDD   A,SP
      LDD   B,SP
      LDD   D,SP
      LDD   [D,SP]
      LDD   $94BF,PC
      LDD   <$93C9,PC
      LDD   $8FC9,PC
      LDD   >$92D1,PC
      LDD   [$90D2,PC]
      LDD   A,PC
      LDD   B,PC
      LDD   D,PC
      LDD   [D,PC]
      LDD   0,X
      LDD   1,+X
      LDD   8,-X
      LDD   1,X+
      LDD   8,X-
      LDD   0,Y
      LDD   1,+Y
      LDD   8,-Y
      LDD   1,Y+
      LDD   8,Y-
      LDD   0,SP
      LDD   1,+SP
      LDD   8,-SP
      LDD   1,SP+
      LDD   8,SP-
      LDD   $93FD,PC
      LDD   $E1,X
      LDD   $E3E4,X
      LDD   [$E4E5,X]
      LDD   A,X
      LDD   B,X
      LDD   D,X
      LDD   [D,X]
      LDD   $E9,Y
      LDD   $EBEC,Y
      LDD   [$ECED,Y]
      LDD   A,Y
      LDY   D,Y
      LDY   [D,Y]
      LDY   $F1,SP
      LDY   $F3F4,SP
      LDY   [$F4F5,SP]
      LDY   A,SP
      LDY   B,SP
      LDY   D,SP
      LDY   [D,SP]
      LDY   $9530,PC
      LDY   <$943A,PC
      LDY   $903A,PC
      LDY   >$9342,PC
      LDY   [$9143,PC]
      LDY   A,PC
      LDY   B,PC
      LDY   D,PC
      LDY   [D,PC]
      LDY   0,X
      LDY   1,+X
      LDY   8,-X
      LDY   1,X+
      LDY   8,X-
      LDY   0,Y
      LDY   1,+Y
      LDY   8,-Y
      LDY   1,Y+
      LDY   8,Y-
      LDY   0,SP
      LDY   1,+SP
      LDY   8,-SP
      LDY   1,SP+
      LDY   8,SP-
      LDY   $946E,PC
      LDY   $E1,X
      LDY   $E3E4,X
      LDY   [$E4E5,X]
      LDY   A,X
      LDY   B,X
      LDY   D,X
      LDY   [D,X]
      LDY   $E9,Y
      LDY   $EBEC,Y
      LDY   [$ECED,Y]
      LDY   A,Y
      LDY   B,Y
      LDX   [D,Y]
      LDX   $F1,SP
      LDX   $F3F4,SP
      LDX   [$F4F5,SP]
      LDX   A,SP
      LDX   B,SP
      LDX   D,SP
      LDX   [D,SP]
      LDX   $95A1,PC
      LDX   <$94AB,PC
      LDX   $90AB,PC
      LDX   >$93B3,PC
      LDX   [$91B4,PC]
      LDX   A,PC
      LDX   B,PC
      LDX   D,PC
      LDX   [D,PC]
      LDX   0,X
      LDX   1,+X
      LDX   8,-X
      LDX   1,X+
      LDX   8,X-
      LDX   0,Y
      LDX   1,+Y
      LDX   8,-Y
      LDX   1,Y+
      LDX   8,Y-
      LDX   0,SP
      LDX   1,+SP
      LDX   8,-SP
      LDX   1,SP+
      LDX   8,SP-
      LDX   $94DF,PC
      LDX   $E1,X
      LDX   $E3E4,X
      LDX   [$E4E5,X]
      LDX   A,X
      LDX   B,X
      LDX   D,X
      LDX   [D,X]
      LDX   $E9,Y
      LDX   $EBEC,Y
      LDX   [$ECED,Y]
      LDX   A,Y
      LDX   B,Y
      LDX   D,Y
      LDS   $F1,SP
      LDS   $F3F4,SP
      LDS   [$F4F5,SP]
      LDS   A,SP
      LDS   B,SP
      LDS   D,SP
      LDS   [D,SP]
      LDS   $9612,PC
      LDS   <$951C,PC
      LDS   $911C,PC
      LDS   >$9424,PC
      LDS   [$9225,PC]
      LDS   A,PC
      LDS   B,PC
      LDS   D,PC
      LDS   [D,PC]
      LDS   0,X
      LDS   1,+X
      LDS   8,-X
      LDS   1,X+
      LDS   8,X-
      LDS   0,Y
      LDS   1,+Y
      LDS   8,-Y
      LDS   1,Y+
      LDS   8,Y-
      LDS   0,SP
      LDS   1,+SP
      LDS   8,-SP
      LDS   1,SP+
      LDS   8,SP-
      LDS   $9550,PC
      LDS   $E1,X
      LDS   $E3E4,X
      LDS   [$E4E5,X]
      LDS   A,X
      LDS   B,X
      LDS   D,X
      LDS   [D,X]
      LDS   $E9,Y
      LDS   $EBEC,Y
      LDS   [$ECED,Y]
      LDS   A,Y
      LDS   B,Y
      LDS   D,Y
      LDS   [D,Y]
      SUBB  $F1F2
      SUBB  >$0001
      CMPB  $F2F3
      CMPB  >$0001
      SBCB  $F3F4
      SBCB  >$0001
      ADDD  $F4F5
      ADDD  >$0001
      ANDB  $F5F6
      ANDB  >$0001
      BITB  $F6F7
      BITB  >$0001
      LDAB  $F7F8
      LDAB  >$0001
      TST   $F8F9
      TST   >$0001
      EORB  $F9FA
      EORB  >$0001
      ADCB  $FAFB
      ADCB  >$0001
      ORAB  $FBFC
      ORAB  >$0001
      ADDB  $FCFD
      ADDB  >$0001
      LDD   $FDFE
      LDD   >$0001
      LDY   $FEFF
      LDY   >$0001
      LDX   $FF00
      LDX   >$0001
      LDS   >$0001
      LDS   $0102
