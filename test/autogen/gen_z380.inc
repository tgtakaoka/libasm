;;; AUTO GENERATED FILE
;;; generated by: gen_z380 -i -u -C Z380 -o gen_z380.inc -l gen_z380.lst
      NOP
      LD     BC, 0302H
      LD     (BC), A
      INC    BC
      INC    B
      DEC    B
      LD     B, 7
      RLCA
      EX     AF, AF'
      ADD    HL, BC
      LD     A, (BC)
      DEC    BC
      INC    C
      DEC    C
      LD     C, 15
      RRCA
      DJNZ   $+19
      LD     DE, 1312H
      LD     (DE), A
      INC    DE
      INC    D
      DEC    D
      LD     D, 23
      RLA
      JR     $+27
      ADD    HL, DE
      LD     A, (DE)
      DEC    DE
      INC    E
      DEC    E
      LD     E, 31
      RRA
      JR     NZ, $+35
      LD     HL, 2322H
      LD     (2423H), HL
      INC    HL
      INC    H
      DEC    H
      LD     H, 27H
      DAA
      JR     Z, $+43
      ADD    HL, HL
      LD     HL, (2C2BH)
      DEC    HL
      INC    L
      DEC    L
      LD     L, 2FH
      CPL
      JR     NC, $+51
      LD     SP, 3332H
      LD     (3433H), A
      INC    SP
      INC    (HL)
      DEC    (HL)
      LD     (HL), 37H
      SCF
      JR     C, $+59
      ADD    HL, SP
      LD     A, (3C3BH)
      DEC    SP
      INC    A
      DEC    A
      LD     A, 3FH
      CCF
      LD     B, B
      LD     B, C
      LD     B, D
      LD     B, E
      LD     B, H
      LD     B, L
      LD     B, (HL)
      LD     B, A
      LD     C, B
      LD     C, C
      LD     C, D
      LD     C, E
      LD     C, H
      LD     C, L
      LD     C, (HL)
      LD     C, A
      LD     D, B
      LD     D, C
      LD     D, D
      LD     D, E
      LD     D, H
      LD     D, L
      LD     D, (HL)
      LD     D, A
      LD     E, B
      LD     E, C
      LD     E, D
      LD     E, E
      LD     E, H
      LD     E, L
      LD     E, (HL)
      LD     E, A
      LD     H, B
      LD     H, C
      LD     H, D
      LD     H, E
      LD     H, H
      LD     H, L
      LD     H, (HL)
      LD     H, A
      LD     L, B
      LD     L, C
      LD     L, D
      LD     L, E
      LD     L, H
      LD     L, L
      LD     L, (HL)
      LD     L, A
      LD     (HL), B
      LD     (HL), C
      LD     (HL), D
      LD     (HL), E
      LD     (HL), H
      LD     (HL), L
      HALT
      LD     (HL), A
      LD     A, B
      LD     A, C
      LD     A, D
      LD     A, E
      LD     A, H
      LD     A, L
      LD     A, (HL)
      LD     A, A
      ADD    A, B
      ADD    A, C
      ADD    A, D
      ADD    A, E
      ADD    A, H
      ADD    A, L
      ADD    A, (HL)
      ADD    A, A
      ADC    A, B
      ADC    A, C
      ADC    A, D
      ADC    A, E
      ADC    A, H
      ADC    A, L
      ADC    A, (HL)
      ADC    A, A
      SUB    B
      SUB    C
      SUB    D
      SUB    E
      SUB    H
      SUB    L
      SUB    (HL)
      SUB    A
      SBC    A, B
      SBC    A, C
      SBC    A, D
      SBC    A, E
      SBC    A, H
      SBC    A, L
      SBC    A, (HL)
      SBC    A, A
      AND    B
      AND    C
      AND    D
      AND    E
      AND    H
      AND    L
      AND    (HL)
      AND    A
      XOR    B
      XOR    C
      XOR    D
      XOR    E
      XOR    H
      XOR    L
      XOR    (HL)
      XOR    A
      OR     B
      OR     C
      OR     D
      OR     E
      OR     H
      OR     L
      OR     (HL)
      OR     A
      CP     B
      CP     C
      CP     D
      CP     E
      CP     H
      CP     L
      CP     (HL)
      CP     A
      RET    NZ
      POP    BC
      JP     NZ, 0C4C3H
      JP     0C5C4H
      CALL   NZ, 0C6C5H
      PUSH   BC
      ADD    A, 0C7H
      RST    0
      RET    Z
      RET
      JP     Z, 0CCCBH
      SET    1, H
      SET    1, L
      SET    1, (HL)
      SET    1, A
      SET    2, B
      SET    2, C
      SET    2, D
      SET    2, E
      RLC    B
      RLC    C
      RLC    D
      RLC    E
      RLC    H
      RLC    L
      RLC    (HL)
      RLC    A
      RRC    B
      RRC    C
      RRC    D
      RRC    E
      RRC    H
      RRC    L
      RRC    (HL)
      RRC    A
      RL     B
      RL     C
      RL     D
      RL     E
      RL     H
      RL     L
      RL     (HL)
      RL     A
      RR     B
      RR     C
      RR     D
      RR     E
      RR     H
      RR     L
      RR     (HL)
      RR     A
      SLA    B
      SLA    C
      SLA    D
      SLA    E
      SLA    H
      SLA    L
      SLA    (HL)
      SLA    A
      SRA    B
      SRA    C
      SRA    D
      SRA    E
      SRA    H
      SRA    L
      SRA    (HL)
      SRA    A
      EX     B, B'
      EX     C, C'
      EX     D, D'
      EX     E, E'
      EX     H, H'
      EX     L, L'
      EX     A, A'
      SRL    B
      SRL    C
      SRL    D
      SRL    E
      SRL    H
      SRL    L
      SRL    (HL)
      SRL    A
      BIT    0, B
      BIT    0, C
      BIT    0, D
      BIT    0, E
      BIT    0, H
      BIT    0, L
      BIT    0, (HL)
      BIT    0, A
      RES    0, B
      RES    0, C
      RES    0, D
      RES    0, E
      RES    0, H
      RES    0, L
      RES    0, (HL)
      RES    0, A
      CALL   Z, 0CECDH
      CALL   0CFCEH
      ADC    A, 0CFH
      RET    NC
      POP    DE
      JP     NC, 0D4D3H
      OUT    (0D4H), A
      CALL   NC, 0D6D5H
      PUSH   DE
      SUB    0D7H
      RET    C
      EXX
      JP     C, 0DCDBH
      IN     A, (0DCH)
      CALL   C, 0DEDDH
      SBCW   HL, (IX-33)
      POP    IX
      EX     (SP), IX
      CALR   PO, $-1917H
      PUSH   IX
      ANDW   HL, (IX-25)
      JP     (IX)
      CALR   PE, $-110FH
      XORW   HL, (IX-17)
      DI     0F4H
      CALR   P, $-0907H
      ORW    HL, (IX-9)
      SETC   LW
      LD     SP, IX
      EI     0FCH
      CALR   M, $-00FFH
      CPW    HL, (IX-1)
      RESC   LW
      LDW    (BC), IX
      LDW    BC, DE
      LDW    IX, (BC)
      LDW    IX, BC
      ADD    IX, BC
      LDW    BC, IX
      LDW    BC, (BC)
      LDW    BC, (DE)
      LDW    BC, (HL)
      DJNZ   $+1215H
      LDW    (DE), IX
      LDW    DE, DE
      LDW    IX, (DE)
      LDW    IX, DE
      JR     $+1A1DH
      ADD    IX, DE
      LDW    DE, IX
      LDW    DE, (BC)
      LDW    DE, (DE)
      LDW    DE, (HL)
      JR     NZ, $+2225H
      LD     IX, 2322H
      LD     (2423H), IX
      INC    IX
      INC    IXU
      DEC    IXU
      LD     IXU, 27H
      LDW    IX, IY
      JR     Z, $+2A2DH
      ADD    IX, IX
      LD     IX, (2C2BH)
      DEC    IX
      INC    IXL
      DEC    IXL
      LD     IXL, 2FH
      CPLW   HL
      JR     NC, $+3235H
      LDW    (HL), IX
      LDW    HL, DE
      LDW    IX, (HL)
      INC    (IX+53)
      DEC    (IX+54)
      LD     (IX+55), 38H
      LDW    IX, HL
      JR     C, $+3A3DH
      ADD    IX, SP
      LDW    HL, IX
      LDW    HL, (BC)
      LDW    HL, (DE)
      SWAP   IX
      LDW    HL, (HL)
      INW    BC, (C)
      OUTW   (C), BC
      LD     B, IXU
      LD     B, IXL
      LD     B, (IX+71)
      LDW    I, HL
      LD     C, IXU
      LD     C, IXL
      LD     C, (IX+79)
      INW    DE, (C)
      OUTW   (C), DE
      LD     D, IXU
      LD     D, IXL
      LD     D, (IX+87)
      LDW    HL, I
      LD     E, IXU
      LD     E, IXL
      LD     E, (IX+95)
      LD     IXU, B
      LD     IXU, C
      LD     IXU, D
      LD     IXU, E
      LD     IXU, IXU
      LD     IXU, IXL
      LD     H, (IX+103)
      LD     IXU, A
      LD     IXL, B
      LD     IXL, C
      LD     IXL, D
      LD     IXL, E
      LD     IXL, IXU
      LD     IXL, IXL
      LD     L, (IX+111)
      LD     IXL, A
      LD     (IX+113), B
      LD     (IX+114), C
      LD     (IX+115), D
      LD     (IX+116), E
      LD     (IX+117), H
      LD     (IX+118), L
      LD     (IX+120), A
      INW    HL, (C)
      OUTW   (C), HL
      LD     A, IXU
      LD     A, IXL
      LD     A, (IX+127)
      ADD    A, IXU
      ADD    A, IXL
      ADD    A, (IX-121)
      ADDW   HL, IX
      ADC    A, IXU
      ADC    A, IXL
      ADC    A, (IX-113)
      ADCW   HL, IX
      SUB    A, IXU
      SUB    A, IXL
      SUB    (IX-105)
      SUBW   HL, IX
      SBC    A, IXU
      SBC    A, IXL
      SBC    A, (IX-97)
      SBCW   HL, IX
      AND    A, IXU
      AND    A, IXL
      AND    (IX-89)
      ANDW   HL, IX
      XOR    A, IXU
      XOR    A, IXL
      XOR    (IX-81)
      XORW   HL, IX
      OR     A, IXU
      OR     A, IXL
      OR     (IX-73)
      ORW    HL, IX
      CP     A, IXU
      CP     A, IXL
      CP     (IX-65)
      CPW    HL, IX
      POP    BC
      PUSH   BC
      EX     B, B'
      EX     C, C'
      EX     D, D'
      EX     E, E'
      EX     H, H'
      EX     L, L'
      EX     A, A'
      POP    DE
      PUSH   DE
      POP    IX
      EX     (SP), IX
      PUSH   IX
      LD     SP, IX
      LDW    (BC), IX
      LDW    BC, DE
      LDW    IX, (BC)
      LDW    IX, BC
      LDW    BC, IX
      LDW    BC, (BC)
      LDW    BC, (DE)
      LDW    BC, (HL)
      LDW    (DE), IX
      LDW    DE, DE
      LDW    IX, (DE)
      LDW    IX, DE
      LDW    DE, IX
      LDW    DE, (BC)
      LDW    DE, (DE)
      LDW    DE, (HL)
      LD     (2423H), IX
      LDW    IX, IY
      LD     IX, (2C2BH)
      LDW    (HL), IX
      LDW    HL, DE
      LDW    IX, (HL)
      LDW    IX, HL
      LDW    HL, IX
      LDW    HL, (BC)
      LDW    HL, (DE)
      LDW    HL, (HL)
      LDW    I, HL
      LDW    HL, I
      LDW    BC, (SP-52)
      LDW    BC, (IX-52)
      LDW    (SP-52), BC
      LDW    (IX-52), BC
      LDW    DE, (SP-52)
      LDW    DE, (IX-52)
      LDW    (SP-52), DE
      LDW    (IX-52), DE
      LDW    IX, (SP-52)
      LDW    IY, (IX-52)
      LDW    (SP-52), IX
      LDW    (IX-52), IY
      LDW    HL, (SP-52)
      LDW    HL, (IX-52)
      LDW    (SP-52), HL
      LDW    (IX-52), HL
      POP    HL
      EX     (SP), HL
      PUSH   HL
      EX     DE, HL
      LDIRW
      LDDRW
      LDW    BC, BC
      EX     BC, IX
      EX     BC, DE
      LDW    (BC), 0807H
      EX     BC, IY
      EX     BC, HL
      LDW    DE, BC
      EX     DE, IX
      LDW    (DE), 1817H
      EX     DE, IY
      EX     IX, IY
      LDW    HL, BC
      EX     HL, IX
      LDW    (HL), 3837H
      EX     HL, IY
      LD     (4544H), BC
      LD     BC, (4D4CH)
      LD     (5554H), DE
      LD     DE, (5D5CH)
      EXTS   A
      LDW    HL, (6D6CH)
      LD     (7574H), SP
      LD     SP, (7D7CH)
      LDCTL  HL, SR
      POP    SR
      PUSH   SR
      LDCTL  SR, HL
      EX     BC, BC'
      EX     DE, DE'
      EX     HL, HL'
      EX     IX, IX'
      EX     IY, IY'
      LDIW
      LDDW
      POP    AF
      PUSH   AF
      LD     SP, HL
      LDW    (BC), IY
      LDW    BC, HL
      LDW    IY, (BC)
      LDW    IY, BC
      LDW    BC, IY
      LDW    (BC), BC
      LDW    (DE), BC
      LDW    (HL), BC
      LDW    (DE), IY
      LDW    DE, HL
      LDW    IY, (DE)
      LDW    IY, DE
      LDW    DE, IY
      LDW    (BC), DE
      LDW    (DE), DE
      LDW    (HL), DE
      LD     (2423H), IY
      LDW    IY, IX
      LD     IY, (2C2BH)
      LDW    (HL), IY
      LDW    HL, HL
      LDW    IY, (HL)
      LDW    IY, HL
      LDW    HL, IY
      LDW    (BC), HL
      LDW    (DE), HL
      LDW    (HL), HL
      LDW    BC, (IY-52)
      LDW    (IY-52), BC
      LDW    DE, (IY-52)
      LDW    (IY-52), DE
      LDW    IY, (SP-52)
      LDW    IX, (IY-52)
      LDW    (SP-52), IY
      LDW    (IY-52), IX
      LDW    HL, (IY-52)
      LDW    (IY-52), HL
      POP    IY
      EX     (SP), IY
      PUSH   IY
      LD     SP, IY
      LD     (2423H), HL
      LD     HL, (2C2BH)
      LD     (252423H), IX
      LD     IX, (2D2C2BH)
      LDW    BC, (SP-3234H)
      LDW    BC, (IX-3234H)
      LDW    (SP-3234H), BC
      LDW    (IX-3234H), BC
      LDW    DE, (SP-3234H)
      LDW    DE, (IX-3234H)
      LDW    (SP-3234H), DE
      LDW    (IX-3234H), DE
      LDW    IX, (SP-3234H)
      LDW    IY, (IX-3234H)
      LDW    (SP-3234H), IX
      LDW    (IX-3234H), IY
      LDW    HL, (SP-3234H)
      LDW    HL, (IX-3234H)
      LDW    (SP-3234H), HL
      LDW    (IX-3234H), HL
      LDW    (BC), 090807H
      LDW    (DE), 191817H
      LDW    (HL), 393837H
      LD     (464544H), BC
      LD     BC, (4E4D4CH)
      LD     (565554H), DE
      LD     DE, (5E5D5CH)
      LDW    HL, (6E6D6CH)
      LD     (767574H), SP
      LD     SP, (7E7D7CH)
      LD     (252423H), IY
      LD     IY, (2D2C2BH)
      LDW    BC, (IY-3234H)
      LDW    (IY-3234H), BC
      LDW    DE, (IY-3234H)
      LDW    (IY-3234H), DE
      LDW    IY, (SP-3234H)
      LDW    IX, (IY-3234H)
      LDW    (SP-3234H), IY
      LDW    (IY-3234H), IX
      LDW    HL, (IY-3234H)
      LDW    (IY-3234H), HL
      LD     (252423H), HL
      LD     HL, (2D2C2BH)
      LD     (26252423H), IX
      LD     IX, (2E2D2C2BH)
      LDW    BC, (SP-313234H)
      LDW    BC, (IX-313234H)
      LDW    (SP-313234H), BC
      LDW    (IX-313234H), BC
      LDW    DE, (SP-313234H)
      LDW    DE, (IX-313234H)
      LDW    (SP-313234H), DE
      LDW    (IX-313234H), DE
      LDW    IX, (SP-313234H)
      LDW    IY, (IX-313234H)
      LDW    (SP-313234H), IX
      LDW    (IX-313234H), IY
      LDW    HL, (SP-313234H)
      LDW    HL, (IX-313234H)
      LDW    (SP-313234H), HL
      LDW    (IX-313234H), HL
      LDW    (BC), 0A090807H
      LDW    (DE), 1A191817H
      LDW    (HL), 3A393837H
      LD     (47464544H), BC
      LD     BC, (4F4E4D4CH)
      LD     (57565554H), DE
      LD     DE, (5F5E5D5CH)
      LDW    HL, (6F6E6D6CH)
      LD     (77767574H), SP
      LD     SP, (7F7E7D7CH)
      LD     (26252423H), IY
      LD     IY, (2E2D2C2BH)
      LDW    BC, (IY-313234H)
      LDW    (IY-313234H), BC
      LDW    DE, (IY-313234H)
      LDW    (IY-313234H), DE
      LDW    IY, (SP-313234H)
      LDW    IX, (IY-313234H)
      LDW    (SP-313234H), IY
      LDW    (IY-313234H), IX
      LDW    HL, (IY-313234H)
      LDW    (IY-313234H), HL
      LD     (26252423H), HL
      LD     HL, (2E2D2C2BH)
      CALL   NZ, 0C7C6C5H
      JP     Z, 0CDCCCBH
      CALL   Z, 0CFCECDH
      CALL   0D0CFCEH
      JP     NC, 0D5D4D3H
      CALL   NC, 0D7D6D5H
      JP     C, 0DDDCDBH
      CALL   C, 0DFDEDDH
      SBCW   HL, (IX-1F21H)
      ANDW   HL, (IX-1719H)
      XORW   HL, (IX-0F11H)
      ORW    HL, (IX-0709H)
      CPW    HL, (IX+00FFH)
      LD     IX, 242322H
      INC    (IX+3635H)
      DEC    (IX+3736H)
      LD     (IX+3837H), 39H
      LD     B, (IX+4847H)
      LD     C, (IX+504FH)
      LD     D, (IX+5857H)
      LD     E, (IX+605FH)
      LD     H, (IX+6867H)
      LD     L, (IX+706FH)
      LD     (IX+7271H), B
      LD     (IX+7372H), C
      LD     (IX+7473H), D
      LD     (IX+7574H), E
      LD     (IX+7675H), H
      LD     (IX+7776H), L
      LD     (IX+7978H), A
      LD     A, (IX-7F81H)
      ADD    A, (IX-7779H)
      ADC    A, (IX-6F71H)
      SUB    (IX-6769H)
      SBC    A, (IX-5F61H)
      AND    (IX-5759H)
      XOR    (IX-4F51H)
      OR     (IX-4749H)
      CP     (IX-3F41H)
      ADDW   HL, (IX-3739H)
      SET    1, (IX-3234H)
      RLCW   (IX-3234H)
      RLC    (IX-3234H)
      RRCW   (IX-3234H)
      RRC    (IX-3234H)
      RLW    (IX-3234H)
      RL     (IX-3234H)
      RRW    (IX-3234H)
      RR     (IX-3234H)
      SLAW   (IX-3234H)
      SLA    (IX-3234H)
      SRAW   (IX-3234H)
      SRA    (IX-3234H)
      SRLW   (IX-3234H)
      SRL    (IX-3234H)
      BIT    0, (IX-3234H)
      RES    0, (IX-3234H)
      MULTW  HL, (IX-3234H)
      MULTUW HL, (IX-3234H)
      DIVUW  HL, (IX-3234H)
      ADCW   HL, (IX-2F31H)
      SUBW   HL, (IX-2729H)
      JP     PO, 0E5E4E3H
      CALL   PO, 0E7E6E5H
      JP     PE, 0EDECEBH
      CALL   PE, 0EFEEEDH
      LDW    (666564H), HL
      ADD    SP, 858483H
      SUB    SP, 959493H
      ADD    HL, (0C9C8C7H)
      OUTA   (0D6D5D4H), A
      SUB    HL, (0D9D8D7H)
      INA    A, (0DEDDDCH)
      JP     P, 0F5F4F3H
      CALL   P, 0F7F6F5H
      JP     M, 0FDFCFBH
      CALL   M, 0FFFEFDH
      CPW    HL, (IY+00FFH)
      LD     IY, 242322H
      INC    (IY+3635H)
      DEC    (IY+3736H)
      LD     (IY+3837H), 39H
      LD     B, (IY+4847H)
      LD     C, (IY+504FH)
      LD     D, (IY+5857H)
      LD     E, (IY+605FH)
      LD     H, (IY+6867H)
      LD     L, (IY+706FH)
      LD     (IY+7271H), B
      LD     (IY+7372H), C
      LD     (IY+7473H), D
      LD     (IY+7574H), E
      LD     (IY+7675H), H
      LD     (IY+7776H), L
      LD     (IY+7978H), A
      LD     A, (IY-7F81H)
      ADD    A, (IY-7779H)
      ADC    A, (IY-6F71H)
      SUB    (IY-6769H)
      SBC    A, (IY-5F61H)
      AND    (IY-5759H)
      XOR    (IY-4F51H)
      OR     (IY-4749H)
      CP     (IY-3F41H)
      ADDW   HL, (IY-3739H)
      SET    1, (IY-3234H)
      RLCW   (IY-3234H)
      RLC    (IY-3234H)
      RRCW   (IY-3234H)
      RRC    (IY-3234H)
      RLW    (IY-3234H)
      RL     (IY-3234H)
      RRW    (IY-3234H)
      RR     (IY-3234H)
      SLAW   (IY-3234H)
      SLA    (IY-3234H)
      SRAW   (IY-3234H)
      SRA    (IY-3234H)
      SRLW   (IY-3234H)
      SRL    (IY-3234H)
      BIT    0, (IY-3234H)
      RES    0, (IY-3234H)
      MULTW  HL, (IY-3234H)
      MULTUW HL, (IY-3234H)
      DIVUW  HL, (IY-3234H)
      ADCW   HL, (IY-2F31H)
      OUTAW  (0D6D5D4H), HL
      SUBW   HL, (IY-2729H)
      INAW   HL, (0DEDDDCH)
      SBCW   HL, (IY-1F21H)
      ANDW   HL, (IY-1719H)
      XORW   HL, (IY-0F11H)
      PUSH   0F8F7F6H
      ORW    HL, (IY-0709H)
      LD     BC, 040302H
      LD     DE, 141312H
      LD     HL, 242322H
      LD     SP, 343332H
      LD     (353433H), A
      LD     A, (3D3C3BH)
      JP     NZ, 0C5C4C3H
      JP     0C6C5C4H
      CALR   NZ, $-3937H
      ADDW   HL, (IX-57)
      LDCTL  SR, A
      LDCTL  SR, 0CBH
      SET    1, (IX-52)
      LDW    BC, (SP-52)
      RLCW   (IX-52)
      LDW    BC, (IX-52)
      RLC    (IX-52)
      LDW    (SP-52), BC
      RRCW   (IX-52)
      LDW    (IX-52), BC
      RRC    (IX-52)
      LDW    DE, (SP-52)
      RLW    (IX-52)
      LDW    DE, (IX-52)
      RL     (IX-52)
      LDW    (SP-52), DE
      RRW    (IX-52)
      LDW    (IX-52), DE
      RR     (IX-52)
      LDW    IX, (SP-52)
      SLAW   (IX-52)
      LDW    IY, (IX-52)
      SLA    (IX-52)
      LDW    (SP-52), IX
      SRAW   (IX-52)
      LDW    (IX-52), IY
      SRA    (IX-52)
      LDW    HL, (SP-52)
      LDW    HL, (IX-52)
      LDW    (SP-52), HL
      SRLW   (IX-52)
      LDW    (IX-52), HL
      SRL    (IX-52)
      BIT    0, (IX-52)
      RES    0, (IX-52)
      MULTW  HL, (IX-52)
      MULTUW HL, (IX-52)
      DIVUW  HL, (IX-52)
      CALR   Z, $-312FH
      CALR   $-302EH
      ADCW   HL, (IX-49)
      MTEST
      LDCTL  A, XSR
      CALR   NC, $-2927H
      SUBW   HL, (IX-41)
      LDCTL  XSR, A
      EXXX
      LDCTL  XSR, 0DBH
      CALR   C, $-211FH
      SBC    A, 0DFH
      RET    PO
      POP    HL
      JP     PO, 0E4E3H
      EX     (SP), HL
      CALL   PO, 0E6E5H
      PUSH   HL
      AND    0E7H
      RET    PE
      JP     (HL)
      JP     PE, 0ECEBH
      EX     DE, HL
      CALL   PE, 0EEEDH
      LDIRW
      INIRW
      OTIRW
      CALR   P, $-8
      SETC   LCK
      LDDRW
      INDRW
      OTDRW
      CALR   M, $
      RESC   LCK
      IN0    B, (1)
      OUT0   (2), B
      LDW    BC, BC
      EX     BC, IX
      TST    B
      EX     BC, DE
      LDW    (BC), 0807H
      EX     A, B
      IN0    C, (9)
      OUT0   (10), C
      EX     BC, IY
      TST    C
      EX     BC, HL
      SWAP   BC
      EX     A, C
      IN0    D, (17)
      OUT0   (18), D
      LDW    DE, BC
      EX     DE, IX
      TST    D
      LDW    (DE), 1817H
      EX     A, D
      IN0    E, (25)
      OUT0   (26), E
      EX     DE, IY
      TST    E
      SWAP   DE
      EX     A, E
      IN0    H, (21H)
      OUT0   (22H), H
      TST    H
      EX     A, H
      IN0    L, (29H)
      OUT0   (2AH), L
      EX     IX, IY
      TST    L
      EX     A, L
      IN0    (31H)
      LDW    HL, BC
      EX     HL, IX
      TST    (HL)
      LDW    (HL), 3837H
      EX     A, (HL)
      IN0    A, (39H)
      OUT0   (3AH), A
      EX     HL, IY
      TST    A
      SWAP   HL
      EX     A, A
      IN     B, (C)
      OUT    (C), B
      SBC    HL, BC
      LD     (4544H), BC
      NEG
      RETN
      IM     0
      LD     I, A
      IN     C, (C)
      OUT    (C), C
      ADC    HL, BC
      LD     BC, (4D4CH)
      MLT    BC
      RETI
      LD     R, A
      IN     D, (C)
      OUT    (C), D
      SBC    HL, DE
      LD     (5554H), DE
      NEGW   HL
      RETB
      LD     A, I
      IN     E, (C)
      OUT    (C), E
      ADC    HL, DE
      LD     DE, (5D5CH)
      MLT    DE
      LD     A, R
      IN     H, (C)
      OUT    (C), H
      SBC    HL, HL
      LDW    (6564H), HL
      TST    65H
      EXTS   A
      RRD
      IN     L, (C)
      OUT    (C), L
      ADC    HL, HL
      LDW    HL, (6D6CH)
      MLT    HL
      RLD
      OUT    (C), 72H
      SBC    HL, SP
      LD     (7574H), SP
      TSTIO  75H
      EXTSW  HL
      SLP
      IN     A, (C)
      OUT    (C), A
      ADC    HL, SP
      LD     SP, (7D7CH)
      MLT    SP
      ADD    SP, 8483H
      OTIM
      ADDW   HL, BC
      ADDW   HL, DE
      ADDW   HL, 8887H
      ADDW   HL, HL
      OTDM
      ADCW   HL, BC
      ADCW   HL, DE
      ADCW   HL, 908FH
      ADCW   HL, HL
      SUB    SP, 9493H
      OTIMR
      SUBW   HL, BC
      SUBW   HL, DE
      SUBW   HL, 9897H
      SUBW   HL, HL
      OTDMR
      SBCW   HL, BC
      SBCW   HL, DE
      SBCW   HL, 0A09FH
      SBCW   HL, HL
      LDI
      CPI
      INI
      OUTI
      ANDW   HL, BC
      ANDW   HL, DE
      ANDW   HL, 0A8A7H
      ANDW   HL, HL
      LDD
      CPD
      IND
      OUTD
      XORW   HL, BC
      XORW   HL, DE
      XORW   HL, 0B0AFH
      XORW   HL, HL
      LDIR
      CPIR
      INIR
      OTIR
      ORW    HL, BC
      ORW    HL, DE
      ORW    HL, 0B8B7H
      ORW    HL, HL
      LDDR
      CPDR
      INDR
      OTDR
      CPW    HL, BC
      CPW    HL, DE
      CPW    HL, 0C0BFH
      CPW    HL, HL
      LDCTL  HL, SR
      POP    SR
      CALR   NZ, $-56
      PUSH   SR
      ADD    HL, (0C8C7H)
      LDCTL  SR, HL
      RLCW   BC
      RLCW   DE
      RLCW   (HL)
      RLCW   HL
      RLCW   IX
      RLCW   IY
      RRCW   BC
      RRCW   DE
      RRCW   (HL)
      RRCW   HL
      RRCW   IX
      RRCW   IY
      RLW    BC
      RLW    DE
      RLW    (HL)
      RLW    HL
      RLW    IX
      RLW    IY
      RRW    BC
      RRW    DE
      RRW    (HL)
      RRW    HL
      RRW    IX
      RRW    IY
      SLAW   BC
      SLAW   DE
      SLAW   (HL)
      SLAW   HL
      SLAW   IX
      SLAW   IY
      SRAW   BC
      SRAW   DE
      SRAW   (HL)
      SRAW   HL
      SRAW   IX
      SRAW   IY
      EX     BC, BC'
      EX     DE, DE'
      EX     HL, HL'
      EX     IX, IX'
      EX     IY, IY'
      SRLW   BC
      SRLW   DE
      SRLW   (HL)
      SRLW   HL
      SRLW   IX
      SRLW   IY
      MULTW  HL, BC
      MULTW  HL, DE
      MULTW  HL, HL
      MULTW  HL, IX
      MULTW  HL, IY
      MULTW  HL, 9998H
      MULTUW HL, BC
      MULTUW HL, DE
      MULTUW HL, HL
      MULTUW HL, IX
      MULTUW HL, IY
      MULTUW HL, 0A1A0H
      DIVUW  HL, BC
      DIVUW  HL, DE
      DIVUW  HL, HL
      DIVUW  HL, IX
      DIVUW  HL, IY
      DIVUW  HL, 0C1C0H
      CALR   Z, $-48
      CALR   $-47
      BTEST
      LDCTL  A, DSR
      OUTA   (0D5D4H), A
      CALR   NC, $-40
      SUB    HL, (0D8D7H)
      LDCTL  DSR, A
      EXALL
      LDCTL  DSR, 0DBH
      INA    A, (0DDDCH)
      CALR   C, $-32
      LDIW
      INIW
      OUTIW
      CALR   PO, $-24
      LDDW
      INDW
      OUTDW
      CALR   PE, $-16
      XOR    0EFH
      RET    P
      POP    AF
      JP     P, 0F4F3H
      DI
      CALL   P, 0F6F5H
      PUSH   AF
      OR     0F7H
      RET    M
      LD     SP, HL
      JP     M, 0FCFBH
      EI
      CALL   M, 0FEFDH
      CPW    HL, (IY-1)
      LDW    (BC), IY
      LDW    BC, HL
      LDW    IY, (BC)
      LDW    IY, BC
      ADD    IY, BC
      LDW    BC, IY
      LDW    (BC), BC
      LDW    (DE), BC
      LDW    (HL), BC
      DJNZ   $+131216H
      LDW    (DE), IY
      LDW    DE, HL
      LDW    IY, (DE)
      LDW    IY, DE
      JR     $+1B1A1EH
      ADD    IY, DE
      LDW    DE, IY
      LDW    (BC), DE
      LDW    (DE), DE
      LDW    (HL), DE
      JR     NZ, $+232226H
      LD     IY, 2322H
      LD     (2423H), IY
      INC    IY
      INC    IYU
      DEC    IYU
      LD     IYU, 27H
      LDW    IY, IX
      JR     Z, $+2B2A2EH
      ADD    IY, IY
      LD     IY, (2C2BH)
      DEC    IY
      INC    IYL
      DEC    IYL
      LD     IYL, 2FH
      JR     NC, $+333236H
      LDW    (HL), IY
      LDW    HL, HL
      LDW    IY, (HL)
      INC    (IY+53)
      DEC    (IY+54)
      LD     (IY+55), 38H
      LDW    IY, HL
      JR     C, $+3B3A3EH
      ADD    IY, SP
      LDW    HL, IY
      LDW    (BC), HL
      LDW    (DE), HL
      SWAP   IY
      LDW    (HL), HL
      LD     B, IYU
      LD     B, IYL
      LD     B, (IY+71)
      LD     C, IYU
      LD     C, IYL
      LD     C, (IY+79)
      LD     D, IYU
      LD     D, IYL
      LD     D, (IY+87)
      LD     E, IYU
      LD     E, IYL
      LD     E, (IY+95)
      LD     IYU, B
      LD     IYU, C
      LD     IYU, D
      LD     IYU, E
      LD     IYU, IYU
      LD     IYU, IYL
      LD     H, (IY+103)
      LD     IYU, A
      LD     IYL, B
      LD     IYL, C
      LD     IYL, D
      LD     IYL, E
      LD     IYL, IYU
      LD     IYL, IYL
      LD     L, (IY+111)
      LD     IYL, A
      LD     (IY+113), B
      LD     (IY+114), C
      LD     (IY+115), D
      LD     (IY+116), E
      LD     (IY+117), H
      LD     (IY+118), L
      LD     (IY+120), A
      OUTW   (C), 7B7AH
      LD     A, IYU
      LD     A, IYL
      LD     A, (IY+127)
      ADD    A, IYU
      ADD    A, IYL
      ADD    A, (IY-121)
      ADDW   HL, IY
      ADC    A, IYU
      ADC    A, IYL
      ADC    A, (IY-113)
      ADCW   HL, IY
      SUB    A, IYU
      SUB    A, IYL
      SUB    (IY-105)
      SUBW   HL, IY
      SBC    A, IYU
      SBC    A, IYL
      SBC    A, (IY-97)
      SBCW   HL, IY
      AND    A, IYU
      AND    A, IYL
      AND    (IY-89)
      ANDW   HL, IY
      XOR    A, IYU
      XOR    A, IYL
      XOR    (IY-81)
      XORW   HL, IY
      OR     A, IYU
      OR     A, IYL
      OR     (IY-73)
      ORW    HL, IY
      CP     A, IYU
      CP     A, IYL
      CP     (IY-65)
      CPW    HL, IY
      LD     IX, 2322H
      LD     IY, 2322H
      PUSH   0F7F6H
      LD     BC, 0302H
      LD     DE, 1312H
      LD     HL, 2322H
      LD     SP, 3332H
      LD     IX, 25242322H
      LD     IY, 25242322H
      PUSH   0F9F8F7F6H
      LD     BC, 05040302H
      LD     DE, 15141312H
      LD     HL, 25242322H
      LD     SP, 35343332H
      CALL   NZ, 0C8C7C6C5H
      JP     Z, 0CECDCCCBH
      CALL   Z, 0D0CFCECDH
      CALL   0D1D0CFCEH
      JP     NC, 0D6D5D4D3H
      CALL   NC, 0D8D7D6D5H
      JP     C, 0DEDDDCDBH
      CALL   C, 0E0DFDEDDH
      SBCW   HL, (IX-1E1F21H)
      ANDW   HL, (IX-161719H)
      XORW   HL, (IX-0E0F11H)
      ORW    HL, (IX-060709H)
      CPW    HL, (IX+0100FFH)
      INC    (IX+373635H)
      DEC    (IX+383736H)
      LD     (IX+393837H), 3AH
      LD     B, (IX+494847H)
      LD     C, (IX+51504FH)
      LD     D, (IX+595857H)
      LD     E, (IX+61605FH)
      LD     H, (IX+696867H)
      LD     L, (IX+71706FH)
      LD     (IX+737271H), B
      LD     (IX+747372H), C
      LD     (IX+757473H), D
      LD     (IX+767574H), E
      LD     (IX+777675H), H
      LD     (IX+787776H), L
      LD     (IX+7A7978H), A
      LD     A, (IX-7E7F81H)
      ADD    A, (IX-767779H)
      ADC    A, (IX-6E6F71H)
      SUB    (IX-666769H)
      SBC    A, (IX-5E5F61H)
      AND    (IX-565759H)
      XOR    (IX-4E4F51H)
      OR     (IX-464749H)
      CP     (IX-3E3F41H)
      ADDW   HL, (IX-363739H)
      SET    2, (IX-313234H)
      RLCW   (IX-313234H)
      RLC    (IX-313234H)
      RRCW   (IX-313234H)
      RRC    (IX-313234H)
      RLW    (IX-313234H)
      RL     (IX-313234H)
      RRW    (IX-313234H)
      RR     (IX-313234H)
      SLAW   (IX-313234H)
      SLA    (IX-313234H)
      SRAW   (IX-313234H)
      SRA    (IX-313234H)
      SRLW   (IX-313234H)
      SRL    (IX-313234H)
      BIT    0, (IX-313234H)
      RES    0, (IX-313234H)
      MULTW  HL, (IX-313234H)
      MULTUW HL, (IX-313234H)
      DIVUW  HL, (IX-313234H)
      ADCW   HL, (IX-2E2F31H)
      SUBW   HL, (IX-262729H)
      JP     PO, 0E6E5E4E3H
      CALL   PO, 0E8E7E6E5H
      JP     PE, 0EEEDECEBH
      CALL   PE, 0F0EFEEEDH
      LDW    (67666564H), HL
      ADD    SP, 86858483H
      SUB    SP, 96959493H
      ADD    HL, (0CAC9C8C7H)
      OUTA   (0D7D6D5D4H), A
      SUB    HL, (0DAD9D8D7H)
      INA    A, (0DFDEDDDCH)
      JP     P, 0F6F5F4F3H
      CALL   P, 0F8F7F6F5H
      JP     M, 0FEFDFCFBH
      CALL   M, 00FFFEFDH
      CPW    HL, (IY+0100FFH)
      INC    (IY+373635H)
      DEC    (IY+383736H)
      LD     (IY+393837H), 3AH
      LD     B, (IY+494847H)
      LD     C, (IY+51504FH)
      LD     D, (IY+595857H)
      LD     E, (IY+61605FH)
      LD     H, (IY+696867H)
      LD     L, (IY+71706FH)
      LD     (IY+737271H), B
      LD     (IY+747372H), C
      LD     (IY+757473H), D
      LD     (IY+767574H), E
      LD     (IY+777675H), H
      LD     (IY+787776H), L
      LD     (IY+7A7978H), A
      LD     A, (IY-7E7F81H)
      ADD    A, (IY-767779H)
      ADC    A, (IY-6E6F71H)
      SUB    (IY-666769H)
      SBC    A, (IY-5E5F61H)
      AND    (IY-565759H)
      XOR    (IY-4E4F51H)
      OR     (IY-464749H)
      CP     (IY-3E3F41H)
      ADDW   HL, (IY-363739H)
      SET    2, (IY-313234H)
      RLCW   (IY-313234H)
      RLC    (IY-313234H)
      RRCW   (IY-313234H)
      RRC    (IY-313234H)
      RLW    (IY-313234H)
      RL     (IY-313234H)
      RRW    (IY-313234H)
      RR     (IY-313234H)
      SLAW   (IY-313234H)
      SLA    (IY-313234H)
      SRAW   (IY-313234H)
      SRA    (IY-313234H)
      SRLW   (IY-313234H)
      SRL    (IY-313234H)
      BIT    0, (IY-313234H)
      RES    0, (IY-313234H)
      MULTW  HL, (IY-313234H)
      MULTUW HL, (IY-313234H)
      DIVUW  HL, (IY-313234H)
      ADCW   HL, (IY-2E2F31H)
      OUTAW  (0D7D6D5D4H), HL
      SUBW   HL, (IY-262729H)
      INAW   HL, (0DFDEDDDCH)
      SBCW   HL, (IY-1E1F21H)
      ANDW   HL, (IY-161719H)
      XORW   HL, (IY-0E0F11H)
      ORW    HL, (IY-060709H)
      LD     (36353433H), A
      LD     A, (3E3D3C3BH)
      JP     NZ, 0C6C5C4C3H
      JP     0C7C6C5C4H
      CALR   NZ, $-003936H
      ADDW   HL, (IY-57)
      SET    1, (IY-52)
      RLCW   (IY-52)
      LDW    BC, (IY-52)
      RLC    (IY-52)
      RRCW   (IY-52)
      LDW    (IY-52), BC
      RRC    (IY-52)
      RLW    (IY-52)
      LDW    DE, (IY-52)
      RL     (IY-52)
      RRW    (IY-52)
      LDW    (IY-52), DE
      RR     (IY-52)
      LDW    IY, (SP-52)
      SLAW   (IY-52)
      LDW    IX, (IY-52)
      SLA    (IY-52)
      LDW    (SP-52), IY
      SRAW   (IY-52)
      LDW    (IY-52), IX
      SRA    (IY-52)
      LDW    HL, (IY-52)
      SRLW   (IY-52)
      LDW    (IY-52), HL
      SRL    (IY-52)
      BIT    0, (IY-52)
      RES    0, (IY-52)
      MULTW  HL, (IY-52)
      MULTUW HL, (IY-52)
      DIVUW  HL, (IY-52)
      CALR   Z, $-00312EH
      CALR   $-00302DH
      ADCW   HL, (IY-49)
      LDCTL  A, YSR
      OUTAW  (0D5D4H), HL
      CALR   NC, $-002926H
      SUBW   HL, (IY-41)
      LDCTL  YSR, A
      EXXY
      LDCTL  YSR, 0DBH
      INAW   HL, (0DDDCH)
      CALR   C, $-00211EH
      SBCW   HL, (IY-33)
      POP    IY
      EX     (SP), IY
      CALR   PO, $-001916H
      PUSH   IY
      ANDW   HL, (IY-25)
      JP     (IY)
      CALR   PE, $-01110EH
      XORW   HL, (IY-17)
      CALR   P, $-010906H
      PUSH   0F7F6H
      ORW    HL, (IY-9)
      SETC   XM
      LD     SP, IY
      CALR   M, $-0000FEH
      CP     0FFH
