;;; AUTO GENERATED FILE
;;; generated by: gen_cp1600 -i -u -C CP1600 -o gen_cp1600.inc -l gen_cp1600.lst
      HLT
      SDBD
      MVI@  R1, R0
      SDBD
      ADD@  R1, R0
      SDBD
      SUB@  R1, R0
      SDBD
      CMP@  R1, R0
      SDBD
      AND@  R1, R0
      SDBD
      XOR@  R1, R0
      EIS
      DIS
      JSRE  R5, X'0606'
      JSRD  R5, X'0607'
      JSR   R5, X'0A09'
      J     X'0001'
      JE    X'0002'
      JD    X'0003'
      TCI
      CLRC
      SETC
      INCR  R0
      DECR  R0
      COMR  R0
      NEGR  R0
      ADCR  R0
      GSWD  R0
      NOP
      NOP   2
      SIN
      SIN   2
      RSWD  R0
      SWAP  R0
      SWAP  R0, 2
      SLL   R0
      SLL   R0, 2
      RLC   R0
      RLC   R0, 2
      SLLC  R0
      SLLC  R0, 2
      SLR   R0
      SLR   R0, 2
      SAR   R0
      SAR   R0, 2
      RRC   R0
      RRC   R0, 2
      SARC  R0
      SARC  R0, 2
      TSTR  R0
      MOVR  R0, R1
      JR    R0
      ADDR  R0, R0
      SUBR  R0, R0
      CMPR  R0, R0
      ANDR  R0, R0
      CLRR  R0
      XORR  R0, R1
      B     X'034B'
      BC    X'034E'
      BOV   X'0351'
      BPL   X'0354'
      BZE   X'0357'
      BLT   X'035A'
      BLE   X'035D'
      BUSC  X'0360'
      NOPP
      BNC   X'0366'
      BNOV  X'0369'
      BMI   X'036C'
      BNZE  X'036F'
      BGE   X'0372'
      BGT   X'0375'
      BESC  X'0378'
      BEXT  X'037B', 0
      MVO   R0, X'0341'
      MVO@  R0, R1
      PSHR  R0
      MVOI  R0, X'0379'
      MVI   X'0381', R0
      MVI@  R1, R0
      PULR  R0
      MVII  X'03B9', R0
      ADD   X'03C1', R0
      ADD@  R1, R0
      ADDI  X'03F9', R0
      SUB   X'0401', R0
      SUB@  R1, R0
      SUBI  X'0439', R0
      CMP   X'0441', R0
      CMP@  R1, R0
      CMPI  X'0479', R0
      AND   X'0481', R0
      AND@  R1, R0
      ANDI  X'04B9', R0
      XOR   X'04C1', R0
      XOR@  R1, R0
      XORI  X'04F9', R0
