;;; AUTO GENERATED FILE
;;; generated by: gen_z280 -u -C Z280 -o gen_z280.asm -l gen_z280.lst
      CPU    Z280
      ORG    0100H
      NOP
      LD     BC, 0302H
      LD     (BC), A
      INC    BC
      INC    B
      DEC    B
      LD     B, 7
      RLCA
      EX     AF, AF'
      ADD    HL, BC
      LD     A, (BC)
      DEC    BC
      INC    C
      DEC    C
      LD     C, 15
      RRCA
      DJNZ   $+19
      LD     DE, 1312H
      LD     (DE), A
      INC    DE
      INC    D
      DEC    D
      LD     D, 23
      RLA
      JR     $+27
      ADD    HL, DE
      LD     A, (DE)
      DEC    DE
      INC    E
      DEC    E
      LD     E, 31
      RRA
      JR     NZ, $+35
      LD     HL, 2322H
      LD     (2423H), HL
      INC    HL
      INC    H
      DEC    H
      LD     H, 27H
      DAA
      JR     Z, $+43
      ADD    HL, HL
      LD     HL, (2C2BH)
      DEC    HL
      INC    L
      DEC    L
      LD     L, 2FH
      CPL
      JR     NC, $+51
      LD     SP, 3332H
      LD     (3433H), A
      INC    SP
      INC    (HL)
      DEC    (HL)
      LD     (HL), 37H
      SCF
      JR     C, $+59
      ADD    HL, SP
      LD     A, (3C3BH)
      DEC    SP
      INC    A
      DEC    A
      LD     A, 3FH
      CCF
      LD     B, B
      LD     B, C
      LD     B, D
      LD     B, E
      LD     B, H
      LD     B, L
      LD     B, (HL)
      LD     B, A
      LD     C, B
      LD     C, C
      LD     C, D
      LD     C, E
      LD     C, H
      LD     C, L
      LD     C, (HL)
      LD     C, A
      LD     D, B
      LD     D, C
      LD     D, D
      LD     D, E
      LD     D, H
      LD     D, L
      LD     D, (HL)
      LD     D, A
      LD     E, B
      LD     E, C
      LD     E, D
      LD     E, E
      LD     E, H
      LD     E, L
      LD     E, (HL)
      LD     E, A
      LD     H, B
      LD     H, C
      LD     H, D
      LD     H, E
      LD     H, H
      LD     H, L
      LD     H, (HL)
      LD     H, A
      LD     L, B
      LD     L, C
      LD     L, D
      LD     L, E
      LD     L, H
      LD     L, L
      LD     L, (HL)
      LD     L, A
      LD     (HL), B
      LD     (HL), C
      LD     (HL), D
      LD     (HL), E
      LD     (HL), H
      LD     (HL), L
      HALT
      LD     (HL), A
      LD     A, B
      LD     A, C
      LD     A, D
      LD     A, E
      LD     A, H
      LD     A, L
      LD     A, (HL)
      LD     A, A
      ADD    A, B
      ADD    A, C
      ADD    A, D
      ADD    A, E
      ADD    A, H
      ADD    A, L
      ADD    A, (HL)
      ADD    A, A
      ADC    A, B
      ADC    A, C
      ADC    A, D
      ADC    A, E
      ADC    A, H
      ADC    A, L
      ADC    A, (HL)
      ADC    A, A
      SUB    B
      SUB    C
      SUB    D
      SUB    E
      SUB    H
      SUB    L
      SUB    (HL)
      SUB    A
      SBC    A, B
      SBC    A, C
      SBC    A, D
      SBC    A, E
      SBC    A, H
      SBC    A, L
      SBC    A, (HL)
      SBC    A, A
      AND    B
      AND    C
      AND    D
      AND    E
      AND    H
      AND    L
      AND    (HL)
      AND    A
      XOR    B
      XOR    C
      XOR    D
      XOR    E
      XOR    H
      XOR    L
      XOR    (HL)
      XOR    A
      OR     B
      OR     C
      OR     D
      OR     E
      OR     H
      OR     L
      OR     (HL)
      OR     A
      CP     B
      CP     C
      CP     D
      CP     E
      CP     H
      CP     L
      CP     (HL)
      CP     A
      RET    NZ
      POP    BC
      JP     NZ, 0C4C3H
      JP     0C5C4H
      CALL   NZ, 0C6C5H
      PUSH   BC
      ADD    A, 0C7H
      RST    0
      RET    Z
      RET
      JP     Z, 0CCCBH
      SET    1, H
      SET    1, L
      SET    1, (HL)
      SET    1, A
      SET    2, B
      SET    2, C
      SET    2, D
      SET    2, E
      RLC    B
      RLC    C
      RLC    D
      RLC    E
      RLC    H
      RLC    L
      RLC    (HL)
      RLC    A
      RRC    B
      RRC    C
      RRC    D
      RRC    E
      RRC    H
      RRC    L
      RRC    (HL)
      RRC    A
      RL     B
      RL     C
      RL     D
      RL     E
      RL     H
      RL     L
      RL     (HL)
      RL     A
      RR     B
      RR     C
      RR     D
      RR     E
      RR     H
      RR     L
      RR     (HL)
      RR     A
      SLA    B
      SLA    C
      SLA    D
      SLA    E
      SLA    H
      SLA    L
      SLA    (HL)
      SLA    A
      SRA    B
      SRA    C
      SRA    D
      SRA    E
      SRA    H
      SRA    L
      SRA    (HL)
      SRA    A
      TSET   B
      TSET   C
      TSET   D
      TSET   E
      TSET   H
      TSET   L
      TSET   (HL)
      TSET   A
      SRL    B
      SRL    C
      SRL    D
      SRL    E
      SRL    H
      SRL    L
      SRL    (HL)
      SRL    A
      BIT    0, B
      BIT    0, C
      BIT    0, D
      BIT    0, E
      BIT    0, H
      BIT    0, L
      BIT    0, (HL)
      BIT    0, A
      RES    0, B
      RES    0, C
      RES    0, D
      RES    0, E
      RES    0, H
      RES    0, L
      RES    0, (HL)
      RES    0, A
      CALL   Z, 0CECDH
      CALL   0CFCEH
      ADC    A, 0CFH
      RET    NC
      POP    DE
      JP     NC, 0D4D3H
      OUT    (0D4H), A
      CALL   NC, 0D6D5H
      PUSH   DE
      SUB    0D7H
      RET    C
      EXX
      JP     C, 0DCDBH
      IN     A, (0DCH)
      CALL   C, 0DEDDH
      POP    IX
      JP     PO, (HL)
      EX     (SP), IX
      CALL   PO, (HL)
      PUSH   IX
      JP     (IX)
      JP     PE, (HL)
      EX     IX, HL
      CALL   PE, (HL)
      SUBW   HL, IX
      MULT   A, (IX-15)
      MULTU  A, (IX-14)
      MULTW  HL, <$-0208H>
      MULTUW HL, <$-0207H>
      DIV    HL, (IX-11)
      DIVU   HL, (IX-10)
      ADDW   HL, <$-0204H>
      CPW    HL, <$-0203H>
      MULT   A, (0FAF9H)
      MULTU  A, (0FBFAH)
      DIVW   DEHL, <$-0300H>
      DIVUW  DEHL, <$-01FFH>
      DIV    HL, (0FEFDH)
      DIVU   HL, (0FFFEH)
      SUBW   HL, <$+0104H>
      LDA    IX, (SP+0403H)
      LDW    IX, (SP+0605H)
      LDW    (SP+0706H), IX
      LDW    BC, (IX+7)
      EX     A, (SP+0908H)
      LDA    IX, (HL+IX)
      LDW    IX, (HL+IX)
      LDW    (HL+IX), IX
      LDW    (IX+15), BC
      EX     A, (HL+IX)
      LDA    IX, (HL+IY)
      LDW    IX, (HL+IY)
      LDW    (HL+IY), IX
      LDW    DE, (IX+23)
      EX     A, (HL+IY)
      LDA    IX, (IX+IY)
      LDW    IX, (IX+IY)
      LDW    (IX+IY), IX
      LDW    (IX+31), DE
      EX     A, (IX+IY)
      LDA    IX, <$+2428H>
      LDW    IX, <$+262AH>
      LDW    <$+272BH>, IX
      LDW    HL, (IX+39)
      EX     A, IXH
      LDA    IX, (IX+2C2BH)
      LDW    IX, (IX+2E2DH)
      LDW    (IX+2F2EH), IX
      LDW    (IX+47), HL
      EX     A, IXL
      LDA    IX, (IY+3433H)
      LDW    IX, (IY+3635H)
      LDW    (IY+3736H), IX
      LDW    SP, (IX+55)
      EX     A, (IX+56)
      LDA    IX, (HL+3C3BH)
      LDW    IX, (HL+3E3DH)
      LDW    (HL+3F3EH), IX
      LDW    (IX+63), SP
      EX     A, (4140H)
      IN     (SP+4241H), (C)
      OUT    (C), (SP+4342H)
      SBC    IX, BC
      IN     (HL+IX), (C)
      OUT    (C), (HL+IX)
      ADC    IX, BC
      IN     (HL+IY), (C)
      OUT    (C), (HL+IY)
      SBC    IX, DE
      IN     (IX+IY), (C)
      OUT    (C), (IX+IY)
      ADC    IX, DE
      IN     IXH, (C)
      OUT    (C), IXH
      SBC    IX, IX
      LDCTL  IX, (C)
      IN     IXL, (C)
      OUT    (C), IXL
      ADC    IX, IX
      ADD    IX, A
      LDCTL  (C), IX
      SBC    IX, SP
      IN     (7A79H), (C)
      OUT    (C), (7B7AH)
      ADC    IX, SP
      LDUD   A, (IX-121)
      LDCTL  IX, USP
      LDUD   (IX-113), A
      LDCTL  USP, IX
      LDUP   A, (IX-105)
      LDUP   (IX-97), A
      MULT   A, (SP-3D3FH)
      MULTU  A, (SP-3C3EH)
      MULTW  HL, (HL)
      MULTUW HL, (HL)
      DIV    HL, (SP-393BH)
      DIVU   HL, (SP-383AH)
      ADDW   HL, (HL)
      CPW    HL, (HL)
      MULT   A, (HL+IX)
      MULTU  A, (HL+IX)
      DIVW   DEHL, (HL)
      DIVUW  DEHL, (HL)
      DIV    HL, (HL+IX)
      DIVU   HL, (HL+IX)
      SUBW   HL, (HL)
      MULT   A, (HL+IY)
      MULTU  A, (HL+IY)
      MULTW  HL, (0D4D3H)
      MULTUW HL, (0D5D4H)
      DIV    HL, (HL+IY)
      DIVU   HL, (HL+IY)
      ADDW   HL, (0D8D7H)
      CPW    HL, (0D9D8H)
      MULT   A, (IX+IY)
      MULTU  A, (IX+IY)
      DIVW   DEHL, (0DCDBH)
      DIVUW  DEHL, (0DDDCH)
      DIV    HL, (IX+IY)
      DIVU   HL, (IX+IY)
      SUBW   HL, (0E0DFH)
      MULT   A, IXH
      MULTU  A, IXH
      MULTW  HL, IX
      MULTUW HL, IX
      DIV    HL, IXH
      DIVU   HL, IXH
      ADDW   HL, IX
      CPW    HL, IX
      MULT   A, IXL
      MULTU  A, IXL
      DIVW   DEHL, IX
      DIVUW  DEHL, IX
      DIV    HL, IXL
      DIVU   HL, IXL
      POP    <$-040AH>
      JP     P, (HL)
      CALL   P, (HL)
      PUSH   <$-0406H>
      LD     SP, IX
      JP     M, (HL)
      CALL   M, (HL)
      LDW    (HL), 0302H
      INCW   (HL)
      INC    (SP+0605H)
      DEC    (SP+0706H)
      LD     (SP+0807H), 9
      ADD    IX, BC
      DECW   (HL)
      INC    (HL+IX)
      DEC    (HL+IX)
      LD     (HL+IX), 15
      LDW    (1312H), 1514H
      INCW   (1514H)
      INC    (HL+IY)
      DEC    (HL+IY)
      LD     (HL+IY), 23
      ADD    IX, DE
      DECW   (1D1CH)
      INC    (IX+IY)
      DEC    (IX+IY)
      LD     (IX+IY), 31
      JAR    $+36
      LD     IX, 2322H
      LD     (2423H), IX
      INC    IX
      INC    IXH
      DEC    IXH
      LD     IXH, 27H
      JAF    $+44
      ADD    IX, IX
      LD     IX, (2C2BH)
      DEC    IX
      INC    IXL
      DEC    IXL
      LD     IXL, 2FH
      LDW    <$+3338H>, 3534H
      INCW   <$+3538H>
      INC    (IX+53)
      DEC    (IX+54)
      LD     (IX+55), 38H
      ADD    IX, SP
      DECW   <$+3D40H>
      INC    (3E3DH)
      DEC    (3F3EH)
      LD     (403FH), 41H
      LD     B, IXH
      LD     B, IXL
      LD     B, (IX+71)
      LD     C, IXH
      LD     C, IXL
      LD     C, (IX+79)
      LD     D, IXH
      LD     D, IXL
      LD     D, (IX+87)
      LD     E, IXH
      LD     E, IXL
      LD     E, (IX+95)
      LD     IXH, B
      LD     IXH, C
      LD     IXH, D
      LD     IXH, E
      LD     IXH, IXH
      LD     IXH, IXL
      LD     H, (IX+103)
      LD     IXH, A
      LD     IXL, B
      LD     IXL, C
      LD     IXL, D
      LD     IXL, E
      LD     IXL, IXH
      LD     IXL, IXL
      LD     L, (IX+111)
      LD     IXL, A
      LD     (IX+113), B
      LD     (IX+114), C
      LD     (IX+115), D
      LD     (IX+116), E
      LD     (IX+117), H
      LD     (IX+118), L
      LD     (IX+120), A
      LD     A, (SP+7A79H)
      LD     A, (HL+IX)
      LD     A, (HL+IY)
      LD     A, (IX+IY)
      LD     A, IXH
      LD     A, IXL
      LD     A, (IX+127)
      ADD    A, (SP-7D7FH)
      ADD    A, (HL+IX)
      ADD    A, (HL+IY)
      ADD    A, (IX+IY)
      ADD    A, IXH
      ADD    A, IXL
      ADD    A, (IX-121)
      ADD    A, (8988H)
      ADC    A, (SP-7577H)
      ADC    A, (HL+IX)
      ADC    A, (HL+IY)
      ADC    A, (IX+IY)
      ADC    A, IXH
      ADC    A, IXL
      ADC    A, (IX-113)
      ADC    A, (9190H)
      SUB    A, (SP-6D6FH)
      SUB    A, (HL+IX)
      SUB    A, (HL+IY)
      SUB    A, (IX+IY)
      SUB    A, IXH
      SUB    A, IXL
      SUB    (IX-105)
      SUB    A, (9998H)
      SBC    A, (SP-6567H)
      SBC    A, (HL+IX)
      SBC    A, (HL+IY)
      SBC    A, (IX+IY)
      SBC    A, IXH
      SBC    A, IXL
      SBC    A, (IX-97)
      SBC    A, (0A1A0H)
      AND    A, (SP-5D5FH)
      AND    A, (HL+IX)
      AND    A, (HL+IY)
      AND    A, (IX+IY)
      AND    A, IXH
      AND    A, IXL
      AND    (IX-89)
      AND    A, (0A9A8H)
      XOR    A, (SP-5557H)
      XOR    A, (HL+IX)
      XOR    A, (HL+IY)
      XOR    A, (IX+IY)
      XOR    A, IXH
      XOR    A, IXL
      XOR    (IX-81)
      XOR    A, (0B1B0H)
      OR     A, (SP-4D4FH)
      OR     A, (HL+IX)
      OR     A, (HL+IY)
      OR     A, (IX+IY)
      OR     A, IXH
      OR     A, IXL
      OR     (IX-73)
      OR     A, (0B9B8H)
      CP     A, (SP-4547H)
      CP     A, (HL+IX)
      CP     A, (HL+IY)
      CP     A, (IX+IY)
      CP     A, IXH
      CP     A, IXL
      CP     (IX-65)
      CP     A, (0C1C0H)
      POP    (HL)
      JP     NZ, (HL)
      CALL   NZ, (HL)
      PUSH   (HL)
      JP     Z, (HL)
      SET    1, (IX-52)
      RLC    (IX-52)
      RRC    (IX-52)
      RL     (IX-52)
      RR     (IX-52)
      SLA    (IX-52)
      SRA    (IX-52)
      TSET   (IX-52)
      SRL    (IX-52)
      BIT    0, (IX-52)
      RES    0, (IX-52)
      CALL   Z, (HL)
      CALL   (HL)
      POP    (0D3D2H)
      JP     NC, (HL)
      CALL   NC, (HL)
      PUSH   (0D7D6H)
      JP     C, (HL)
      CALL   C, (HL)
      SBC    A, 0DFH
      RET    PO
      POP    HL
      JP     PO, 0E4E3H
      EX     (SP), HL
      CALL   PO, 0E6E5H
      PUSH   HL
      AND    0E7H
      RET    PE
      JP     (HL)
      JP     PE, 0ECEBH
      EX     DE, HL
      CALL   PE, 0EEEDH
      SUBW   HL, HL
      EX     H, L
      MULT   A, (HL)
      MULTU  A, (HL)
      MULTW  HL, SP
      MULTUW HL, SP
      DIV    HL, (HL)
      DIVU   HL, (HL)
      ADDW   HL, SP
      CPW    HL, SP
      MULT   A, A
      MULTU  A, A
      DIVW   DEHL, SP
      DIVUW  DEHL, SP
      DIV    HL, A
      DIVU   HL, A
      SUBW   HL, SP
      LDA    HL, (SP+0403H)
      LD     (SP+0504H), A
      LDW    HL, (SP+0605H)
      LDW    (SP+0706H), HL
      LDW    BC, (HL)
      EX     A, B
      LDA    HL, (HL+IX)
      LD     (HL+IX), A
      LDW    HL, (HL+IX)
      LDW    (HL+IX), HL
      LDW    (HL), BC
      EX     A, C
      LDA    HL, (HL+IY)
      LD     (HL+IY), A
      LDW    HL, (HL+IY)
      LDW    (HL+IY), HL
      LDW    DE, (HL)
      EX     A, D
      LDA    HL, (IX+IY)
      LD     (IX+IY), A
      LDW    HL, (IX+IY)
      LDW    (IX+IY), HL
      LDW    (HL), DE
      EX     A, E
      LDA    HL, <$+2427H>
      LD     <$+2528H>, A
      LDW    HL, <$+2629H>
      LDW    <$+272AH>, HL
      LDW    HL, (HL)
      EX     A, H
      LDA    HL, (IX+2C2BH)
      LD     (IX+2D2CH), A
      LDW    (HL), HL
      EX     A, L
      LDA    HL, (IY+3433H)
      LD     (IY+3534H), A
      LDW    HL, (IY+3635H)
      LDW    (IY+3736H), HL
      LDW    SP, (HL)
      EX     A, (HL)
      LDA    HL, (HL+3C3BH)
      LD     (HL+3D3CH), A
      LDW    HL, (HL+3E3DH)
      LDW    (HL+3F3EH), HL
      LDW    (HL), SP
      EX     A, A
      IN     B, (C)
      OUT    (C), B
      SBC    HL, BC
      LD     (4544H), BC
      NEG
      RETN
      IM     0
      LD     I, A
      IN     C, (C)
      OUT    (C), C
      ADC    HL, BC
      LD     BC, (4D4CH)
      NEG    HL
      RETI
      LD     R, A
      IN     D, (C)
      OUT    (C), D
      SBC    HL, DE
      LD     (5554H), DE
      RETIL
      LD     A, I
      IN     E, (C)
      OUT    (C), E
      ADC    HL, DE
      LD     DE, (5D5CH)
      LD     A, R
      IN     H, (C)
      OUT    (C), H
      SBC    HL, HL
      EXTS   A
      PCACHE
      LDCTL  HL, (C)
      RRD
      IN     L, (C)
      OUT    (C), L
      ADC    HL, HL
      EXTS   HL
      ADD    HL, A
      LDCTL  (C), HL
      RLD
      TSTI   (C)
      SC     7372H
      SBC    HL, SP
      LD     (7574H), SP
      DI     78H
      IN     A, (C)
      OUT    (C), A
      ADC    HL, SP
      LD     SP, (7D7CH)
      EI     0
      INIW
      OUTIW
      LDUD   A, (HL)
      LDCTL  HL, USP
      INDW
      OUTDW
      LDUD   (HL), A
      LDCTL  USP, HL
      INIRW
      OTIRW
      LDUP   A, (HL)
      INDRW
      OTDRW
      LDUP   (HL), A
      LDI
      CPI
      INI
      OUTI
      LDD
      CPD
      IND
      OUTD
      LDIR
      CPIR
      INIR
      OTIR
      INW    HL, (C)
      LDDR
      CPDR
      INDR
      OTDR
      OUTW   (C), HL
      MULT   A, B
      MULTU  A, B
      MULTW  HL, BC
      MULTUW HL, BC
      DIV    HL, B
      DIVU   HL, B
      ADDW   HL, BC
      CPW    HL, BC
      MULT   A, C
      MULTU  A, C
      DIVW   DEHL, BC
      DIVUW  DEHL, BC
      DIV    HL, C
      DIVU   HL, C
      SUBW   HL, BC
      MULT   A, D
      MULTU  A, D
      MULTW  HL, DE
      MULTUW HL, DE
      DIV    HL, D
      DIVU   HL, D
      ADDW   HL, DE
      CPW    HL, DE
      MULT   A, E
      MULTU  A, E
      DIVW   DEHL, DE
      DIVUW  DEHL, DE
      DIV    HL, E
      DIVU   HL, E
      SUBW   HL, DE
      MULT   A, H
      MULTU  A, H
      MULTW  HL, HL
      MULTUW HL, HL
      DIV    HL, H
      DIVU   HL, H
      ADDW   HL, HL
      CPW    HL, HL
      MULT   A, L
      MULTU  A, L
      DIVW   DEHL, HL
      DIVUW  DEHL, HL
      DIV    HL, L
      DIVU   HL, L
      XOR    0EFH
      RET    P
      POP    AF
      JP     P, 0F4F3H
      DI
      CALL   P, 0F6F5H
      PUSH   AF
      OR     0F7H
      RET    M
      LD     SP, HL
      JP     M, 0FCFBH
      EI
      CALL   M, 0FEFDH
      INCW   (IX+0504H)
      INC    <$+0609H>
      DEC    <$+070AH>
      LD     <$+080CH>, 9
      ADD    IY, BC
      DECW   (IX+0D0CH)
      INC    (IX+0E0DH)
      DEC    (IX+0F0EH)
      LD     (IX+100FH), 17
      INCW   (IY+1514H)
      INC    (IY+1615H)
      DEC    (IY+1716H)
      LD     (IY+1817H), 25
      ADD    IY, DE
      DECW   (IY+1D1CH)
      INC    (HL+1E1DH)
      DEC    (HL+1F1EH)
      LD     (HL+201FH), 21H
      LD     IY, 2322H
      LD     (2423H), IY
      INC    IY
      INC    IYH
      DEC    IYH
      LD     IYH, 27H
      ADD    IY, IY
      LD     IY, (2C2BH)
      DEC    IY
      INC    IYL
      DEC    IYL
      LD     IYL, 2FH
      INC    (IY+53)
      DEC    (IY+54)
      LD     (IY+55), 38H
      ADD    IY, SP
      LD     B, IYH
      LD     B, IYL
      LD     B, (IY+71)
      LD     C, IYH
      LD     C, IYL
      LD     C, (IY+79)
      LD     D, IYH
      LD     D, IYL
      LD     D, (IY+87)
      LD     E, IYH
      LD     E, IYL
      LD     E, (IY+95)
      LD     IYH, B
      LD     IYH, C
      LD     IYH, D
      LD     IYH, E
      LD     IYH, IYH
      LD     IYH, IYL
      LD     H, (IY+103)
      LD     IYH, A
      LD     IYL, B
      LD     IYL, C
      LD     IYL, D
      LD     IYL, E
      LD     IYL, IYH
      LD     IYL, IYL
      LD     L, (IY+111)
      LD     IYL, A
      LD     (IY+113), B
      LD     (IY+114), C
      LD     (IY+115), D
      LD     (IY+116), E
      LD     (IY+117), H
      LD     (IY+118), L
      LD     (IY+120), A
      LD     A, <$+7A7DH>
      LD     A, (IX+7B7AH)
      LD     A, (IY+7C7BH)
      LD     A, (HL+7D7CH)
      LD     A, IYH
      LD     A, IYL
      LD     A, (IY+127)
      ADD    A, <$-087BH>
      ADD    A, (IX-7C7EH)
      ADD    A, (IY-7B7DH)
      ADD    A, (HL-7A7CH)
      ADD    A, IYH
      ADD    A, IYL
      ADD    A, (IY-121)
      ADC    A, <$-0973H>
      ADC    A, (IX-7476H)
      ADC    A, (IY-7375H)
      ADC    A, (HL-7274H)
      ADC    A, IYH
      ADC    A, IYL
      ADC    A, (IY-113)
      SUB    A, <$-096BH>
      SUB    A, (IX-6C6EH)
      SUB    A, (IY-6B6DH)
      SUB    A, (HL-6A6CH)
      SUB    A, IYH
      SUB    A, IYL
      SUB    (IY-105)
      SBC    A, <$-0963H>
      SBC    A, (IX-6466H)
      SBC    A, (IY-6365H)
      SBC    A, (HL-6264H)
      SBC    A, IYH
      SBC    A, IYL
      SBC    A, (IY-97)
      AND    A, <$-095BH>
      AND    A, (IX-5C5EH)
      AND    A, (IY-5B5DH)
      AND    A, (HL-5A5CH)
      AND    A, IYH
      AND    A, IYL
      AND    (IY-89)
      XOR    A, <$-0953H>
      XOR    A, (IX-5456H)
      XOR    A, (IY-5355H)
      XOR    A, (HL-5254H)
      XOR    A, IYH
      XOR    A, IYL
      XOR    (IY-81)
      OR     A, <$-094BH>
      OR     A, (IX-4C4EH)
      OR     A, (IY-4B4DH)
      OR     A, (HL-4A4CH)
      OR     A, IYH
      OR     A, IYL
      OR     (IY-73)
      CP     A, <$-0943H>
      CP     A, (IX-4446H)
      CP     A, (IY-4345H)
      CP     A, (HL-4244H)
      CP     A, IYH
      CP     A, IYL
      CP     (IY-65)
      JP     NZ, <$-0939H>
      JP     <$-0938H>
      CALL   NZ, <$-0937H>
      JP     Z, <$-0A31H>
      SET    1, (IY-52)
      RLC    (IY-52)
      RRC    (IY-52)
      RL     (IY-52)
      RR     (IY-52)
      SLA    (IY-52)
      SRA    (IY-52)
      TSET   (IY-52)
      SRL    (IY-52)
      BIT    0, (IY-52)
      RES    0, (IY-52)
      CALL   Z, <$-0A2FH>
      CALL   <$-0A2EH>
      JP     NC, <$-0A29H>
      CALL   NC, <$-0A27H>
      JP     C, <$-0A21H>
      CALL   C, <$-0A1FH>
      POP    IY
      JP     PO, <$-0A19H>
      EX     (SP), IY
      CALL   PO, <$-0A17H>
      PUSH   IY
      JP     (IY)
      JP     PE, <$-0A11H>
      EX     IY, HL
      CALL   PE, <$-0A0FH>
      SUBW   HL, IY
      MULT   A, (IY-15)
      MULTU  A, (IY-14)
      MULTW  HL, 0F4F3H
      MULTUW HL, 0F5F4H
      DIV    HL, (IY-11)
      DIVU   HL, (IY-10)
      ADDW   HL, 0F8F7H
      CPW    HL, 0F9F8H
      MULT   A, 0F9H
      MULTU  A, 0FAH
      DIVW   DEHL, 0FCFBH
      DIVUW  DEHL, 0FDFCH
      DIV    HL, 0FDH
      DIVU   HL, 0FEH
      SUBW   HL, 00FFH
      LDA    IY, (SP+0403H)
      LDW    IY, (SP+0605H)
      LDW    (SP+0706H), IY
      LDW    BC, (IY+7)
      EX     A, <$+090DH>
      LDA    IY, (HL+IX)
      LDW    IY, (HL+IX)
      LDW    (HL+IX), IY
      LDW    (IY+15), BC
      EX     A, (IX+1110H)
      LDA    IY, (HL+IY)
      LDW    IY, (HL+IY)
      LDW    (HL+IY), IY
      LDW    DE, (IY+23)
      EX     A, (IY+1918H)
      LDA    IY, (IX+IY)
      LDW    IY, (IX+IY)
      LDW    (IX+IY), IY
      LDW    (IY+31), DE
      EX     A, (HL+2120H)
      LDA    IY, <$+2428H>
      LDW    IY, <$+262AH>
      LDW    <$+272BH>, IY
      JP     P, <$-0B09H>
      CALL   P, <$-0907H>
      PUSH   0F7F6H
      LD     SP, IY
      JP     M, <$-0301H>
      CALL   M, <$-00FFH>
      CP     0FFH
