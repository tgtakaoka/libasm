;;; AUTO GENERATED FILE
;;; generated by: gen_mn1610 -i -u -C MN1613 -o gen_mn1613.inc -l gen_mn1613.lst
      MVI   R0, 0
      MVI   SP, 0
      MVI   STR, 0
      SETS  R0, SBRB
      SETS  SP, SBRB
      SETS  STR, SBRB
      LS    SBRB, 1010H
      SETB  R0, SSBR
      SETB  SP, SSBR
      SETB  STR, SSBR
      LB    SSBR, 1018H
      SETS  R0, ICB
      SETS  SP, ICB
      SETS  STR, ICB
      LS    ICB, 1020H
      SETB  R0, TSR0
      SETB  SP, TSR0
      SETB  STR, TSR0
      LB    TSR0, 1028H
      SETS  R0, NPP
      SETS  SP, NPP
      SETS  STR, NPP
      LS    NPP, 1030H
      SETB  R0, OSR0
      SETB  SP, OSR0
      SETB  STR, OSR0
      LB    OSR0, 1048H
      CPYB  R0, CSBR
      CPYB  SP, CSBR
      CPYB  STR, CSBR
      STB   CSBR, 1088H
      CPYS  R0, SBRB
      CPYS  SP, SBRB
      CPYS  STR, SBRB
      STS   SBRB, 1090H
      CPYB  R0, SSBR
      CPYB  SP, SSBR
      CPYB  STR, SSBR
      STB   SSBR, 1098H
      CPYS  R0, ICB
      CPYS  SP, ICB
      CPYS  STR, ICB
      STS   ICB, 10A0H
      CPYB  R0, TSR0
      CPYB  SP, TSR0
      CPYB  STR, TSR0
      STB   TSR0, 10A8H
      CPYS  R0, NPP
      CPYS  SP, NPP
      CPYS  STR, NPP
      STS   NPP, 10B0H
      CPYB  R0, OSR0
      CPYB  SP, OSR0
      CPYB  STR, OSR0
      STB   OSR0, 10C8H
      WT    R0, 00H
      WT    SP, 00H
      WT    STR, 00H
      TRST  R0, 1801H
      TRST  SP, 1806H
      TRST  STR, 1807H
      POPM
      TSET  R0, 1809H
      TSET  SP, 180EH
      TSET  STR, 180FH
      PSHM
      TRST  R0, 1811H, SKP
      TRST  SP, 1816H, SKP
      TRST  STR, 1817H, SKP
      TSET  R0, 1819H, SKP
      TSET  SP, 181EH, SKP
      TSET  STR, 181FH, SKP
      TRST  R0, 1821H, M
      TRST  SP, 1826H, M
      TRST  STR, 1827H, M
      TSET  R0, 1829H, M
      TSET  SP, 182EH, M
      TSET  STR, 182FH, M
      TRST  R0, 1831H, PZ
      TRST  SP, 1836H, PZ
      TRST  STR, 1837H, PZ
      TSET  R0, 1839H, PZ
      TSET  SP, 183EH, PZ
      TSET  STR, 183FH, PZ
      TRST  R0, 1841H, Z
      TRST  SP, 1846H, Z
      TRST  STR, 1847H, Z
      TSET  R0, 1849H, Z
      TSET  SP, 184EH, Z
      TSET  STR, 184FH, Z
      TRST  R0, 1851H, NZ
      TRST  SP, 1856H, NZ
      TRST  STR, 1857H, NZ
      TSET  R0, 1859H, NZ
      TSET  SP, 185EH, NZ
      TSET  STR, 185FH, NZ
      TRST  R0, 1861H, MZ
      TRST  SP, 1866H, MZ
      TRST  STR, 1867H, MZ
      TSET  R0, 1869H, MZ
      TSET  SP, 186EH, MZ
      TSET  STR, 186FH, MZ
      TRST  R0, 1871H, P
      TRST  SP, 1876H, P
      TRST  STR, 1877H, P
      TSET  R0, 1879H, P
      TSET  SP, 187EH, P
      TSET  STR, 187FH, P
      TRST  R0, 1881H, EZ
      TRST  SP, 1886H, EZ
      TRST  STR, 1887H, EZ
      TSET  R0, 1889H, EZ
      TSET  SP, 188EH, EZ
      TSET  STR, 188FH, EZ
      TRST  R0, 1891H, ENZ
      TRST  SP, 1896H, ENZ
      TRST  STR, 1897H, ENZ
      TSET  R0, 1899H, ENZ
      TSET  SP, 189EH, ENZ
      TSET  STR, 189FH, ENZ
      TRST  R0, 18A1H, OZ
      TRST  SP, 18A6H, OZ
      TRST  STR, 18A7H, OZ
      TSET  R0, 18A9H, OZ
      TSET  SP, 18AEH, OZ
      TSET  STR, 18AFH, OZ
      TRST  R0, 18B1H, ONZ
      TRST  SP, 18B6H, ONZ
      TRST  STR, 18B7H, ONZ
      TSET  R0, 18B9H, ONZ
      TSET  SP, 18BEH, ONZ
      TSET  STR, 18BFH, ONZ
      TRST  R0, 18C1H, LMZ
      TRST  SP, 18C6H, LMZ
      TRST  STR, 18C7H, LMZ
      TSET  R0, 18C9H, LMZ
      TSET  SP, 18CEH, LMZ
      TSET  STR, 18CFH, LMZ
      TRST  R0, 18D1H, LP
      TRST  SP, 18D6H, LP
      TRST  STR, 18D7H, LP
      TSET  R0, 18D9H, LP
      TSET  SP, 18DEH, LP
      TSET  STR, 18DFH, LP
      TRST  R0, 18E1H, LPZ
      TRST  SP, 18E6H, LPZ
      TRST  STR, 18E7H, LPZ
      TSET  R0, 18E9H, LPZ
      TSET  SP, 18EEH, LPZ
      TSET  STR, 18EFH, LPZ
      TRST  R0, 18F1H, LM
      TRST  SP, 18F6H, LM
      TRST  STR, 18F7H, LM
      TSET  R0, 18F9H, LM
      TSET  SP, 18FEH, LM
      TSET  STR, 18FFH, LM
      RD    R0, 00H
      RD    SP, 00H
      RD    STR, 00H
      NEG   R0
      NEG   SP
      NEG   STR
      FLT   DR0, R0
      NEG   R0, C
      NEG   SP, C
      NEG   STR, C
      FIX   R0, DR0
      NEG   R0, SKP
      NEG   SP, SKP
      NEG   STR, SKP
      FLT   DR0, R0, SKP
      NEG   R0, C, SKP
      NEG   SP, C, SKP
      NEG   STR, C, SKP
      FIX   R0, DR0, SKP
      NEG   R0, M
      NEG   SP, M
      NEG   STR, M
      FLT   DR0, R0, M
      NEG   R0, C, M
      NEG   SP, C, M
      NEG   STR, C, M
      FIX   R0, DR0, M
      NEG   R0, PZ
      NEG   SP, PZ
      NEG   STR, PZ
      FLT   DR0, R0, PZ
      NEG   R0, C, PZ
      NEG   SP, C, PZ
      NEG   STR, C, PZ
      FIX   R0, DR0, PZ
      NEG   R0, Z
      NEG   SP, Z
      NEG   STR, Z
      FLT   DR0, R0, Z
      NEG   R0, C, Z
      NEG   SP, C, Z
      NEG   STR, C, Z
      FIX   R0, DR0, Z
      NEG   R0, NZ
      NEG   SP, NZ
      NEG   STR, NZ
      FLT   DR0, R0, NZ
      NEG   R0, C, NZ
      NEG   SP, C, NZ
      NEG   STR, C, NZ
      FIX   R0, DR0, NZ
      NEG   R0, MZ
      NEG   SP, MZ
      NEG   STR, MZ
      FLT   DR0, R0, MZ
      NEG   R0, C, MZ
      NEG   SP, C, MZ
      NEG   STR, C, MZ
      FIX   R0, DR0, MZ
      NEG   R0, P
      NEG   SP, P
      NEG   STR, P
      FLT   DR0, R0, P
      NEG   R0, C, P
      NEG   SP, C, P
      NEG   STR, C, P
      FIX   R0, DR0, P
      NEG   R0, EZ
      NEG   SP, EZ
      NEG   STR, EZ
      FLT   DR0, R0, EZ
      NEG   R0, C, EZ
      NEG   SP, C, EZ
      NEG   STR, C, EZ
      FIX   R0, DR0, EZ
      NEG   R0, ENZ
      NEG   SP, ENZ
      NEG   STR, ENZ
      FLT   DR0, R0, ENZ
      NEG   R0, C, ENZ
      NEG   SP, C, ENZ
      NEG   STR, C, ENZ
      FIX   R0, DR0, ENZ
      NEG   R0, OZ
      NEG   SP, OZ
      NEG   STR, OZ
      FLT   DR0, R0, OZ
      NEG   R0, C, OZ
      NEG   SP, C, OZ
      NEG   STR, C, OZ
      FIX   R0, DR0, OZ
      NEG   R0, ONZ
      NEG   SP, ONZ
      NEG   STR, ONZ
      FLT   DR0, R0, ONZ
      NEG   R0, C, ONZ
      NEG   SP, C, ONZ
      NEG   STR, C, ONZ
      FIX   R0, DR0, ONZ
      NEG   R0, LMZ
      NEG   SP, LMZ
      NEG   STR, LMZ
      FLT   DR0, R0, LMZ
      NEG   R0, C, LMZ
      NEG   SP, C, LMZ
      NEG   STR, C, LMZ
      FIX   R0, DR0, LMZ
      NEG   R0, LP
      NEG   SP, LP
      NEG   STR, LP
      FLT   DR0, R0, LP
      NEG   R0, C, LP
      NEG   SP, C, LP
      NEG   STR, C, LP
      FIX   R0, DR0, LP
      NEG   R0, LPZ
      NEG   SP, LPZ
      NEG   STR, LPZ
      FLT   DR0, R0, LPZ
      NEG   R0, C, LPZ
      NEG   SP, C, LPZ
      NEG   STR, C, LPZ
      FIX   R0, DR0, LPZ
      NEG   R0, LM
      NEG   SP, LM
      NEG   STR, LM
      FLT   DR0, R0, LM
      NEG   R0, C, LM
      NEG   SP, C, LM
      NEG   STR, C, LM
      FIX   R0, DR0, LM
      H
      PUSH  R0
      POP   R0
      RET
      LPSW  0
      SR    R0
      SR    R0, RE
      SR    R0, SE
      SR    R0, CE
      SL    R0
      SL    R0, RE
      SL    R0, SE
      SL    R0, CE
      WTR   R0, (R1)
      RDR   R0, (R1)
      SR    R0, SKP
      SR    R0, RE, SKP
      SR    R0, SE, SKP
      SR    R0, CE, SKP
      SL    R0, SKP
      SL    R0, RE, SKP
      SL    R0, SE, SKP
      SL    R0, CE, SKP
      SR    R0, M
      SR    R0, RE, M
      SR    R0, SE, M
      SR    R0, CE, M
      SL    R0, M
      SL    R0, RE, M
      SL    R0, SE, M
      SL    R0, CE, M
      SR    R0, PZ
      SR    R0, RE, PZ
      SR    R0, SE, PZ
      SR    R0, CE, PZ
      SL    R0, PZ
      SL    R0, RE, PZ
      SL    R0, SE, PZ
      SL    R0, CE, PZ
      LR    R0, (R1)
      STR   R0, (R1)
      SR    R0, Z
      SR    R0, RE, Z
      SR    R0, SE, Z
      SR    R0, CE, Z
      SL    R0, Z
      SL    R0, RE, Z
      SL    R0, SE, Z
      SL    R0, CE, Z
      LR    R0, SSBR, (R1)
      STR   R0, SSBR, (R1)
      SR    R0, NZ
      SR    R0, RE, NZ
      SR    R0, SE, NZ
      SR    R0, CE, NZ
      SL    R0, NZ
      SL    R0, RE, NZ
      SL    R0, SE, NZ
      SL    R0, CE, NZ
      LR    R0, TSR0, (R1)
      STR   R0, TSR0, (R1)
      SR    R0, MZ
      SR    R0, RE, MZ
      SR    R0, SE, MZ
      SR    R0, CE, MZ
      SL    R0, MZ
      SL    R0, RE, MZ
      SL    R0, SE, MZ
      SL    R0, CE, MZ
      SR    R0, P
      SR    R0, RE, P
      SR    R0, SE, P
      SR    R0, CE, P
      SL    R0, P
      SL    R0, RE, P
      SL    R0, SE, P
      SL    R0, CE, P
      LR    R0, -(R1)
      STR   R0, -(R1)
      SR    R0, EZ
      SR    R0, RE, EZ
      SR    R0, SE, EZ
      SR    R0, CE, EZ
      SL    R0, EZ
      SL    R0, RE, EZ
      SL    R0, SE, EZ
      SL    R0, CE, EZ
      LR    R0, SSBR, -(R1)
      STR   R0, SSBR, -(R1)
      SR    R0, ENZ
      SR    R0, RE, ENZ
      SR    R0, SE, ENZ
      SR    R0, CE, ENZ
      SL    R0, ENZ
      SL    R0, RE, ENZ
      SL    R0, SE, ENZ
      SL    R0, CE, ENZ
      LR    R0, TSR0, -(R1)
      STR   R0, TSR0, -(R1)
      SR    R0, OZ
      SR    R0, RE, OZ
      SR    R0, SE, OZ
      SR    R0, CE, OZ
      SL    R0, OZ
      SL    R0, RE, OZ
      SL    R0, SE, OZ
      SL    R0, CE, OZ
      SR    R0, ONZ
      SR    R0, RE, ONZ
      SR    R0, SE, ONZ
      SR    R0, CE, ONZ
      SL    R0, ONZ
      SL    R0, RE, ONZ
      SL    R0, SE, ONZ
      SL    R0, CE, ONZ
      LR    R0, (R1)+
      STR   R0, (R1)+
      SR    R0, LMZ
      SR    R0, RE, LMZ
      SR    R0, SE, LMZ
      SR    R0, CE, LMZ
      SL    R0, LMZ
      SL    R0, RE, LMZ
      SL    R0, SE, LMZ
      SL    R0, CE, LMZ
      LR    R0, SSBR, (R1)+
      STR   R0, SSBR, (R1)+
      SR    R0, LP
      SR    R0, RE, LP
      SR    R0, SE, LP
      SR    R0, CE, LP
      SL    R0, LP
      SL    R0, RE, LP
      SL    R0, SE, LP
      SL    R0, CE, LP
      LR    R0, TSR0, (R1)+
      STR   R0, TSR0, (R1)+
      SR    R0, LPZ
      SR    R0, RE, LPZ
      SR    R0, SE, LPZ
      SR    R0, CE, LPZ
      SL    R0, LPZ
      SL    R0, RE, LPZ
      SL    R0, SE, LPZ
      SL    R0, CE, LPZ
      SR    R0, LM
      SR    R0, RE, LM
      SR    R0, SE, LM
      SR    R0, CE, LM
      SL    R0, LM
      SL    R0, RE, LM
      SL    R0, SE, LM
      SL    R0, CE, LM
      PUSH  SP
      POP   SP
      SR    SP
      SR    SP, RE
      SR    SP, SE
      SR    SP, CE
      SL    SP
      SL    SP, RE
      SL    SP, SE
      SL    SP, CE
      WTR   SP, (R1)
      RDR   SP, (R1)
      SR    SP, SKP
      SR    SP, RE, SKP
      SR    SP, SE, SKP
      SR    SP, CE, SKP
      SL    SP, SKP
      SL    SP, RE, SKP
      SL    SP, SE, SKP
      SL    SP, CE, SKP
      SR    SP, M
      SR    SP, RE, M
      SR    SP, SE, M
      SR    SP, CE, M
      SL    SP, M
      SL    SP, RE, M
      SL    SP, SE, M
      SL    SP, CE, M
      SR    SP, PZ
      SR    SP, RE, PZ
      SR    SP, SE, PZ
      SR    SP, CE, PZ
      SL    SP, PZ
      SL    SP, RE, PZ
      SL    SP, SE, PZ
      SL    SP, CE, PZ
      LR    SP, (R1)
      STR   SP, (R1)
      SR    SP, Z
      SR    SP, RE, Z
      SR    SP, SE, Z
      SR    SP, CE, Z
      SL    SP, Z
      SL    SP, RE, Z
      SL    SP, SE, Z
      SL    SP, CE, Z
      LR    SP, SSBR, (R1)
      STR   SP, SSBR, (R1)
      SR    SP, NZ
      SR    SP, RE, NZ
      SR    SP, SE, NZ
      SR    SP, CE, NZ
      SL    SP, NZ
      SL    SP, RE, NZ
      SL    SP, SE, NZ
      SL    SP, CE, NZ
      LR    SP, TSR0, (R1)
      STR   SP, TSR0, (R1)
      SR    SP, MZ
      SR    SP, RE, MZ
      SR    SP, SE, MZ
      SR    SP, CE, MZ
      SL    SP, MZ
      SL    SP, RE, MZ
      SL    SP, SE, MZ
      SL    SP, CE, MZ
      SR    SP, P
      SR    SP, RE, P
      SR    SP, SE, P
      SR    SP, CE, P
      SL    SP, P
      SL    SP, RE, P
      SL    SP, SE, P
      SL    SP, CE, P
      LR    SP, -(R1)
      STR   SP, -(R1)
      SR    SP, EZ
      SR    SP, RE, EZ
      SR    SP, SE, EZ
      SR    SP, CE, EZ
      SL    SP, EZ
      SL    SP, RE, EZ
      SL    SP, SE, EZ
      SL    SP, CE, EZ
      LR    SP, SSBR, -(R1)
      STR   SP, SSBR, -(R1)
      SR    SP, ENZ
      SR    SP, RE, ENZ
      SR    SP, SE, ENZ
      SR    SP, CE, ENZ
      SL    SP, ENZ
      SL    SP, RE, ENZ
      SL    SP, SE, ENZ
      SL    SP, CE, ENZ
      LR    SP, TSR0, -(R1)
      STR   SP, TSR0, -(R1)
      SR    SP, OZ
      SR    SP, RE, OZ
      SR    SP, SE, OZ
      SR    SP, CE, OZ
      SL    SP, OZ
      SL    SP, RE, OZ
      SL    SP, SE, OZ
      SL    SP, CE, OZ
      SR    SP, ONZ
      SR    SP, RE, ONZ
      SR    SP, SE, ONZ
      SR    SP, CE, ONZ
      SL    SP, ONZ
      SL    SP, RE, ONZ
      SL    SP, SE, ONZ
      SL    SP, CE, ONZ
      LR    SP, (R1)+
      STR   SP, (R1)+
      SR    SP, LMZ
      SR    SP, RE, LMZ
      SR    SP, SE, LMZ
      SR    SP, CE, LMZ
      SL    SP, LMZ
      SL    SP, RE, LMZ
      SL    SP, SE, LMZ
      SL    SP, CE, LMZ
      LR    SP, SSBR, (R1)+
      STR   SP, SSBR, (R1)+
      SR    SP, LP
      SR    SP, RE, LP
      SR    SP, SE, LP
      SR    SP, CE, LP
      SL    SP, LP
      SL    SP, RE, LP
      SL    SP, SE, LP
      SL    SP, CE, LP
      LR    SP, TSR0, (R1)+
      STR   SP, TSR0, (R1)+
      SR    SP, LPZ
      SR    SP, RE, LPZ
      SR    SP, SE, LPZ
      SR    SP, CE, LPZ
      SL    SP, LPZ
      SL    SP, RE, LPZ
      SL    SP, SE, LPZ
      SL    SP, CE, LPZ
      SR    SP, LM
      SR    SP, RE, LM
      SR    SP, SE, LM
      SR    SP, CE, LM
      SL    SP, LM
      SL    SP, RE, LM
      SL    SP, SE, LM
      SL    SP, CE, LM
      PUSH  STR
      POP   STR
      BD    2708H
      SR    STR
      SR    STR, RE
      SR    STR, SE
      SR    STR, CE
      SL    STR
      SL    STR, RE
      SL    STR, SE
      SL    STR, CE
      BALD  2718H
      SR    STR, SKP
      SR    STR, RE, SKP
      SR    STR, SE, SKP
      SR    STR, CE, SKP
      SL    STR, SKP
      SL    STR, RE, SKP
      SL    STR, SE, SKP
      SL    STR, CE, SKP
      SR    STR, M
      SR    STR, RE, M
      SR    STR, SE, M
      SR    STR, CE, M
      SL    STR, M
      SL    STR, RE, M
      SL    STR, SE, M
      SL    STR, CE, M
      SR    STR, PZ
      SR    STR, RE, PZ
      SR    STR, SE, PZ
      SR    STR, CE, PZ
      SL    STR, PZ
      SL    STR, RE, PZ
      SL    STR, SE, PZ
      SL    STR, CE, PZ
      SR    STR, Z
      SR    STR, RE, Z
      SR    STR, SE, Z
      SR    STR, CE, Z
      SL    STR, Z
      SL    STR, RE, Z
      SL    STR, SE, Z
      SL    STR, CE, Z
      SR    STR, NZ
      SR    STR, RE, NZ
      SR    STR, SE, NZ
      SR    STR, CE, NZ
      SL    STR, NZ
      SL    STR, RE, NZ
      SL    STR, SE, NZ
      SL    STR, CE, NZ
      SR    STR, MZ
      SR    STR, RE, MZ
      SR    STR, SE, MZ
      SR    STR, CE, MZ
      SL    STR, MZ
      SL    STR, RE, MZ
      SL    STR, SE, MZ
      SL    STR, CE, MZ
      SR    STR, P
      SR    STR, RE, P
      SR    STR, SE, P
      SR    STR, CE, P
      SL    STR, P
      SL    STR, RE, P
      SL    STR, SE, P
      SL    STR, CE, P
      SR    STR, EZ
      SR    STR, RE, EZ
      SR    STR, SE, EZ
      SR    STR, CE, EZ
      SL    STR, EZ
      SL    STR, RE, EZ
      SL    STR, SE, EZ
      SL    STR, CE, EZ
      SR    STR, ENZ
      SR    STR, RE, ENZ
      SR    STR, SE, ENZ
      SR    STR, CE, ENZ
      SL    STR, ENZ
      SL    STR, RE, ENZ
      SL    STR, SE, ENZ
      SL    STR, CE, ENZ
      SR    STR, OZ
      SR    STR, RE, OZ
      SR    STR, SE, OZ
      SR    STR, CE, OZ
      SL    STR, OZ
      SL    STR, RE, OZ
      SL    STR, SE, OZ
      SL    STR, CE, OZ
      SR    STR, ONZ
      SR    STR, RE, ONZ
      SR    STR, SE, ONZ
      SR    STR, CE, ONZ
      SL    STR, ONZ
      SL    STR, RE, ONZ
      SL    STR, SE, ONZ
      SL    STR, CE, ONZ
      SR    STR, LMZ
      SR    STR, RE, LMZ
      SR    STR, SE, LMZ
      SR    STR, CE, LMZ
      SL    STR, LMZ
      SL    STR, RE, LMZ
      SL    STR, SE, LMZ
      SL    STR, CE, LMZ
      SR    STR, LP
      SR    STR, RE, LP
      SR    STR, SE, LP
      SR    STR, CE, LP
      SL    STR, LP
      SL    STR, RE, LP
      SL    STR, SE, LP
      SL    STR, CE, LP
      SR    STR, LPZ
      SR    STR, RE, LPZ
      SR    STR, SE, LPZ
      SR    STR, CE, LPZ
      SL    STR, LPZ
      SL    STR, RE, LPZ
      SL    STR, SE, LPZ
      SL    STR, CE, LPZ
      SR    STR, LM
      SR    STR, RE, LM
      SR    STR, SE, LM
      SR    STR, CE, LM
      SL    STR, LM
      SL    STR, RE, LM
      SL    STR, SE, LM
      SL    STR, CE, LM
      BR    (R1)
      LD    R0, 2809H
      LD    SP, 280EH
      BL    (2810H)
      BALR  (R1)
      LD    R0, SSBR, 2819H
      LD    SP, SSBR, 281EH
      BALL  (2820H)
      LD    R0, TSR0, 2829H
      LD    SP, TSR0, 282EH
      STD   R0, 2849H
      STD   SP, 284EH
      STD   R0, SSBR, 2859H
      STD   SP, SSBR, 285EH
      STD   R0, TSR0, 2869H
      STD   SP, TSR0, 286EH
      TBIT  R0, 0
      TBIT  R0, 0, SKP
      TBIT  R0, 0, M
      TBIT  R0, 0, PZ
      TBIT  R0, 0, Z
      TBIT  R0, 0, NZ
      TBIT  R0, 0, MZ
      TBIT  R0, 0, P
      TBIT  R0, 0, EZ
      TBIT  R0, 0, ENZ
      TBIT  R0, 0, OZ
      TBIT  R0, 0, ONZ
      TBIT  R0, 0, LMZ
      TBIT  R0, 0, LP
      TBIT  R0, 0, LPZ
      TBIT  R0, 0, LM
      TBIT  SP, 0
      TBIT  SP, 0, SKP
      TBIT  SP, 0, M
      TBIT  SP, 0, PZ
      TBIT  SP, 0, Z
      TBIT  SP, 0, NZ
      TBIT  SP, 0, MZ
      TBIT  SP, 0, P
      TBIT  SP, 0, EZ
      TBIT  SP, 0, ENZ
      TBIT  SP, 0, OZ
      TBIT  SP, 0, ONZ
      TBIT  SP, 0, LMZ
      TBIT  SP, 0, LP
      TBIT  SP, 0, LPZ
      TBIT  SP, 0, LM
      TBIT  STR, 0
      TBIT  STR, 0, SKP
      TBIT  STR, 0, M
      TBIT  STR, 0, PZ
      TBIT  STR, 0, Z
      TBIT  STR, 0, NZ
      TBIT  STR, 0, MZ
      TBIT  STR, 0, P
      TBIT  STR, 0, EZ
      TBIT  STR, 0, ENZ
      TBIT  STR, 0, OZ
      TBIT  STR, 0, ONZ
      TBIT  STR, 0, LMZ
      TBIT  STR, 0, LP
      TBIT  STR, 0, LPZ
      TBIT  STR, 0, LM
      RBIT  R0, 0
      RBIT  R0, 0, SKP
      RBIT  R0, 0, M
      RBIT  R0, 0, PZ
      RBIT  R0, 0, Z
      RBIT  R0, 0, NZ
      RBIT  R0, 0, MZ
      RBIT  R0, 0, P
      RBIT  R0, 0, EZ
      RBIT  R0, 0, ENZ
      RBIT  R0, 0, OZ
      RBIT  R0, 0, ONZ
      RBIT  R0, 0, LMZ
      RBIT  R0, 0, LP
      RBIT  R0, 0, LPZ
      RBIT  R0, 0, LM
      RBIT  SP, 0
      RBIT  SP, 0, SKP
      RBIT  SP, 0, M
      RBIT  SP, 0, PZ
      RBIT  SP, 0, Z
      RBIT  SP, 0, NZ
      RBIT  SP, 0, MZ
      RBIT  SP, 0, P
      RBIT  SP, 0, EZ
      RBIT  SP, 0, ENZ
      RBIT  SP, 0, OZ
      RBIT  SP, 0, ONZ
      RBIT  SP, 0, LMZ
      RBIT  SP, 0, LP
      RBIT  SP, 0, LPZ
      RBIT  SP, 0, LM
      RBIT  STR, 0
      RBIT  STR, 0, SKP
      RBIT  STR, 0, M
      RBIT  STR, 0, PZ
      RBIT  STR, 0, Z
      RBIT  STR, 0, NZ
      RBIT  STR, 0, MZ
      RBIT  STR, 0, P
      RBIT  STR, 0, EZ
      RBIT  STR, 0, ENZ
      RBIT  STR, 0, OZ
      RBIT  STR, 0, ONZ
      RBIT  STR, 0, LMZ
      RBIT  STR, 0, LP
      RBIT  STR, 0, LPZ
      RBIT  STR, 0, LM
      SBIT  R0, 0
      SBIT  R0, 0, SKP
      SBIT  R0, 0, M
      SBIT  R0, 0, PZ
      SBIT  R0, 0, Z
      SBIT  R0, 0, NZ
      SBIT  R0, 0, MZ
      SBIT  R0, 0, P
      SBIT  R0, 0, EZ
      SBIT  R0, 0, ENZ
      SBIT  R0, 0, OZ
      SBIT  R0, 0, ONZ
      SBIT  R0, 0, LMZ
      SBIT  R0, 0, LP
      SBIT  R0, 0, LPZ
      SBIT  R0, 0, LM
      SBIT  SP, 0
      SBIT  SP, 0, SKP
      SBIT  SP, 0, M
      SBIT  SP, 0, PZ
      SBIT  SP, 0, Z
      SBIT  SP, 0, NZ
      SBIT  SP, 0, MZ
      SBIT  SP, 0, P
      SBIT  SP, 0, EZ
      SBIT  SP, 0, ENZ
      SBIT  SP, 0, OZ
      SBIT  SP, 0, ONZ
      SBIT  SP, 0, LMZ
      SBIT  SP, 0, LP
      SBIT  SP, 0, LPZ
      SBIT  SP, 0, LM
      SBIT  STR, 0
      SBIT  STR, 0, SKP
      SBIT  STR, 0, M
      SBIT  STR, 0, PZ
      SBIT  STR, 0, Z
      SBIT  STR, 0, NZ
      SBIT  STR, 0, MZ
      SBIT  STR, 0, P
      SBIT  STR, 0, EZ
      SBIT  STR, 0, ENZ
      SBIT  STR, 0, OZ
      SBIT  STR, 0, ONZ
      SBIT  STR, 0, LMZ
      SBIT  STR, 0, LP
      SBIT  STR, 0, LPZ
      SBIT  STR, 0, LM
      SETH  R0, TCR
      SETH  SP, TCR
      SETH  STR, TCR
      RETL
      SETH  R0, TIR
      SETH  SP, TIR
      SETH  STR, TIR
      BLK   (R2), (R1), R0
      SETH  R0, TSR
      SETH  SP, TSR
      SETH  STR, TSR
      SETH  R0, SCR
      SETH  SP, SCR
      SETH  STR, SCR
      SETH  R0, SSR
      SETH  SP, SSR
      SETH  STR, SSR
      SETH  R0, SOR
      SETH  SP, SOR
      SETH  STR, SOR
      SETH  R0, IISR
      SETH  SP, IISR
      SETH  STR, IISR
      SRBT  R0, R0
      SRBT  R0, SP
      SRBT  R0, STR
      CPYH  R0, TCR
      CPYH  SP, TCR
      CPYH  STR, TCR
      CPYH  R0, TIR
      CPYH  SP, TIR
      CPYH  STR, TIR
      CPYH  R0, TSR
      CPYH  SP, TSR
      CPYH  STR, TSR
      CPYH  R0, SCR
      CPYH  SP, SCR
      CPYH  STR, SCR
      CPYH  R0, SSR
      CPYH  SP, SSR
      CPYH  STR, SSR
      CPYH  R0, SIR
      CPYH  SP, SIR
      CPYH  STR, SIR
      CPYH  R0, IISR
      CPYH  SP, IISR
      CPYH  STR, IISR
      DEBP  R0, R0
      DEBP  SP, R0
      DEBP  STR, R0
      SI    R0, 0
      SI    R0, 0, SKP
      SI    R0, 0, M
      SI    R0, 0, PZ
      SI    R0, 0, Z
      SI    R0, 0, NZ
      SI    R0, 0, MZ
      SI    R0, 0, P
      SI    R0, 0, EZ
      SI    R0, 0, ENZ
      SI    R0, 0, OZ
      SI    R0, 0, ONZ
      SI    R0, 0, LMZ
      SI    R0, 0, LP
      SI    R0, 0, LPZ
      SI    R0, 0, LM
      SI    SP, 0
      SI    SP, 0, SKP
      SI    SP, 0, M
      SI    SP, 0, PZ
      SI    SP, 0, Z
      SI    SP, 0, NZ
      SI    SP, 0, MZ
      SI    SP, 0, P
      SI    SP, 0, EZ
      SI    SP, 0, ENZ
      SI    SP, 0, OZ
      SI    SP, 0, ONZ
      SI    SP, 0, LMZ
      SI    SP, 0, LP
      SI    SP, 0, LPZ
      SI    SP, 0, LM
      SI    STR, 0
      SI    STR, 0, SKP
      SI    STR, 0, M
      SI    STR, 0, PZ
      SI    STR, 0, Z
      SI    STR, 0, NZ
      SI    STR, 0, MZ
      SI    STR, 0, P
      SI    STR, 0, EZ
      SI    STR, 0, ENZ
      SI    STR, 0, OZ
      SI    STR, 0, ONZ
      SI    STR, 0, LMZ
      SI    STR, 0, LP
      SI    STR, 0, LPZ
      SI    STR, 0, LM
      SD    DR0, (R1)
      SD    DR0, (R1), C
      SD    DR0, (R1), SKP
      SD    DR0, (R1), C, SKP
      SD    DR0, (R1), M
      SD    DR0, (R1), C, M
      SD    DR0, (R1), PZ
      SD    DR0, (R1), C, PZ
      SD    DR0, (R1), Z
      SD    DR0, (R1), C, Z
      SD    DR0, (R1), NZ
      SD    DR0, (R1), C, NZ
      SD    DR0, (R1), MZ
      SD    DR0, (R1), C, MZ
      SD    DR0, (R1), P
      SD    DR0, (R1), C, P
      SD    DR0, (R1), EZ
      SD    DR0, (R1), C, EZ
      SD    DR0, (R1), ENZ
      SD    DR0, (R1), C, ENZ
      SD    DR0, (R1), OZ
      SD    DR0, (R1), C, OZ
      SD    DR0, (R1), ONZ
      SD    DR0, (R1), C, ONZ
      SD    DR0, (R1), LMZ
      SD    DR0, (R1), C, LMZ
      SD    DR0, (R1), LP
      SD    DR0, (R1), C, LP
      SD    DR0, (R1), LPZ
      SD    DR0, (R1), C, LPZ
      SD    DR0, (R1), LM
      SD    DR0, (R1), C, LM
      AI    R0, 0
      AI    R0, 0, SKP
      AI    R0, 0, M
      AI    R0, 0, PZ
      AI    R0, 0, Z
      AI    R0, 0, NZ
      AI    R0, 0, MZ
      AI    R0, 0, P
      AI    R0, 0, EZ
      AI    R0, 0, ENZ
      AI    R0, 0, OZ
      AI    R0, 0, ONZ
      AI    R0, 0, LMZ
      AI    R0, 0, LP
      AI    R0, 0, LPZ
      AI    R0, 0, LM
      AI    SP, 0
      AI    SP, 0, SKP
      AI    SP, 0, M
      AI    SP, 0, PZ
      AI    SP, 0, Z
      AI    SP, 0, NZ
      AI    SP, 0, MZ
      AI    SP, 0, P
      AI    SP, 0, EZ
      AI    SP, 0, ENZ
      AI    SP, 0, OZ
      AI    SP, 0, ONZ
      AI    SP, 0, LMZ
      AI    SP, 0, LP
      AI    SP, 0, LPZ
      AI    SP, 0, LM
      AI    STR, 0
      AI    STR, 0, SKP
      AI    STR, 0, M
      AI    STR, 0, PZ
      AI    STR, 0, Z
      AI    STR, 0, NZ
      AI    STR, 0, MZ
      AI    STR, 0, P
      AI    STR, 0, EZ
      AI    STR, 0, ENZ
      AI    STR, 0, OZ
      AI    STR, 0, ONZ
      AI    STR, 0, LMZ
      AI    STR, 0, LP
      AI    STR, 0, LPZ
      AI    STR, 0, LM
      AD    DR0, (R1)
      AD    DR0, (R1), C
      AD    DR0, (R1), SKP
      AD    DR0, (R1), C, SKP
      AD    DR0, (R1), M
      AD    DR0, (R1), C, M
      AD    DR0, (R1), PZ
      AD    DR0, (R1), C, PZ
      AD    DR0, (R1), Z
      AD    DR0, (R1), C, Z
      AD    DR0, (R1), NZ
      AD    DR0, (R1), C, NZ
      AD    DR0, (R1), MZ
      AD    DR0, (R1), C, MZ
      AD    DR0, (R1), P
      AD    DR0, (R1), C, P
      AD    DR0, (R1), EZ
      AD    DR0, (R1), C, EZ
      AD    DR0, (R1), ENZ
      AD    DR0, (R1), C, ENZ
      AD    DR0, (R1), OZ
      AD    DR0, (R1), C, OZ
      AD    DR0, (R1), ONZ
      AD    DR0, (R1), C, ONZ
      AD    DR0, (R1), LMZ
      AD    DR0, (R1), C, LMZ
      AD    DR0, (R1), LP
      AD    DR0, (R1), C, LP
      AD    DR0, (R1), LPZ
      AD    DR0, (R1), C, LPZ
      AD    DR0, (R1), LM
      AD    DR0, (R1), C, LM
      CB    R0, R0
      CB    R0, SP
      CB    R0, STR
      CBI   R0, 8
      C     R0, R0
      C     R0, SP
      C     R0, STR
      CWI   R0, 5110H
      CB    R0, R0, SKP
      CB    R0, SP, SKP
      CB    R0, STR, SKP
      CBI   R0, 24, SKP
      C     R0, R0, SKP
      C     R0, SP, SKP
      C     R0, STR, SKP
      CWI   R0, 5120H, SKP
      CB    R0, R0, M
      CB    R0, SP, M
      CB    R0, STR, M
      CBI   R0, 40, M
      C     R0, R0, M
      C     R0, SP, M
      C     R0, STR, M
      CWI   R0, 5130H, M
      CB    R0, R0, PZ
      CB    R0, SP, PZ
      CB    R0, STR, PZ
      CBI   R0, 56, PZ
      C     R0, R0, PZ
      C     R0, SP, PZ
      C     R0, STR, PZ
      CWI   R0, 5140H, PZ
      CB    R0, R0, Z
      CB    R0, SP, Z
      CB    R0, STR, Z
      CBI   R0, 72, Z
      C     R0, R0, Z
      C     R0, SP, Z
      C     R0, STR, Z
      CWI   R0, 5150H, Z
      CB    R0, R0, NZ
      CB    R0, SP, NZ
      CB    R0, STR, NZ
      CBI   R0, 88, NZ
      C     R0, R0, NZ
      C     R0, SP, NZ
      C     R0, STR, NZ
      CWI   R0, 5160H, NZ
      CB    R0, R0, MZ
      CB    R0, SP, MZ
      CB    R0, STR, MZ
      CBI   R0, 104, MZ
      C     R0, R0, MZ
      C     R0, SP, MZ
      C     R0, STR, MZ
      CWI   R0, 5170H, MZ
      CB    R0, R0, P
      CB    R0, SP, P
      CB    R0, STR, P
      CBI   R0, 120, P
      C     R0, R0, P
      C     R0, SP, P
      C     R0, STR, P
      CWI   R0, 5180H, P
      CB    R0, R0, EZ
      CB    R0, SP, EZ
      CB    R0, STR, EZ
      CBI   R0, 136, EZ
      C     R0, R0, EZ
      C     R0, SP, EZ
      C     R0, STR, EZ
      CWI   R0, 5190H, EZ
      CB    R0, R0, ENZ
      CB    R0, SP, ENZ
      CB    R0, STR, ENZ
      CBI   R0, 152, ENZ
      C     R0, R0, ENZ
      C     R0, SP, ENZ
      C     R0, STR, ENZ
      CWI   R0, 51A0H, ENZ
      CB    R0, R0, OZ
      CB    R0, SP, OZ
      CB    R0, STR, OZ
      CBI   R0, 168, OZ
      C     R0, R0, OZ
      C     R0, SP, OZ
      C     R0, STR, OZ
      CWI   R0, 51B0H, OZ
      CB    R0, R0, ONZ
      CB    R0, SP, ONZ
      CB    R0, STR, ONZ
      CBI   R0, 184, ONZ
      C     R0, R0, ONZ
      C     R0, SP, ONZ
      C     R0, STR, ONZ
      CWI   R0, 51C0H, ONZ
      CB    R0, R0, LMZ
      CB    R0, SP, LMZ
      CB    R0, STR, LMZ
      CBI   R0, 200, LMZ
      C     R0, R0, LMZ
      C     R0, SP, LMZ
      C     R0, STR, LMZ
      CWI   R0, 51D0H, LMZ
      CB    R0, R0, LP
      CB    R0, SP, LP
      CB    R0, STR, LP
      CBI   R0, 216, LP
      C     R0, R0, LP
      C     R0, SP, LP
      C     R0, STR, LP
      CWI   R0, 51E0H, LP
      CB    R0, R0, LPZ
      CB    R0, SP, LPZ
      CB    R0, STR, LPZ
      CBI   R0, 232, LPZ
      C     R0, R0, LPZ
      C     R0, SP, LPZ
      C     R0, STR, LPZ
      CWI   R0, 51F0H, LPZ
      CB    R0, R0, LM
      CB    R0, SP, LM
      CB    R0, STR, LM
      CBI   R0, 248, LM
      C     R0, R0, LM
      C     R0, SP, LM
      C     R0, STR, LM
      CWI   R0, 5200H, LM
      CB    SP, R0
      CB    SP, SP
      CB    SP, STR
      CBI   SP, 8
      C     SP, R0
      C     SP, SP
      C     SP, STR
      CWI   SP, 5610H
      CB    SP, R0, SKP
      CB    SP, SP, SKP
      CB    SP, STR, SKP
      CBI   SP, 24, SKP
      C     SP, R0, SKP
      C     SP, SP, SKP
      C     SP, STR, SKP
      CWI   SP, 5620H, SKP
      CB    SP, R0, M
      CB    SP, SP, M
      CB    SP, STR, M
      CBI   SP, 40, M
      C     SP, R0, M
      C     SP, SP, M
      C     SP, STR, M
      CWI   SP, 5630H, M
      CB    SP, R0, PZ
      CB    SP, SP, PZ
      CB    SP, STR, PZ
      CBI   SP, 56, PZ
      C     SP, R0, PZ
      C     SP, SP, PZ
      C     SP, STR, PZ
      CWI   SP, 5640H, PZ
      CB    SP, R0, Z
      CB    SP, SP, Z
      CB    SP, STR, Z
      CBI   SP, 72, Z
      C     SP, R0, Z
      C     SP, SP, Z
      C     SP, STR, Z
      CWI   SP, 5650H, Z
      CB    SP, R0, NZ
      CB    SP, SP, NZ
      CB    SP, STR, NZ
      CBI   SP, 88, NZ
      C     SP, R0, NZ
      C     SP, SP, NZ
      C     SP, STR, NZ
      CWI   SP, 5660H, NZ
      CB    SP, R0, MZ
      CB    SP, SP, MZ
      CB    SP, STR, MZ
      CBI   SP, 104, MZ
      C     SP, R0, MZ
      C     SP, SP, MZ
      C     SP, STR, MZ
      CWI   SP, 5670H, MZ
      CB    SP, R0, P
      CB    SP, SP, P
      CB    SP, STR, P
      CBI   SP, 120, P
      C     SP, R0, P
      C     SP, SP, P
      C     SP, STR, P
      CWI   SP, 5680H, P
      CB    SP, R0, EZ
      CB    SP, SP, EZ
      CB    SP, STR, EZ
      CBI   SP, 136, EZ
      C     SP, R0, EZ
      C     SP, SP, EZ
      C     SP, STR, EZ
      CWI   SP, 5690H, EZ
      CB    SP, R0, ENZ
      CB    SP, SP, ENZ
      CB    SP, STR, ENZ
      CBI   SP, 152, ENZ
      C     SP, R0, ENZ
      C     SP, SP, ENZ
      C     SP, STR, ENZ
      CWI   SP, 56A0H, ENZ
      CB    SP, R0, OZ
      CB    SP, SP, OZ
      CB    SP, STR, OZ
      CBI   SP, 168, OZ
      C     SP, R0, OZ
      C     SP, SP, OZ
      C     SP, STR, OZ
      CWI   SP, 56B0H, OZ
      CB    SP, R0, ONZ
      CB    SP, SP, ONZ
      CB    SP, STR, ONZ
      CBI   SP, 184, ONZ
      C     SP, R0, ONZ
      C     SP, SP, ONZ
      C     SP, STR, ONZ
      CWI   SP, 56C0H, ONZ
      CB    SP, R0, LMZ
      CB    SP, SP, LMZ
      CB    SP, STR, LMZ
      CBI   SP, 200, LMZ
      C     SP, R0, LMZ
      C     SP, SP, LMZ
      C     SP, STR, LMZ
      CWI   SP, 56D0H, LMZ
      CB    SP, R0, LP
      CB    SP, SP, LP
      CB    SP, STR, LP
      CBI   SP, 216, LP
      C     SP, R0, LP
      C     SP, SP, LP
      C     SP, STR, LP
      CWI   SP, 56E0H, LP
      CB    SP, R0, LPZ
      CB    SP, SP, LPZ
      CB    SP, STR, LPZ
      CBI   SP, 232, LPZ
      C     SP, R0, LPZ
      C     SP, SP, LPZ
      C     SP, STR, LPZ
      CWI   SP, 56F0H, LPZ
      CB    SP, R0, LM
      CB    SP, SP, LM
      CB    SP, STR, LM
      CBI   SP, 248, LM
      C     SP, R0, LM
      C     SP, SP, LM
      C     SP, STR, LM
      CWI   SP, 5700H, LM
      CB    STR, R0
      CB    STR, SP
      CB    STR, STR
      CBI   STR, 8
      C     STR, R0
      C     STR, SP
      C     STR, STR
      CWI   STR, 5710H
      CB    STR, R0, SKP
      CB    STR, SP, SKP
      CB    STR, STR, SKP
      CBI   STR, 24, SKP
      C     STR, R0, SKP
      C     STR, SP, SKP
      C     STR, STR, SKP
      CWI   STR, 5720H, SKP
      CB    STR, R0, M
      CB    STR, SP, M
      CB    STR, STR, M
      CBI   STR, 40, M
      C     STR, R0, M
      C     STR, SP, M
      C     STR, STR, M
      CWI   STR, 5730H, M
      CB    STR, R0, PZ
      CB    STR, SP, PZ
      CB    STR, STR, PZ
      CBI   STR, 56, PZ
      C     STR, R0, PZ
      C     STR, SP, PZ
      C     STR, STR, PZ
      CWI   STR, 5740H, PZ
      CB    STR, R0, Z
      CB    STR, SP, Z
      CB    STR, STR, Z
      CBI   STR, 72, Z
      C     STR, R0, Z
      C     STR, SP, Z
      C     STR, STR, Z
      CWI   STR, 5750H, Z
      CB    STR, R0, NZ
      CB    STR, SP, NZ
      CB    STR, STR, NZ
      CBI   STR, 88, NZ
      C     STR, R0, NZ
      C     STR, SP, NZ
      C     STR, STR, NZ
      CWI   STR, 5760H, NZ
      CB    STR, R0, MZ
      CB    STR, SP, MZ
      CB    STR, STR, MZ
      CBI   STR, 104, MZ
      C     STR, R0, MZ
      C     STR, SP, MZ
      C     STR, STR, MZ
      CWI   STR, 5770H, MZ
      CB    STR, R0, P
      CB    STR, SP, P
      CB    STR, STR, P
      CBI   STR, 120, P
      C     STR, R0, P
      C     STR, SP, P
      C     STR, STR, P
      CWI   STR, 5780H, P
      CB    STR, R0, EZ
      CB    STR, SP, EZ
      CB    STR, STR, EZ
      CBI   STR, 136, EZ
      C     STR, R0, EZ
      C     STR, SP, EZ
      C     STR, STR, EZ
      CWI   STR, 5790H, EZ
      CB    STR, R0, ENZ
      CB    STR, SP, ENZ
      CB    STR, STR, ENZ
      CBI   STR, 152, ENZ
      C     STR, R0, ENZ
      C     STR, SP, ENZ
      C     STR, STR, ENZ
      CWI   STR, 57A0H, ENZ
      CB    STR, R0, OZ
      CB    STR, SP, OZ
      CB    STR, STR, OZ
      CBI   STR, 168, OZ
      C     STR, R0, OZ
      C     STR, SP, OZ
      C     STR, STR, OZ
      CWI   STR, 57B0H, OZ
      CB    STR, R0, ONZ
      CB    STR, SP, ONZ
      CB    STR, STR, ONZ
      CBI   STR, 184, ONZ
      C     STR, R0, ONZ
      C     STR, SP, ONZ
      C     STR, STR, ONZ
      CWI   STR, 57C0H, ONZ
      CB    STR, R0, LMZ
      CB    STR, SP, LMZ
      CB    STR, STR, LMZ
      CBI   STR, 200, LMZ
      C     STR, R0, LMZ
      C     STR, SP, LMZ
      C     STR, STR, LMZ
      CWI   STR, 57D0H, LMZ
      CB    STR, R0, LP
      CB    STR, SP, LP
      CB    STR, STR, LP
      CBI   STR, 216, LP
      C     STR, R0, LP
      C     STR, SP, LP
      C     STR, STR, LP
      CWI   STR, 57E0H, LP
      CB    STR, R0, LPZ
      CB    STR, SP, LPZ
      CB    STR, STR, LPZ
      CBI   STR, 232, LPZ
      C     STR, R0, LPZ
      C     STR, SP, LPZ
      C     STR, STR, LPZ
      CWI   STR, 57F0H, LPZ
      CB    STR, R0, LM
      CB    STR, SP, LM
      CB    STR, STR, LM
      CBI   STR, 248, LM
      C     STR, R0, LM
      C     STR, SP, LM
      C     STR, STR, LM
      CWI   STR, 5800H, LM
      CBR   R0, (R1)
      DAS   R0, (R1)
      CWR   R0, (R1)
      DAS   R0, (R1), C
      CBR   R0, (R1), SKP
      DAS   R0, (R1), SKP
      CWR   R0, (R1), SKP
      DAS   R0, (R1), C, SKP
      CBR   R0, (R1), M
      DAS   R0, (R1), M
      CWR   R0, (R1), M
      DAS   R0, (R1), C, M
      CBR   R0, (R1), PZ
      DAS   R0, (R1), PZ
      CWR   R0, (R1), PZ
      DAS   R0, (R1), C, PZ
      CBR   R0, (R1), Z
      DAS   R0, (R1), Z
      CWR   R0, (R1), Z
      DAS   R0, (R1), C, Z
      CBR   R0, (R1), NZ
      DAS   R0, (R1), NZ
      CWR   R0, (R1), NZ
      DAS   R0, (R1), C, NZ
      CBR   R0, (R1), MZ
      DAS   R0, (R1), MZ
      CWR   R0, (R1), MZ
      DAS   R0, (R1), C, MZ
      CBR   R0, (R1), P
      DAS   R0, (R1), P
      CWR   R0, (R1), P
      DAS   R0, (R1), C, P
      CBR   R0, (R1), EZ
      DAS   R0, (R1), EZ
      CWR   R0, (R1), EZ
      DAS   R0, (R1), C, EZ
      CBR   R0, (R1), ENZ
      DAS   R0, (R1), ENZ
      CWR   R0, (R1), ENZ
      DAS   R0, (R1), C, ENZ
      CBR   R0, (R1), OZ
      DAS   R0, (R1), OZ
      CWR   R0, (R1), OZ
      DAS   R0, (R1), C, OZ
      CBR   R0, (R1), ONZ
      DAS   R0, (R1), ONZ
      CWR   R0, (R1), ONZ
      DAS   R0, (R1), C, ONZ
      CBR   R0, (R1), LMZ
      DAS   R0, (R1), LMZ
      CWR   R0, (R1), LMZ
      DAS   R0, (R1), C, LMZ
      CBR   R0, (R1), LP
      DAS   R0, (R1), LP
      CWR   R0, (R1), LP
      DAS   R0, (R1), C, LP
      CBR   R0, (R1), LPZ
      DAS   R0, (R1), LPZ
      CWR   R0, (R1), LPZ
      DAS   R0, (R1), C, LPZ
      CBR   R0, (R1), LM
      DAS   R0, (R1), LM
      CWR   R0, (R1), LM
      DAS   R0, (R1), C, LM
      S     R0, R0
      S     R0, SP
      S     R0, STR
      SWI   R0, 5908H
      A     R0, R0
      A     R0, SP
      A     R0, STR
      AWI   R0, 5910H
      S     R0, R0, SKP
      S     R0, SP, SKP
      S     R0, STR, SKP
      SWI   R0, 5918H, SKP
      A     R0, R0, SKP
      A     R0, SP, SKP
      A     R0, STR, SKP
      AWI   R0, 5920H, SKP
      S     R0, R0, M
      S     R0, SP, M
      S     R0, STR, M
      SWI   R0, 5928H, M
      A     R0, R0, M
      A     R0, SP, M
      A     R0, STR, M
      AWI   R0, 5930H, M
      S     R0, R0, PZ
      S     R0, SP, PZ
      S     R0, STR, PZ
      SWI   R0, 5938H, PZ
      A     R0, R0, PZ
      A     R0, SP, PZ
      A     R0, STR, PZ
      AWI   R0, 5940H, PZ
      S     R0, R0, Z
      S     R0, SP, Z
      S     R0, STR, Z
      SWI   R0, 5948H, Z
      A     R0, R0, Z
      A     R0, SP, Z
      A     R0, STR, Z
      AWI   R0, 5950H, Z
      S     R0, R0, NZ
      S     R0, SP, NZ
      S     R0, STR, NZ
      SWI   R0, 5958H, NZ
      A     R0, R0, NZ
      A     R0, SP, NZ
      A     R0, STR, NZ
      AWI   R0, 5960H, NZ
      S     R0, R0, MZ
      S     R0, SP, MZ
      S     R0, STR, MZ
      SWI   R0, 5968H, MZ
      A     R0, R0, MZ
      A     R0, SP, MZ
      A     R0, STR, MZ
      AWI   R0, 5970H, MZ
      S     R0, R0, P
      S     R0, SP, P
      S     R0, STR, P
      SWI   R0, 5978H, P
      A     R0, R0, P
      A     R0, SP, P
      A     R0, STR, P
      AWI   R0, 5980H, P
      S     R0, R0, EZ
      S     R0, SP, EZ
      S     R0, STR, EZ
      SWI   R0, 5988H, EZ
      A     R0, R0, EZ
      A     R0, SP, EZ
      A     R0, STR, EZ
      AWI   R0, 5990H, EZ
      S     R0, R0, ENZ
      S     R0, SP, ENZ
      S     R0, STR, ENZ
      SWI   R0, 5998H, ENZ
      A     R0, R0, ENZ
      A     R0, SP, ENZ
      A     R0, STR, ENZ
      AWI   R0, 59A0H, ENZ
      S     R0, R0, OZ
      S     R0, SP, OZ
      S     R0, STR, OZ
      SWI   R0, 59A8H, OZ
      A     R0, R0, OZ
      A     R0, SP, OZ
      A     R0, STR, OZ
      AWI   R0, 59B0H, OZ
      S     R0, R0, ONZ
      S     R0, SP, ONZ
      S     R0, STR, ONZ
      SWI   R0, 59B8H, ONZ
      A     R0, R0, ONZ
      A     R0, SP, ONZ
      A     R0, STR, ONZ
      AWI   R0, 59C0H, ONZ
      S     R0, R0, LMZ
      S     R0, SP, LMZ
      S     R0, STR, LMZ
      SWI   R0, 59C8H, LMZ
      A     R0, R0, LMZ
      A     R0, SP, LMZ
      A     R0, STR, LMZ
      AWI   R0, 59D0H, LMZ
      S     R0, R0, LP
      S     R0, SP, LP
      S     R0, STR, LP
      SWI   R0, 59D8H, LP
      A     R0, R0, LP
      A     R0, SP, LP
      A     R0, STR, LP
      AWI   R0, 59E0H, LP
      S     R0, R0, LPZ
      S     R0, SP, LPZ
      S     R0, STR, LPZ
      SWI   R0, 59E8H, LPZ
      A     R0, R0, LPZ
      A     R0, SP, LPZ
      A     R0, STR, LPZ
      AWI   R0, 59F0H, LPZ
      S     R0, R0, LM
      S     R0, SP, LM
      S     R0, STR, LM
      SWI   R0, 59F8H, LM
      A     R0, R0, LM
      A     R0, SP, LM
      A     R0, STR, LM
      AWI   R0, 5A00H, LM
      S     SP, R0
      S     SP, SP
      S     SP, STR
      SWI   SP, 5E08H
      A     SP, R0
      A     SP, SP
      A     SP, STR
      AWI   SP, 5E10H
      S     SP, R0, SKP
      S     SP, SP, SKP
      S     SP, STR, SKP
      SWI   SP, 5E18H, SKP
      A     SP, R0, SKP
      A     SP, SP, SKP
      A     SP, STR, SKP
      AWI   SP, 5E20H, SKP
      S     SP, R0, M
      S     SP, SP, M
      S     SP, STR, M
      SWI   SP, 5E28H, M
      A     SP, R0, M
      A     SP, SP, M
      A     SP, STR, M
      AWI   SP, 5E30H, M
      S     SP, R0, PZ
      S     SP, SP, PZ
      S     SP, STR, PZ
      SWI   SP, 5E38H, PZ
      A     SP, R0, PZ
      A     SP, SP, PZ
      A     SP, STR, PZ
      AWI   SP, 5E40H, PZ
      S     SP, R0, Z
      S     SP, SP, Z
      S     SP, STR, Z
      SWI   SP, 5E48H, Z
      A     SP, R0, Z
      A     SP, SP, Z
      A     SP, STR, Z
      AWI   SP, 5E50H, Z
      S     SP, R0, NZ
      S     SP, SP, NZ
      S     SP, STR, NZ
      SWI   SP, 5E58H, NZ
      A     SP, R0, NZ
      A     SP, SP, NZ
      A     SP, STR, NZ
      AWI   SP, 5E60H, NZ
      S     SP, R0, MZ
      S     SP, SP, MZ
      S     SP, STR, MZ
      SWI   SP, 5E68H, MZ
      A     SP, R0, MZ
      A     SP, SP, MZ
      A     SP, STR, MZ
      AWI   SP, 5E70H, MZ
      S     SP, R0, P
      S     SP, SP, P
      S     SP, STR, P
      SWI   SP, 5E78H, P
      A     SP, R0, P
      A     SP, SP, P
      A     SP, STR, P
      AWI   SP, 5E80H, P
      S     SP, R0, EZ
      S     SP, SP, EZ
      S     SP, STR, EZ
      SWI   SP, 5E88H, EZ
      A     SP, R0, EZ
      A     SP, SP, EZ
      A     SP, STR, EZ
      AWI   SP, 5E90H, EZ
      S     SP, R0, ENZ
      S     SP, SP, ENZ
      S     SP, STR, ENZ
      SWI   SP, 5E98H, ENZ
      A     SP, R0, ENZ
      A     SP, SP, ENZ
      A     SP, STR, ENZ
      AWI   SP, 5EA0H, ENZ
      S     SP, R0, OZ
      S     SP, SP, OZ
      S     SP, STR, OZ
      SWI   SP, 5EA8H, OZ
      A     SP, R0, OZ
      A     SP, SP, OZ
      A     SP, STR, OZ
      AWI   SP, 5EB0H, OZ
      S     SP, R0, ONZ
      S     SP, SP, ONZ
      S     SP, STR, ONZ
      SWI   SP, 5EB8H, ONZ
      A     SP, R0, ONZ
      A     SP, SP, ONZ
      A     SP, STR, ONZ
      AWI   SP, 5EC0H, ONZ
      S     SP, R0, LMZ
      S     SP, SP, LMZ
      S     SP, STR, LMZ
      SWI   SP, 5EC8H, LMZ
      A     SP, R0, LMZ
      A     SP, SP, LMZ
      A     SP, STR, LMZ
      AWI   SP, 5ED0H, LMZ
      S     SP, R0, LP
      S     SP, SP, LP
      S     SP, STR, LP
      SWI   SP, 5ED8H, LP
      A     SP, R0, LP
      A     SP, SP, LP
      A     SP, STR, LP
      AWI   SP, 5EE0H, LP
      S     SP, R0, LPZ
      S     SP, SP, LPZ
      S     SP, STR, LPZ
      SWI   SP, 5EE8H, LPZ
      A     SP, R0, LPZ
      A     SP, SP, LPZ
      A     SP, STR, LPZ
      AWI   SP, 5EF0H, LPZ
      S     SP, R0, LM
      S     SP, SP, LM
      S     SP, STR, LM
      SWI   SP, 5EF8H, LM
      A     SP, R0, LM
      A     SP, SP, LM
      A     SP, STR, LM
      AWI   SP, 5F00H, LM
      S     STR, R0
      S     STR, SP
      S     STR, STR
      SWI   STR, 5F08H
      A     STR, R0
      A     STR, SP
      A     STR, STR
      AWI   STR, 5F10H
      S     STR, R0, SKP
      S     STR, SP, SKP
      S     STR, STR, SKP
      SWI   STR, 5F18H, SKP
      A     STR, R0, SKP
      A     STR, SP, SKP
      A     STR, STR, SKP
      AWI   STR, 5F20H, SKP
      S     STR, R0, M
      S     STR, SP, M
      S     STR, STR, M
      SWI   STR, 5F28H, M
      A     STR, R0, M
      A     STR, SP, M
      A     STR, STR, M
      AWI   STR, 5F30H, M
      S     STR, R0, PZ
      S     STR, SP, PZ
      S     STR, STR, PZ
      SWI   STR, 5F38H, PZ
      A     STR, R0, PZ
      A     STR, SP, PZ
      A     STR, STR, PZ
      AWI   STR, 5F40H, PZ
      S     STR, R0, Z
      S     STR, SP, Z
      S     STR, STR, Z
      SWI   STR, 5F48H, Z
      A     STR, R0, Z
      A     STR, SP, Z
      A     STR, STR, Z
      AWI   STR, 5F50H, Z
      S     STR, R0, NZ
      S     STR, SP, NZ
      S     STR, STR, NZ
      SWI   STR, 5F58H, NZ
      A     STR, R0, NZ
      A     STR, SP, NZ
      A     STR, STR, NZ
      AWI   STR, 5F60H, NZ
      S     STR, R0, MZ
      S     STR, SP, MZ
      S     STR, STR, MZ
      SWI   STR, 5F68H, MZ
      A     STR, R0, MZ
      A     STR, SP, MZ
      A     STR, STR, MZ
      AWI   STR, 5F70H, MZ
      S     STR, R0, P
      S     STR, SP, P
      S     STR, STR, P
      SWI   STR, 5F78H, P
      A     STR, R0, P
      A     STR, SP, P
      A     STR, STR, P
      AWI   STR, 5F80H, P
      S     STR, R0, EZ
      S     STR, SP, EZ
      S     STR, STR, EZ
      SWI   STR, 5F88H, EZ
      A     STR, R0, EZ
      A     STR, SP, EZ
      A     STR, STR, EZ
      AWI   STR, 5F90H, EZ
      S     STR, R0, ENZ
      S     STR, SP, ENZ
      S     STR, STR, ENZ
      SWI   STR, 5F98H, ENZ
      A     STR, R0, ENZ
      A     STR, SP, ENZ
      A     STR, STR, ENZ
      AWI   STR, 5FA0H, ENZ
      S     STR, R0, OZ
      S     STR, SP, OZ
      S     STR, STR, OZ
      SWI   STR, 5FA8H, OZ
      A     STR, R0, OZ
      A     STR, SP, OZ
      A     STR, STR, OZ
      AWI   STR, 5FB0H, OZ
      S     STR, R0, ONZ
      S     STR, SP, ONZ
      S     STR, STR, ONZ
      SWI   STR, 5FB8H, ONZ
      A     STR, R0, ONZ
      A     STR, SP, ONZ
      A     STR, STR, ONZ
      AWI   STR, 5FC0H, ONZ
      S     STR, R0, LMZ
      S     STR, SP, LMZ
      S     STR, STR, LMZ
      SWI   STR, 5FC8H, LMZ
      A     STR, R0, LMZ
      A     STR, SP, LMZ
      A     STR, STR, LMZ
      AWI   STR, 5FD0H, LMZ
      S     STR, R0, LP
      S     STR, SP, LP
      S     STR, STR, LP
      SWI   STR, 5FD8H, LP
      A     STR, R0, LP
      A     STR, SP, LP
      A     STR, STR, LP
      AWI   STR, 5FE0H, LP
      S     STR, R0, LPZ
      S     STR, SP, LPZ
      S     STR, STR, LPZ
      SWI   STR, 5FE8H, LPZ
      A     STR, R0, LPZ
      A     STR, SP, LPZ
      A     STR, STR, LPZ
      AWI   STR, 5FF0H, LPZ
      S     STR, R0, LM
      S     STR, SP, LM
      S     STR, STR, LM
      SWI   STR, 5FF8H, LM
      A     STR, R0, LM
      A     STR, SP, LM
      A     STR, STR, LM
      AWI   STR, 6000H, LM
      SWR   R0, (R1)
      DAA   R0, (R1)
      AWR   R0, (R1)
      DAA   R0, (R1), C
      SWR   R0, (R1), SKP
      DAA   R0, (R1), SKP
      AWR   R0, (R1), SKP
      DAA   R0, (R1), C, SKP
      SWR   R0, (R1), M
      DAA   R0, (R1), M
      AWR   R0, (R1), M
      DAA   R0, (R1), C, M
      SWR   R0, (R1), PZ
      DAA   R0, (R1), PZ
      AWR   R0, (R1), PZ
      DAA   R0, (R1), C, PZ
      SWR   R0, (R1), Z
      DAA   R0, (R1), Z
      AWR   R0, (R1), Z
      DAA   R0, (R1), C, Z
      SWR   R0, (R1), NZ
      DAA   R0, (R1), NZ
      AWR   R0, (R1), NZ
      DAA   R0, (R1), C, NZ
      SWR   R0, (R1), MZ
      DAA   R0, (R1), MZ
      AWR   R0, (R1), MZ
      DAA   R0, (R1), C, MZ
      SWR   R0, (R1), P
      DAA   R0, (R1), P
      AWR   R0, (R1), P
      DAA   R0, (R1), C, P
      SWR   R0, (R1), EZ
      DAA   R0, (R1), EZ
      AWR   R0, (R1), EZ
      DAA   R0, (R1), C, EZ
      SWR   R0, (R1), ENZ
      DAA   R0, (R1), ENZ
      AWR   R0, (R1), ENZ
      DAA   R0, (R1), C, ENZ
      SWR   R0, (R1), OZ
      DAA   R0, (R1), OZ
      AWR   R0, (R1), OZ
      DAA   R0, (R1), C, OZ
      SWR   R0, (R1), ONZ
      DAA   R0, (R1), ONZ
      AWR   R0, (R1), ONZ
      DAA   R0, (R1), C, ONZ
      SWR   R0, (R1), LMZ
      DAA   R0, (R1), LMZ
      AWR   R0, (R1), LMZ
      DAA   R0, (R1), C, LMZ
      SWR   R0, (R1), LP
      DAA   R0, (R1), LP
      AWR   R0, (R1), LP
      DAA   R0, (R1), C, LP
      SWR   R0, (R1), LPZ
      DAA   R0, (R1), LPZ
      AWR   R0, (R1), LPZ
      DAA   R0, (R1), C, LPZ
      SWR   R0, (R1), LM
      DAA   R0, (R1), LM
      AWR   R0, (R1), LM
      DAA   R0, (R1), C, LM
      EOR   R0, R0
      EOR   R0, SP
      EOR   R0, STR
      EORI  R0, 6108H
      OR    R0, R0
      OR    R0, SP
      OR    R0, STR
      ORI   R0, 6110H
      EOR   R0, R0, SKP
      EOR   R0, SP, SKP
      EOR   R0, STR, SKP
      EORI  R0, 6118H, SKP
      OR    R0, R0, SKP
      OR    R0, SP, SKP
      OR    R0, STR, SKP
      ORI   R0, 6120H, SKP
      EOR   R0, R0, M
      EOR   R0, SP, M
      EOR   R0, STR, M
      EORI  R0, 6128H, M
      OR    R0, R0, M
      OR    R0, SP, M
      OR    R0, STR, M
      ORI   R0, 6130H, M
      EOR   R0, R0, PZ
      EOR   R0, SP, PZ
      EOR   R0, STR, PZ
      EORI  R0, 6138H, PZ
      OR    R0, R0, PZ
      OR    R0, SP, PZ
      OR    R0, STR, PZ
      ORI   R0, 6140H, PZ
      EOR   R0, R0, Z
      EOR   R0, SP, Z
      EOR   R0, STR, Z
      EORI  R0, 6148H, Z
      OR    R0, R0, Z
      OR    R0, SP, Z
      OR    R0, STR, Z
      ORI   R0, 6150H, Z
      EOR   R0, R0, NZ
      EOR   R0, SP, NZ
      EOR   R0, STR, NZ
      EORI  R0, 6158H, NZ
      OR    R0, R0, NZ
      OR    R0, SP, NZ
      OR    R0, STR, NZ
      ORI   R0, 6160H, NZ
      EOR   R0, R0, MZ
      EOR   R0, SP, MZ
      EOR   R0, STR, MZ
      EORI  R0, 6168H, MZ
      OR    R0, R0, MZ
      OR    R0, SP, MZ
      OR    R0, STR, MZ
      ORI   R0, 6170H, MZ
      EOR   R0, R0, P
      EOR   R0, SP, P
      EOR   R0, STR, P
      EORI  R0, 6178H, P
      OR    R0, R0, P
      OR    R0, SP, P
      OR    R0, STR, P
      ORI   R0, 6180H, P
      EOR   R0, R0, EZ
      EOR   R0, SP, EZ
      EOR   R0, STR, EZ
      EORI  R0, 6188H, EZ
      OR    R0, R0, EZ
      OR    R0, SP, EZ
      OR    R0, STR, EZ
      ORI   R0, 6190H, EZ
      EOR   R0, R0, ENZ
      EOR   R0, SP, ENZ
      EOR   R0, STR, ENZ
      EORI  R0, 6198H, ENZ
      OR    R0, R0, ENZ
      OR    R0, SP, ENZ
      OR    R0, STR, ENZ
      ORI   R0, 61A0H, ENZ
      EOR   R0, R0, OZ
      EOR   R0, SP, OZ
      EOR   R0, STR, OZ
      EORI  R0, 61A8H, OZ
      OR    R0, R0, OZ
      OR    R0, SP, OZ
      OR    R0, STR, OZ
      ORI   R0, 61B0H, OZ
      EOR   R0, R0, ONZ
      EOR   R0, SP, ONZ
      EOR   R0, STR, ONZ
      EORI  R0, 61B8H, ONZ
      OR    R0, R0, ONZ
      OR    R0, SP, ONZ
      OR    R0, STR, ONZ
      ORI   R0, 61C0H, ONZ
      EOR   R0, R0, LMZ
      EOR   R0, SP, LMZ
      EOR   R0, STR, LMZ
      EORI  R0, 61C8H, LMZ
      OR    R0, R0, LMZ
      OR    R0, SP, LMZ
      OR    R0, STR, LMZ
      ORI   R0, 61D0H, LMZ
      EOR   R0, R0, LP
      EOR   R0, SP, LP
      EOR   R0, STR, LP
      EORI  R0, 61D8H, LP
      OR    R0, R0, LP
      OR    R0, SP, LP
      OR    R0, STR, LP
      ORI   R0, 61E0H, LP
      EOR   R0, R0, LPZ
      EOR   R0, SP, LPZ
      EOR   R0, STR, LPZ
      EORI  R0, 61E8H, LPZ
      OR    R0, R0, LPZ
      OR    R0, SP, LPZ
      OR    R0, STR, LPZ
      ORI   R0, 61F0H, LPZ
      EOR   R0, R0, LM
      EOR   R0, SP, LM
      EOR   R0, STR, LM
      EORI  R0, 61F8H, LM
      OR    R0, R0, LM
      OR    R0, SP, LM
      OR    R0, STR, LM
      ORI   R0, 6200H, LM
      EOR   SP, R0
      EOR   SP, SP
      EOR   SP, STR
      EORI  SP, 6608H
      OR    SP, R0
      OR    SP, SP
      OR    SP, STR
      ORI   SP, 6610H
      EOR   SP, R0, SKP
      EOR   SP, SP, SKP
      EOR   SP, STR, SKP
      EORI  SP, 6618H, SKP
      OR    SP, R0, SKP
      OR    SP, SP, SKP
      OR    SP, STR, SKP
      ORI   SP, 6620H, SKP
      EOR   SP, R0, M
      EOR   SP, SP, M
      EOR   SP, STR, M
      EORI  SP, 6628H, M
      OR    SP, R0, M
      OR    SP, SP, M
      OR    SP, STR, M
      ORI   SP, 6630H, M
      EOR   SP, R0, PZ
      EOR   SP, SP, PZ
      EOR   SP, STR, PZ
      EORI  SP, 6638H, PZ
      OR    SP, R0, PZ
      OR    SP, SP, PZ
      OR    SP, STR, PZ
      ORI   SP, 6640H, PZ
      EOR   SP, R0, Z
      EOR   SP, SP, Z
      EOR   SP, STR, Z
      EORI  SP, 6648H, Z
      OR    SP, R0, Z
      OR    SP, SP, Z
      OR    SP, STR, Z
      ORI   SP, 6650H, Z
      EOR   SP, R0, NZ
      EOR   SP, SP, NZ
      EOR   SP, STR, NZ
      EORI  SP, 6658H, NZ
      OR    SP, R0, NZ
      OR    SP, SP, NZ
      OR    SP, STR, NZ
      ORI   SP, 6660H, NZ
      EOR   SP, R0, MZ
      EOR   SP, SP, MZ
      EOR   SP, STR, MZ
      EORI  SP, 6668H, MZ
      OR    SP, R0, MZ
      OR    SP, SP, MZ
      OR    SP, STR, MZ
      ORI   SP, 6670H, MZ
      EOR   SP, R0, P
      EOR   SP, SP, P
      EOR   SP, STR, P
      EORI  SP, 6678H, P
      OR    SP, R0, P
      OR    SP, SP, P
      OR    SP, STR, P
      ORI   SP, 6680H, P
      EOR   SP, R0, EZ
      EOR   SP, SP, EZ
      EOR   SP, STR, EZ
      EORI  SP, 6688H, EZ
      OR    SP, R0, EZ
      OR    SP, SP, EZ
      OR    SP, STR, EZ
      ORI   SP, 6690H, EZ
      EOR   SP, R0, ENZ
      EOR   SP, SP, ENZ
      EOR   SP, STR, ENZ
      EORI  SP, 6698H, ENZ
      OR    SP, R0, ENZ
      OR    SP, SP, ENZ
      OR    SP, STR, ENZ
      ORI   SP, 66A0H, ENZ
      EOR   SP, R0, OZ
      EOR   SP, SP, OZ
      EOR   SP, STR, OZ
      EORI  SP, 66A8H, OZ
      OR    SP, R0, OZ
      OR    SP, SP, OZ
      OR    SP, STR, OZ
      ORI   SP, 66B0H, OZ
      EOR   SP, R0, ONZ
      EOR   SP, SP, ONZ
      EOR   SP, STR, ONZ
      EORI  SP, 66B8H, ONZ
      OR    SP, R0, ONZ
      OR    SP, SP, ONZ
      OR    SP, STR, ONZ
      ORI   SP, 66C0H, ONZ
      EOR   SP, R0, LMZ
      EOR   SP, SP, LMZ
      EOR   SP, STR, LMZ
      EORI  SP, 66C8H, LMZ
      OR    SP, R0, LMZ
      OR    SP, SP, LMZ
      OR    SP, STR, LMZ
      ORI   SP, 66D0H, LMZ
      EOR   SP, R0, LP
      EOR   SP, SP, LP
      EOR   SP, STR, LP
      EORI  SP, 66D8H, LP
      OR    SP, R0, LP
      OR    SP, SP, LP
      OR    SP, STR, LP
      ORI   SP, 66E0H, LP
      EOR   SP, R0, LPZ
      EOR   SP, SP, LPZ
      EOR   SP, STR, LPZ
      EORI  SP, 66E8H, LPZ
      OR    SP, R0, LPZ
      OR    SP, SP, LPZ
      OR    SP, STR, LPZ
      ORI   SP, 66F0H, LPZ
      EOR   SP, R0, LM
      EOR   SP, SP, LM
      EOR   SP, STR, LM
      EORI  SP, 66F8H, LM
      OR    SP, R0, LM
      OR    SP, SP, LM
      OR    SP, STR, LM
      ORI   SP, 6700H, LM
      EOR   STR, R0
      EOR   STR, SP
      EOR   STR, STR
      EORI  STR, 6708H
      OR    STR, R0
      OR    STR, SP
      OR    STR, STR
      ORI   STR, 6710H
      EOR   STR, R0, SKP
      EOR   STR, SP, SKP
      EOR   STR, STR, SKP
      EORI  STR, 6718H, SKP
      OR    STR, R0, SKP
      OR    STR, SP, SKP
      OR    STR, STR, SKP
      ORI   STR, 6720H, SKP
      EOR   STR, R0, M
      EOR   STR, SP, M
      EOR   STR, STR, M
      EORI  STR, 6728H, M
      OR    STR, R0, M
      OR    STR, SP, M
      OR    STR, STR, M
      ORI   STR, 6730H, M
      EOR   STR, R0, PZ
      EOR   STR, SP, PZ
      EOR   STR, STR, PZ
      EORI  STR, 6738H, PZ
      OR    STR, R0, PZ
      OR    STR, SP, PZ
      OR    STR, STR, PZ
      ORI   STR, 6740H, PZ
      EOR   STR, R0, Z
      EOR   STR, SP, Z
      EOR   STR, STR, Z
      EORI  STR, 6748H, Z
      OR    STR, R0, Z
      OR    STR, SP, Z
      OR    STR, STR, Z
      ORI   STR, 6750H, Z
      EOR   STR, R0, NZ
      EOR   STR, SP, NZ
      EOR   STR, STR, NZ
      EORI  STR, 6758H, NZ
      OR    STR, R0, NZ
      OR    STR, SP, NZ
      OR    STR, STR, NZ
      ORI   STR, 6760H, NZ
      EOR   STR, R0, MZ
      EOR   STR, SP, MZ
      EOR   STR, STR, MZ
      EORI  STR, 6768H, MZ
      OR    STR, R0, MZ
      OR    STR, SP, MZ
      OR    STR, STR, MZ
      ORI   STR, 6770H, MZ
      EOR   STR, R0, P
      EOR   STR, SP, P
      EOR   STR, STR, P
      EORI  STR, 6778H, P
      OR    STR, R0, P
      OR    STR, SP, P
      OR    STR, STR, P
      ORI   STR, 6780H, P
      EOR   STR, R0, EZ
      EOR   STR, SP, EZ
      EOR   STR, STR, EZ
      EORI  STR, 6788H, EZ
      OR    STR, R0, EZ
      OR    STR, SP, EZ
      OR    STR, STR, EZ
      ORI   STR, 6790H, EZ
      EOR   STR, R0, ENZ
      EOR   STR, SP, ENZ
      EOR   STR, STR, ENZ
      EORI  STR, 6798H, ENZ
      OR    STR, R0, ENZ
      OR    STR, SP, ENZ
      OR    STR, STR, ENZ
      ORI   STR, 67A0H, ENZ
      EOR   STR, R0, OZ
      EOR   STR, SP, OZ
      EOR   STR, STR, OZ
      EORI  STR, 67A8H, OZ
      OR    STR, R0, OZ
      OR    STR, SP, OZ
      OR    STR, STR, OZ
      ORI   STR, 67B0H, OZ
      EOR   STR, R0, ONZ
      EOR   STR, SP, ONZ
      EOR   STR, STR, ONZ
      EORI  STR, 67B8H, ONZ
      OR    STR, R0, ONZ
      OR    STR, SP, ONZ
      OR    STR, STR, ONZ
      ORI   STR, 67C0H, ONZ
      EOR   STR, R0, LMZ
      EOR   STR, SP, LMZ
      EOR   STR, STR, LMZ
      EORI  STR, 67C8H, LMZ
      OR    STR, R0, LMZ
      OR    STR, SP, LMZ
      OR    STR, STR, LMZ
      ORI   STR, 67D0H, LMZ
      EOR   STR, R0, LP
      EOR   STR, SP, LP
      EOR   STR, STR, LP
      EORI  STR, 67D8H, LP
      OR    STR, R0, LP
      OR    STR, SP, LP
      OR    STR, STR, LP
      ORI   STR, 67E0H, LP
      EOR   STR, R0, LPZ
      EOR   STR, SP, LPZ
      EOR   STR, STR, LPZ
      EORI  STR, 67E8H, LPZ
      OR    STR, R0, LPZ
      OR    STR, SP, LPZ
      OR    STR, STR, LPZ
      ORI   STR, 67F0H, LPZ
      EOR   STR, R0, LM
      EOR   STR, SP, LM
      EOR   STR, STR, LM
      EORI  STR, 67F8H, LM
      OR    STR, R0, LM
      OR    STR, SP, LM
      OR    STR, STR, LM
      ORI   STR, 6800H, LM
      EORR  R0, (R1)
      FD    DR0, (R1)
      ORR   R0, (R1)
      FM    DR0, (R1)
      EORR  R0, (R1), SKP
      FD    DR0, (R1), SKP
      ORR   R0, (R1), SKP
      FM    DR0, (R1), SKP
      EORR  R0, (R1), M
      FD    DR0, (R1), M
      ORR   R0, (R1), M
      FM    DR0, (R1), M
      EORR  R0, (R1), PZ
      FD    DR0, (R1), PZ
      ORR   R0, (R1), PZ
      FM    DR0, (R1), PZ
      EORR  R0, (R1), Z
      FD    DR0, (R1), Z
      ORR   R0, (R1), Z
      FM    DR0, (R1), Z
      EORR  R0, (R1), NZ
      FD    DR0, (R1), NZ
      ORR   R0, (R1), NZ
      FM    DR0, (R1), NZ
      EORR  R0, (R1), MZ
      FD    DR0, (R1), MZ
      ORR   R0, (R1), MZ
      FM    DR0, (R1), MZ
      EORR  R0, (R1), P
      FD    DR0, (R1), P
      ORR   R0, (R1), P
      FM    DR0, (R1), P
      EORR  R0, (R1), EZ
      FD    DR0, (R1), EZ
      ORR   R0, (R1), EZ
      FM    DR0, (R1), EZ
      EORR  R0, (R1), ENZ
      FD    DR0, (R1), ENZ
      ORR   R0, (R1), ENZ
      FM    DR0, (R1), ENZ
      EORR  R0, (R1), OZ
      FD    DR0, (R1), OZ
      ORR   R0, (R1), OZ
      FM    DR0, (R1), OZ
      EORR  R0, (R1), ONZ
      FD    DR0, (R1), ONZ
      ORR   R0, (R1), ONZ
      FM    DR0, (R1), ONZ
      EORR  R0, (R1), LMZ
      FD    DR0, (R1), LMZ
      ORR   R0, (R1), LMZ
      FM    DR0, (R1), LMZ
      EORR  R0, (R1), LP
      FD    DR0, (R1), LP
      ORR   R0, (R1), LP
      FM    DR0, (R1), LP
      EORR  R0, (R1), LPZ
      FD    DR0, (R1), LPZ
      ORR   R0, (R1), LPZ
      FM    DR0, (R1), LPZ
      EORR  R0, (R1), LM
      FD    DR0, (R1), LM
      ORR   R0, (R1), LM
      FM    DR0, (R1), LM
      LAD   R0, R0
      LAD   R0, SP
      LAD   R0, STR
      LADI  R0, 6908H
      AND   R0, R0
      AND   R0, SP
      AND   R0, STR
      ANDI  R0, 6910H
      LAD   R0, R0, SKP
      LAD   R0, SP, SKP
      LAD   R0, STR, SKP
      LADI  R0, 6918H, SKP
      AND   R0, R0, SKP
      AND   R0, SP, SKP
      AND   R0, STR, SKP
      ANDI  R0, 6920H, SKP
      LAD   R0, R0, M
      LAD   R0, SP, M
      LAD   R0, STR, M
      LADI  R0, 6928H, M
      AND   R0, R0, M
      AND   R0, SP, M
      AND   R0, STR, M
      ANDI  R0, 6930H, M
      LAD   R0, R0, PZ
      LAD   R0, SP, PZ
      LAD   R0, STR, PZ
      LADI  R0, 6938H, PZ
      AND   R0, R0, PZ
      AND   R0, SP, PZ
      AND   R0, STR, PZ
      ANDI  R0, 6940H, PZ
      LAD   R0, R0, Z
      LAD   R0, SP, Z
      LAD   R0, STR, Z
      LADI  R0, 6948H, Z
      AND   R0, R0, Z
      AND   R0, SP, Z
      AND   R0, STR, Z
      ANDI  R0, 6950H, Z
      LAD   R0, R0, NZ
      LAD   R0, SP, NZ
      LAD   R0, STR, NZ
      LADI  R0, 6958H, NZ
      AND   R0, R0, NZ
      AND   R0, SP, NZ
      AND   R0, STR, NZ
      ANDI  R0, 6960H, NZ
      LAD   R0, R0, MZ
      LAD   R0, SP, MZ
      LAD   R0, STR, MZ
      LADI  R0, 6968H, MZ
      AND   R0, R0, MZ
      AND   R0, SP, MZ
      AND   R0, STR, MZ
      ANDI  R0, 6970H, MZ
      LAD   R0, R0, P
      LAD   R0, SP, P
      LAD   R0, STR, P
      LADI  R0, 6978H, P
      AND   R0, R0, P
      AND   R0, SP, P
      AND   R0, STR, P
      ANDI  R0, 6980H, P
      LAD   R0, R0, EZ
      LAD   R0, SP, EZ
      LAD   R0, STR, EZ
      LADI  R0, 6988H, EZ
      AND   R0, R0, EZ
      AND   R0, SP, EZ
      AND   R0, STR, EZ
      ANDI  R0, 6990H, EZ
      LAD   R0, R0, ENZ
      LAD   R0, SP, ENZ
      LAD   R0, STR, ENZ
      LADI  R0, 6998H, ENZ
      AND   R0, R0, ENZ
      AND   R0, SP, ENZ
      AND   R0, STR, ENZ
      ANDI  R0, 69A0H, ENZ
      LAD   R0, R0, OZ
      LAD   R0, SP, OZ
      LAD   R0, STR, OZ
      LADI  R0, 69A8H, OZ
      AND   R0, R0, OZ
      AND   R0, SP, OZ
      AND   R0, STR, OZ
      ANDI  R0, 69B0H, OZ
      LAD   R0, R0, ONZ
      LAD   R0, SP, ONZ
      LAD   R0, STR, ONZ
      LADI  R0, 69B8H, ONZ
      AND   R0, R0, ONZ
      AND   R0, SP, ONZ
      AND   R0, STR, ONZ
      ANDI  R0, 69C0H, ONZ
      LAD   R0, R0, LMZ
      LAD   R0, SP, LMZ
      LAD   R0, STR, LMZ
      LADI  R0, 69C8H, LMZ
      AND   R0, R0, LMZ
      AND   R0, SP, LMZ
      AND   R0, STR, LMZ
      ANDI  R0, 69D0H, LMZ
      LAD   R0, R0, LP
      LAD   R0, SP, LP
      LAD   R0, STR, LP
      LADI  R0, 69D8H, LP
      AND   R0, R0, LP
      AND   R0, SP, LP
      AND   R0, STR, LP
      ANDI  R0, 69E0H, LP
      LAD   R0, R0, LPZ
      LAD   R0, SP, LPZ
      LAD   R0, STR, LPZ
      LADI  R0, 69E8H, LPZ
      AND   R0, R0, LPZ
      AND   R0, SP, LPZ
      AND   R0, STR, LPZ
      ANDI  R0, 69F0H, LPZ
      LAD   R0, R0, LM
      LAD   R0, SP, LM
      LAD   R0, STR, LM
      LADI  R0, 69F8H, LM
      AND   R0, R0, LM
      AND   R0, SP, LM
      AND   R0, STR, LM
      ANDI  R0, 6A00H, LM
      LAD   SP, R0
      LAD   SP, SP
      LAD   SP, STR
      LADI  SP, 6E08H
      AND   SP, R0
      AND   SP, SP
      AND   SP, STR
      ANDI  SP, 6E10H
      LAD   SP, R0, SKP
      LAD   SP, SP, SKP
      LAD   SP, STR, SKP
      LADI  SP, 6E18H, SKP
      AND   SP, R0, SKP
      AND   SP, SP, SKP
      AND   SP, STR, SKP
      ANDI  SP, 6E20H, SKP
      LAD   SP, R0, M
      LAD   SP, SP, M
      LAD   SP, STR, M
      LADI  SP, 6E28H, M
      AND   SP, R0, M
      AND   SP, SP, M
      AND   SP, STR, M
      ANDI  SP, 6E30H, M
      LAD   SP, R0, PZ
      LAD   SP, SP, PZ
      LAD   SP, STR, PZ
      LADI  SP, 6E38H, PZ
      AND   SP, R0, PZ
      AND   SP, SP, PZ
      AND   SP, STR, PZ
      ANDI  SP, 6E40H, PZ
      LAD   SP, R0, Z
      LAD   SP, SP, Z
      LAD   SP, STR, Z
      LADI  SP, 6E48H, Z
      AND   SP, R0, Z
      AND   SP, SP, Z
      AND   SP, STR, Z
      ANDI  SP, 6E50H, Z
      LAD   SP, R0, NZ
      LAD   SP, SP, NZ
      LAD   SP, STR, NZ
      LADI  SP, 6E58H, NZ
      AND   SP, R0, NZ
      AND   SP, SP, NZ
      AND   SP, STR, NZ
      ANDI  SP, 6E60H, NZ
      LAD   SP, R0, MZ
      LAD   SP, SP, MZ
      LAD   SP, STR, MZ
      LADI  SP, 6E68H, MZ
      AND   SP, R0, MZ
      AND   SP, SP, MZ
      AND   SP, STR, MZ
      ANDI  SP, 6E70H, MZ
      LAD   SP, R0, P
      LAD   SP, SP, P
      LAD   SP, STR, P
      LADI  SP, 6E78H, P
      AND   SP, R0, P
      AND   SP, SP, P
      AND   SP, STR, P
      ANDI  SP, 6E80H, P
      LAD   SP, R0, EZ
      LAD   SP, SP, EZ
      LAD   SP, STR, EZ
      LADI  SP, 6E88H, EZ
      AND   SP, R0, EZ
      AND   SP, SP, EZ
      AND   SP, STR, EZ
      ANDI  SP, 6E90H, EZ
      LAD   SP, R0, ENZ
      LAD   SP, SP, ENZ
      LAD   SP, STR, ENZ
      LADI  SP, 6E98H, ENZ
      AND   SP, R0, ENZ
      AND   SP, SP, ENZ
      AND   SP, STR, ENZ
      ANDI  SP, 6EA0H, ENZ
      LAD   SP, R0, OZ
      LAD   SP, SP, OZ
      LAD   SP, STR, OZ
      LADI  SP, 6EA8H, OZ
      AND   SP, R0, OZ
      AND   SP, SP, OZ
      AND   SP, STR, OZ
      ANDI  SP, 6EB0H, OZ
      LAD   SP, R0, ONZ
      LAD   SP, SP, ONZ
      LAD   SP, STR, ONZ
      LADI  SP, 6EB8H, ONZ
      AND   SP, R0, ONZ
      AND   SP, SP, ONZ
      AND   SP, STR, ONZ
      ANDI  SP, 6EC0H, ONZ
      LAD   SP, R0, LMZ
      LAD   SP, SP, LMZ
      LAD   SP, STR, LMZ
      LADI  SP, 6EC8H, LMZ
      AND   SP, R0, LMZ
      AND   SP, SP, LMZ
      AND   SP, STR, LMZ
      ANDI  SP, 6ED0H, LMZ
      LAD   SP, R0, LP
      LAD   SP, SP, LP
      LAD   SP, STR, LP
      LADI  SP, 6ED8H, LP
      AND   SP, R0, LP
      AND   SP, SP, LP
      AND   SP, STR, LP
      ANDI  SP, 6EE0H, LP
      LAD   SP, R0, LPZ
      LAD   SP, SP, LPZ
      LAD   SP, STR, LPZ
      LADI  SP, 6EE8H, LPZ
      AND   SP, R0, LPZ
      AND   SP, SP, LPZ
      AND   SP, STR, LPZ
      ANDI  SP, 6EF0H, LPZ
      LAD   SP, R0, LM
      LAD   SP, SP, LM
      LAD   SP, STR, LM
      LADI  SP, 6EF8H, LM
      AND   SP, R0, LM
      AND   SP, SP, LM
      AND   SP, STR, LM
      ANDI  SP, 6F00H, LM
      LAD   STR, R0
      LAD   STR, SP
      LAD   STR, STR
      LADI  STR, 6F08H
      AND   STR, R0
      AND   STR, SP
      AND   STR, STR
      ANDI  STR, 6F10H
      LAD   STR, R0, SKP
      LAD   STR, SP, SKP
      LAD   STR, STR, SKP
      LADI  STR, 6F18H, SKP
      AND   STR, R0, SKP
      AND   STR, SP, SKP
      AND   STR, STR, SKP
      ANDI  STR, 6F20H, SKP
      LAD   STR, R0, M
      LAD   STR, SP, M
      LAD   STR, STR, M
      LADI  STR, 6F28H, M
      AND   STR, R0, M
      AND   STR, SP, M
      AND   STR, STR, M
      ANDI  STR, 6F30H, M
      LAD   STR, R0, PZ
      LAD   STR, SP, PZ
      LAD   STR, STR, PZ
      LADI  STR, 6F38H, PZ
      AND   STR, R0, PZ
      AND   STR, SP, PZ
      AND   STR, STR, PZ
      ANDI  STR, 6F40H, PZ
      LAD   STR, R0, Z
      LAD   STR, SP, Z
      LAD   STR, STR, Z
      LADI  STR, 6F48H, Z
      AND   STR, R0, Z
      AND   STR, SP, Z
      AND   STR, STR, Z
      ANDI  STR, 6F50H, Z
      LAD   STR, R0, NZ
      LAD   STR, SP, NZ
      LAD   STR, STR, NZ
      LADI  STR, 6F58H, NZ
      AND   STR, R0, NZ
      AND   STR, SP, NZ
      AND   STR, STR, NZ
      ANDI  STR, 6F60H, NZ
      LAD   STR, R0, MZ
      LAD   STR, SP, MZ
      LAD   STR, STR, MZ
      LADI  STR, 6F68H, MZ
      AND   STR, R0, MZ
      AND   STR, SP, MZ
      AND   STR, STR, MZ
      ANDI  STR, 6F70H, MZ
      LAD   STR, R0, P
      LAD   STR, SP, P
      LAD   STR, STR, P
      LADI  STR, 6F78H, P
      AND   STR, R0, P
      AND   STR, SP, P
      AND   STR, STR, P
      ANDI  STR, 6F80H, P
      LAD   STR, R0, EZ
      LAD   STR, SP, EZ
      LAD   STR, STR, EZ
      LADI  STR, 6F88H, EZ
      AND   STR, R0, EZ
      AND   STR, SP, EZ
      AND   STR, STR, EZ
      ANDI  STR, 6F90H, EZ
      LAD   STR, R0, ENZ
      LAD   STR, SP, ENZ
      LAD   STR, STR, ENZ
      LADI  STR, 6F98H, ENZ
      AND   STR, R0, ENZ
      AND   STR, SP, ENZ
      AND   STR, STR, ENZ
      ANDI  STR, 6FA0H, ENZ
      LAD   STR, R0, OZ
      LAD   STR, SP, OZ
      LAD   STR, STR, OZ
      LADI  STR, 6FA8H, OZ
      AND   STR, R0, OZ
      AND   STR, SP, OZ
      AND   STR, STR, OZ
      ANDI  STR, 6FB0H, OZ
      LAD   STR, R0, ONZ
      LAD   STR, SP, ONZ
      LAD   STR, STR, ONZ
      LADI  STR, 6FB8H, ONZ
      AND   STR, R0, ONZ
      AND   STR, SP, ONZ
      AND   STR, STR, ONZ
      ANDI  STR, 6FC0H, ONZ
      LAD   STR, R0, LMZ
      LAD   STR, SP, LMZ
      LAD   STR, STR, LMZ
      LADI  STR, 6FC8H, LMZ
      AND   STR, R0, LMZ
      AND   STR, SP, LMZ
      AND   STR, STR, LMZ
      ANDI  STR, 6FD0H, LMZ
      LAD   STR, R0, LP
      LAD   STR, SP, LP
      LAD   STR, STR, LP
      LADI  STR, 6FD8H, LP
      AND   STR, R0, LP
      AND   STR, SP, LP
      AND   STR, STR, LP
      ANDI  STR, 6FE0H, LP
      LAD   STR, R0, LPZ
      LAD   STR, SP, LPZ
      LAD   STR, STR, LPZ
      LADI  STR, 6FE8H, LPZ
      AND   STR, R0, LPZ
      AND   STR, SP, LPZ
      AND   STR, STR, LPZ
      ANDI  STR, 6FF0H, LPZ
      LAD   STR, R0, LM
      LAD   STR, SP, LM
      LAD   STR, STR, LM
      LADI  STR, 6FF8H, LM
      AND   STR, R0, LM
      AND   STR, SP, LM
      AND   STR, STR, LM
      ANDI  STR, 7000H, LM
      LADR  R0, (R1)
      FS    DR0, (R1)
      ANDR  R0, (R1)
      FA    DR0, (R1)
      LADR  R0, (R1), SKP
      FS    DR0, (R1), SKP
      ANDR  R0, (R1), SKP
      FA    DR0, (R1), SKP
      LADR  R0, (R1), M
      FS    DR0, (R1), M
      ANDR  R0, (R1), M
      FA    DR0, (R1), M
      LADR  R0, (R1), PZ
      FS    DR0, (R1), PZ
      ANDR  R0, (R1), PZ
      FA    DR0, (R1), PZ
      LADR  R0, (R1), Z
      FS    DR0, (R1), Z
      ANDR  R0, (R1), Z
      FA    DR0, (R1), Z
      LADR  R0, (R1), NZ
      FS    DR0, (R1), NZ
      ANDR  R0, (R1), NZ
      FA    DR0, (R1), NZ
      LADR  R0, (R1), MZ
      FS    DR0, (R1), MZ
      ANDR  R0, (R1), MZ
      FA    DR0, (R1), MZ
      LADR  R0, (R1), P
      FS    DR0, (R1), P
      ANDR  R0, (R1), P
      FA    DR0, (R1), P
      LADR  R0, (R1), EZ
      FS    DR0, (R1), EZ
      ANDR  R0, (R1), EZ
      FA    DR0, (R1), EZ
      LADR  R0, (R1), ENZ
      FS    DR0, (R1), ENZ
      ANDR  R0, (R1), ENZ
      FA    DR0, (R1), ENZ
      LADR  R0, (R1), OZ
      FS    DR0, (R1), OZ
      ANDR  R0, (R1), OZ
      FA    DR0, (R1), OZ
      LADR  R0, (R1), ONZ
      FS    DR0, (R1), ONZ
      ANDR  R0, (R1), ONZ
      FA    DR0, (R1), ONZ
      LADR  R0, (R1), LMZ
      FS    DR0, (R1), LMZ
      ANDR  R0, (R1), LMZ
      FA    DR0, (R1), LMZ
      LADR  R0, (R1), LP
      FS    DR0, (R1), LP
      ANDR  R0, (R1), LP
      FA    DR0, (R1), LP
      LADR  R0, (R1), LPZ
      FS    DR0, (R1), LPZ
      ANDR  R0, (R1), LPZ
      FA    DR0, (R1), LPZ
      LADR  R0, (R1), LM
      FS    DR0, (R1), LM
      ANDR  R0, (R1), LM
      FA    DR0, (R1), LM
      DSWP  R0, R0
      DSWP  R0, SP
      DSWP  R0, STR
      BSWP  R0, R0
      BSWP  R0, SP
      BSWP  R0, STR
      DSWP  R0, R0, SKP
      DSWP  R0, SP, SKP
      DSWP  R0, STR, SKP
      BSWP  R0, R0, SKP
      BSWP  R0, SP, SKP
      BSWP  R0, STR, SKP
      DSWP  R0, R0, M
      DSWP  R0, SP, M
      DSWP  R0, STR, M
      BSWP  R0, R0, M
      BSWP  R0, SP, M
      BSWP  R0, STR, M
      DSWP  R0, R0, PZ
      DSWP  R0, SP, PZ
      DSWP  R0, STR, PZ
      BSWP  R0, R0, PZ
      BSWP  R0, SP, PZ
      BSWP  R0, STR, PZ
      DSWP  R0, R0, Z
      DSWP  R0, SP, Z
      DSWP  R0, STR, Z
      BSWP  R0, R0, Z
      BSWP  R0, SP, Z
      BSWP  R0, STR, Z
      DSWP  R0, R0, NZ
      DSWP  R0, SP, NZ
      DSWP  R0, STR, NZ
      BSWP  R0, R0, NZ
      BSWP  R0, SP, NZ
      BSWP  R0, STR, NZ
      DSWP  R0, R0, MZ
      DSWP  R0, SP, MZ
      DSWP  R0, STR, MZ
      BSWP  R0, R0, MZ
      BSWP  R0, SP, MZ
      BSWP  R0, STR, MZ
      DSWP  R0, R0, P
      DSWP  R0, SP, P
      DSWP  R0, STR, P
      BSWP  R0, R0, P
      BSWP  R0, SP, P
      BSWP  R0, STR, P
      DSWP  R0, R0, EZ
      DSWP  R0, SP, EZ
      DSWP  R0, STR, EZ
      BSWP  R0, R0, EZ
      BSWP  R0, SP, EZ
      BSWP  R0, STR, EZ
      DSWP  R0, R0, ENZ
      DSWP  R0, SP, ENZ
      DSWP  R0, STR, ENZ
      BSWP  R0, R0, ENZ
      BSWP  R0, SP, ENZ
      BSWP  R0, STR, ENZ
      DSWP  R0, R0, OZ
      DSWP  R0, SP, OZ
      DSWP  R0, STR, OZ
      BSWP  R0, R0, OZ
      BSWP  R0, SP, OZ
      BSWP  R0, STR, OZ
      DSWP  R0, R0, ONZ
      DSWP  R0, SP, ONZ
      DSWP  R0, STR, ONZ
      BSWP  R0, R0, ONZ
      BSWP  R0, SP, ONZ
      BSWP  R0, STR, ONZ
      DSWP  R0, R0, LMZ
      DSWP  R0, SP, LMZ
      DSWP  R0, STR, LMZ
      BSWP  R0, R0, LMZ
      BSWP  R0, SP, LMZ
      BSWP  R0, STR, LMZ
      DSWP  R0, R0, LP
      DSWP  R0, SP, LP
      DSWP  R0, STR, LP
      BSWP  R0, R0, LP
      BSWP  R0, SP, LP
      BSWP  R0, STR, LP
      DSWP  R0, R0, LPZ
      DSWP  R0, SP, LPZ
      DSWP  R0, STR, LPZ
      BSWP  R0, R0, LPZ
      BSWP  R0, SP, LPZ
      BSWP  R0, STR, LPZ
      DSWP  R0, R0, LM
      DSWP  R0, SP, LM
      DSWP  R0, STR, LM
      BSWP  R0, R0, LM
      BSWP  R0, SP, LM
      BSWP  R0, STR, LM
      DSWP  SP, R0
      DSWP  SP, SP
      DSWP  SP, STR
      BSWP  SP, R0
      BSWP  SP, SP
      BSWP  SP, STR
      DSWP  SP, R0, SKP
      DSWP  SP, SP, SKP
      DSWP  SP, STR, SKP
      BSWP  SP, R0, SKP
      BSWP  SP, SP, SKP
      BSWP  SP, STR, SKP
      DSWP  SP, R0, M
      DSWP  SP, SP, M
      DSWP  SP, STR, M
      BSWP  SP, R0, M
      BSWP  SP, SP, M
      BSWP  SP, STR, M
      DSWP  SP, R0, PZ
      DSWP  SP, SP, PZ
      DSWP  SP, STR, PZ
      BSWP  SP, R0, PZ
      BSWP  SP, SP, PZ
      BSWP  SP, STR, PZ
      DSWP  SP, R0, Z
      DSWP  SP, SP, Z
      DSWP  SP, STR, Z
      BSWP  SP, R0, Z
      BSWP  SP, SP, Z
      BSWP  SP, STR, Z
      DSWP  SP, R0, NZ
      DSWP  SP, SP, NZ
      DSWP  SP, STR, NZ
      BSWP  SP, R0, NZ
      BSWP  SP, SP, NZ
      BSWP  SP, STR, NZ
      DSWP  SP, R0, MZ
      DSWP  SP, SP, MZ
      DSWP  SP, STR, MZ
      BSWP  SP, R0, MZ
      BSWP  SP, SP, MZ
      BSWP  SP, STR, MZ
      DSWP  SP, R0, P
      DSWP  SP, SP, P
      DSWP  SP, STR, P
      BSWP  SP, R0, P
      BSWP  SP, SP, P
      BSWP  SP, STR, P
      DSWP  SP, R0, EZ
      DSWP  SP, SP, EZ
      DSWP  SP, STR, EZ
      BSWP  SP, R0, EZ
      BSWP  SP, SP, EZ
      BSWP  SP, STR, EZ
      DSWP  SP, R0, ENZ
      DSWP  SP, SP, ENZ
      DSWP  SP, STR, ENZ
      BSWP  SP, R0, ENZ
      BSWP  SP, SP, ENZ
      BSWP  SP, STR, ENZ
      DSWP  SP, R0, OZ
      DSWP  SP, SP, OZ
      DSWP  SP, STR, OZ
      BSWP  SP, R0, OZ
      BSWP  SP, SP, OZ
      BSWP  SP, STR, OZ
      DSWP  SP, R0, ONZ
      DSWP  SP, SP, ONZ
      DSWP  SP, STR, ONZ
      BSWP  SP, R0, ONZ
      BSWP  SP, SP, ONZ
      BSWP  SP, STR, ONZ
      DSWP  SP, R0, LMZ
      DSWP  SP, SP, LMZ
      DSWP  SP, STR, LMZ
      BSWP  SP, R0, LMZ
      BSWP  SP, SP, LMZ
      BSWP  SP, STR, LMZ
      DSWP  SP, R0, LP
      DSWP  SP, SP, LP
      DSWP  SP, STR, LP
      BSWP  SP, R0, LP
      BSWP  SP, SP, LP
      BSWP  SP, STR, LP
      DSWP  SP, R0, LPZ
      DSWP  SP, SP, LPZ
      DSWP  SP, STR, LPZ
      BSWP  SP, R0, LPZ
      BSWP  SP, SP, LPZ
      BSWP  SP, STR, LPZ
      DSWP  SP, R0, LM
      DSWP  SP, SP, LM
      DSWP  SP, STR, LM
      BSWP  SP, R0, LM
      BSWP  SP, SP, LM
      BSWP  SP, STR, LM
      DSWP  STR, R0
      DSWP  STR, SP
      DSWP  STR, STR
      BSWP  STR, R0
      BSWP  STR, SP
      BSWP  STR, STR
      DSWP  STR, R0, SKP
      DSWP  STR, SP, SKP
      DSWP  STR, STR, SKP
      BSWP  STR, R0, SKP
      BSWP  STR, SP, SKP
      BSWP  STR, STR, SKP
      DSWP  STR, R0, M
      DSWP  STR, SP, M
      DSWP  STR, STR, M
      BSWP  STR, R0, M
      BSWP  STR, SP, M
      BSWP  STR, STR, M
      DSWP  STR, R0, PZ
      DSWP  STR, SP, PZ
      DSWP  STR, STR, PZ
      BSWP  STR, R0, PZ
      BSWP  STR, SP, PZ
      BSWP  STR, STR, PZ
      DSWP  STR, R0, Z
      DSWP  STR, SP, Z
      DSWP  STR, STR, Z
      BSWP  STR, R0, Z
      BSWP  STR, SP, Z
      BSWP  STR, STR, Z
      DSWP  STR, R0, NZ
      DSWP  STR, SP, NZ
      DSWP  STR, STR, NZ
      BSWP  STR, R0, NZ
      BSWP  STR, SP, NZ
      BSWP  STR, STR, NZ
      DSWP  STR, R0, MZ
      DSWP  STR, SP, MZ
      DSWP  STR, STR, MZ
      BSWP  STR, R0, MZ
      BSWP  STR, SP, MZ
      BSWP  STR, STR, MZ
      DSWP  STR, R0, P
      DSWP  STR, SP, P
      DSWP  STR, STR, P
      BSWP  STR, R0, P
      BSWP  STR, SP, P
      BSWP  STR, STR, P
      DSWP  STR, R0, EZ
      DSWP  STR, SP, EZ
      DSWP  STR, STR, EZ
      BSWP  STR, R0, EZ
      BSWP  STR, SP, EZ
      BSWP  STR, STR, EZ
      DSWP  STR, R0, ENZ
      DSWP  STR, SP, ENZ
      DSWP  STR, STR, ENZ
      BSWP  STR, R0, ENZ
      BSWP  STR, SP, ENZ
      BSWP  STR, STR, ENZ
      DSWP  STR, R0, OZ
      DSWP  STR, SP, OZ
      DSWP  STR, STR, OZ
      BSWP  STR, R0, OZ
      BSWP  STR, SP, OZ
      BSWP  STR, STR, OZ
      DSWP  STR, R0, ONZ
      DSWP  STR, SP, ONZ
      DSWP  STR, STR, ONZ
      BSWP  STR, R0, ONZ
      BSWP  STR, SP, ONZ
      BSWP  STR, STR, ONZ
      DSWP  STR, R0, LMZ
      DSWP  STR, SP, LMZ
      DSWP  STR, STR, LMZ
      BSWP  STR, R0, LMZ
      BSWP  STR, SP, LMZ
      BSWP  STR, STR, LMZ
      DSWP  STR, R0, LP
      DSWP  STR, SP, LP
      DSWP  STR, STR, LP
      BSWP  STR, R0, LP
      BSWP  STR, SP, LP
      BSWP  STR, STR, LP
      DSWP  STR, R0, LPZ
      DSWP  STR, SP, LPZ
      DSWP  STR, STR, LPZ
      BSWP  STR, R0, LPZ
      BSWP  STR, SP, LPZ
      BSWP  STR, STR, LPZ
      DSWP  STR, R0, LM
      DSWP  STR, SP, LM
      DSWP  STR, STR, LM
      BSWP  STR, R0, LM
      BSWP  STR, SP, LM
      BSWP  STR, STR, LM
      DSWR  R0, (R1)
      BSWR  R0, (R1)
      D     DR0, (R1)
      DSWR  R0, (R1), SKP
      BSWR  R0, (R1), SKP
      D     DR0, (R1), SKP
      DSWR  R0, (R1), M
      BSWR  R0, (R1), M
      D     DR0, (R1), M
      DSWR  R0, (R1), PZ
      BSWR  R0, (R1), PZ
      D     DR0, (R1), PZ
      DSWR  R0, (R1), Z
      BSWR  R0, (R1), Z
      D     DR0, (R1), Z
      DSWR  R0, (R1), NZ
      BSWR  R0, (R1), NZ
      D     DR0, (R1), NZ
      DSWR  R0, (R1), MZ
      BSWR  R0, (R1), MZ
      D     DR0, (R1), MZ
      DSWR  R0, (R1), P
      BSWR  R0, (R1), P
      D     DR0, (R1), P
      DSWR  R0, (R1), EZ
      BSWR  R0, (R1), EZ
      D     DR0, (R1), EZ
      DSWR  R0, (R1), ENZ
      BSWR  R0, (R1), ENZ
      D     DR0, (R1), ENZ
      DSWR  R0, (R1), OZ
      BSWR  R0, (R1), OZ
      D     DR0, (R1), OZ
      DSWR  R0, (R1), ONZ
      BSWR  R0, (R1), ONZ
      D     DR0, (R1), ONZ
      DSWR  R0, (R1), LMZ
      BSWR  R0, (R1), LMZ
      D     DR0, (R1), LMZ
      DSWR  R0, (R1), LP
      BSWR  R0, (R1), LP
      D     DR0, (R1), LP
      DSWR  R0, (R1), LPZ
      BSWR  R0, (R1), LPZ
      D     DR0, (R1), LPZ
      DSWR  R0, (R1), LM
      BSWR  R0, (R1), LM
      D     DR0, (R1), LM
      MVB   R0, R0
      MVB   R0, SP
      MVB   R0, STR
      MV    R0, R0
      MV    R0, SP
      MV    R0, STR
      MVWI  R0, 7910H
      MVB   R0, R0, SKP
      MVB   R0, SP, SKP
      MVB   R0, STR, SKP
      MV    R0, R0, SKP
      MV    R0, SP, SKP
      MV    R0, STR, SKP
      MVWI  R0, 7920H, SKP
      MVB   R0, R0, M
      MVB   R0, SP, M
      MVB   R0, STR, M
      MV    R0, R0, M
      MV    R0, SP, M
      MV    R0, STR, M
      MVWI  R0, 7930H, M
      MVB   R0, R0, PZ
      MVB   R0, SP, PZ
      MVB   R0, STR, PZ
      MV    R0, R0, PZ
      MV    R0, SP, PZ
      MV    R0, STR, PZ
      MVWI  R0, 7940H, PZ
      MVB   R0, R0, Z
      MVB   R0, SP, Z
      MVB   R0, STR, Z
      MV    R0, R0, Z
      MV    R0, SP, Z
      MV    R0, STR, Z
      MVWI  R0, 7950H, Z
      MVB   R0, R0, NZ
      MVB   R0, SP, NZ
      MVB   R0, STR, NZ
      MV    R0, R0, NZ
      MV    R0, SP, NZ
      MV    R0, STR, NZ
      MVWI  R0, 7960H, NZ
      MVB   R0, R0, MZ
      MVB   R0, SP, MZ
      MVB   R0, STR, MZ
      MV    R0, R0, MZ
      MV    R0, SP, MZ
      MV    R0, STR, MZ
      MVWI  R0, 7970H, MZ
      MVB   R0, R0, P
      MVB   R0, SP, P
      MVB   R0, STR, P
      MV    R0, R0, P
      MV    R0, SP, P
      MV    R0, STR, P
      MVWI  R0, 7980H, P
      MVB   R0, R0, EZ
      MVB   R0, SP, EZ
      MVB   R0, STR, EZ
      MV    R0, R0, EZ
      MV    R0, SP, EZ
      MV    R0, STR, EZ
      MVWI  R0, 7990H, EZ
      MVB   R0, R0, ENZ
      MVB   R0, SP, ENZ
      MVB   R0, STR, ENZ
      MV    R0, R0, ENZ
      MV    R0, SP, ENZ
      MV    R0, STR, ENZ
      MVWI  R0, 79A0H, ENZ
      MVB   R0, R0, OZ
      MVB   R0, SP, OZ
      MVB   R0, STR, OZ
      MV    R0, R0, OZ
      MV    R0, SP, OZ
      MV    R0, STR, OZ
      MVWI  R0, 79B0H, OZ
      MVB   R0, R0, ONZ
      MVB   R0, SP, ONZ
      MVB   R0, STR, ONZ
      MV    R0, R0, ONZ
      MV    R0, SP, ONZ
      MV    R0, STR, ONZ
      MVWI  R0, 79C0H, ONZ
      MVB   R0, R0, LMZ
      MVB   R0, SP, LMZ
      MVB   R0, STR, LMZ
      MV    R0, R0, LMZ
      MV    R0, SP, LMZ
      MV    R0, STR, LMZ
      MVWI  R0, 79D0H, LMZ
      MVB   R0, R0, LP
      MVB   R0, SP, LP
      MVB   R0, STR, LP
      MV    R0, R0, LP
      MV    R0, SP, LP
      MV    R0, STR, LP
      MVWI  R0, 79E0H, LP
      MVB   R0, R0, LPZ
      MVB   R0, SP, LPZ
      MVB   R0, STR, LPZ
      MV    R0, R0, LPZ
      MV    R0, SP, LPZ
      MV    R0, STR, LPZ
      MVWI  R0, 79F0H, LPZ
      MVB   R0, R0, LM
      MVB   R0, SP, LM
      MVB   R0, STR, LM
      MV    R0, R0, LM
      MV    R0, SP, LM
      MV    R0, STR, LM
      MVWI  R0, 7A00H, LM
      MVB   SP, R0
      MVB   SP, SP
      MVB   SP, STR
      MV    SP, R0
      MV    SP, SP
      MV    SP, STR
      MVWI  SP, 7E10H
      MVB   SP, R0, SKP
      MVB   SP, SP, SKP
      MVB   SP, STR, SKP
      MV    SP, R0, SKP
      MV    SP, SP, SKP
      MV    SP, STR, SKP
      MVWI  SP, 7E20H, SKP
      MVB   SP, R0, M
      MVB   SP, SP, M
      MVB   SP, STR, M
      MV    SP, R0, M
      MV    SP, SP, M
      MV    SP, STR, M
      MVWI  SP, 7E30H, M
      MVB   SP, R0, PZ
      MVB   SP, SP, PZ
      MVB   SP, STR, PZ
      MV    SP, R0, PZ
      MV    SP, SP, PZ
      MV    SP, STR, PZ
      MVWI  SP, 7E40H, PZ
      MVB   SP, R0, Z
      MVB   SP, SP, Z
      MVB   SP, STR, Z
      MV    SP, R0, Z
      MV    SP, SP, Z
      MV    SP, STR, Z
      MVWI  SP, 7E50H, Z
      MVB   SP, R0, NZ
      MVB   SP, SP, NZ
      MVB   SP, STR, NZ
      MV    SP, R0, NZ
      MV    SP, SP, NZ
      MV    SP, STR, NZ
      MVWI  SP, 7E60H, NZ
      MVB   SP, R0, MZ
      MVB   SP, SP, MZ
      MVB   SP, STR, MZ
      MV    SP, R0, MZ
      MV    SP, SP, MZ
      MV    SP, STR, MZ
      MVWI  SP, 7E70H, MZ
      MVB   SP, R0, P
      MVB   SP, SP, P
      MVB   SP, STR, P
      MV    SP, R0, P
      MV    SP, SP, P
      MV    SP, STR, P
      MVWI  SP, 7E80H, P
      MVB   SP, R0, EZ
      MVB   SP, SP, EZ
      MVB   SP, STR, EZ
      MV    SP, R0, EZ
      MV    SP, SP, EZ
      MV    SP, STR, EZ
      MVWI  SP, 7E90H, EZ
      MVB   SP, R0, ENZ
      MVB   SP, SP, ENZ
      MVB   SP, STR, ENZ
      MV    SP, R0, ENZ
      MV    SP, SP, ENZ
      MV    SP, STR, ENZ
      MVWI  SP, 7EA0H, ENZ
      MVB   SP, R0, OZ
      MVB   SP, SP, OZ
      MVB   SP, STR, OZ
      MV    SP, R0, OZ
      MV    SP, SP, OZ
      MV    SP, STR, OZ
      MVWI  SP, 7EB0H, OZ
      MVB   SP, R0, ONZ
      MVB   SP, SP, ONZ
      MVB   SP, STR, ONZ
      MV    SP, R0, ONZ
      MV    SP, SP, ONZ
      MV    SP, STR, ONZ
      MVWI  SP, 7EC0H, ONZ
      MVB   SP, R0, LMZ
      MVB   SP, SP, LMZ
      MVB   SP, STR, LMZ
      MV    SP, R0, LMZ
      MV    SP, SP, LMZ
      MV    SP, STR, LMZ
      MVWI  SP, 7ED0H, LMZ
      MVB   SP, R0, LP
      MVB   SP, SP, LP
      MVB   SP, STR, LP
      MV    SP, R0, LP
      MV    SP, SP, LP
      MV    SP, STR, LP
      MVWI  SP, 7EE0H, LP
      MVB   SP, R0, LPZ
      MVB   SP, SP, LPZ
      MVB   SP, STR, LPZ
      MV    SP, R0, LPZ
      MV    SP, SP, LPZ
      MV    SP, STR, LPZ
      MVWI  SP, 7EF0H, LPZ
      MVB   SP, R0, LM
      MVB   SP, SP, LM
      MVB   SP, STR, LM
      MV    SP, R0, LM
      MV    SP, SP, LM
      MV    SP, STR, LM
      MVWI  SP, 7F00H, LM
      MVB   STR, R0
      MVB   STR, SP
      MVB   STR, STR
      MV    STR, R0
      MV    STR, SP
      MV    STR, STR
      MVWI  STR, 7F10H
      MVB   STR, R0, SKP
      MVB   STR, SP, SKP
      MVB   STR, STR, SKP
      MV    STR, R0, SKP
      MV    STR, SP, SKP
      MV    STR, STR, SKP
      MVWI  STR, 7F20H, SKP
      MVB   STR, R0, M
      MVB   STR, SP, M
      MVB   STR, STR, M
      MV    STR, R0, M
      MV    STR, SP, M
      MV    STR, STR, M
      MVWI  STR, 7F30H, M
      MVB   STR, R0, PZ
      MVB   STR, SP, PZ
      MVB   STR, STR, PZ
      MV    STR, R0, PZ
      MV    STR, SP, PZ
      MV    STR, STR, PZ
      MVWI  STR, 7F40H, PZ
      MVB   STR, R0, Z
      MVB   STR, SP, Z
      MVB   STR, STR, Z
      MV    STR, R0, Z
      MV    STR, SP, Z
      MV    STR, STR, Z
      MVWI  STR, 7F50H, Z
      MVB   STR, R0, NZ
      MVB   STR, SP, NZ
      MVB   STR, STR, NZ
      MV    STR, R0, NZ
      MV    STR, SP, NZ
      MV    STR, STR, NZ
      MVWI  STR, 7F60H, NZ
      MVB   STR, R0, MZ
      MVB   STR, SP, MZ
      MVB   STR, STR, MZ
      MV    STR, R0, MZ
      MV    STR, SP, MZ
      MV    STR, STR, MZ
      MVWI  STR, 7F70H, MZ
      MVB   STR, R0, P
      MVB   STR, SP, P
      MVB   STR, STR, P
      MV    STR, R0, P
      MV    STR, SP, P
      MV    STR, STR, P
      MVWI  STR, 7F80H, P
      MVB   STR, R0, EZ
      MVB   STR, SP, EZ
      MVB   STR, STR, EZ
      MV    STR, R0, EZ
      MV    STR, SP, EZ
      MV    STR, STR, EZ
      MVWI  STR, 7F90H, EZ
      MVB   STR, R0, ENZ
      MVB   STR, SP, ENZ
      MVB   STR, STR, ENZ
      MV    STR, R0, ENZ
      MV    STR, SP, ENZ
      MV    STR, STR, ENZ
      MVWI  STR, 7FA0H, ENZ
      MVB   STR, R0, OZ
      MVB   STR, SP, OZ
      MVB   STR, STR, OZ
      MV    STR, R0, OZ
      MV    STR, SP, OZ
      MV    STR, STR, OZ
      MVWI  STR, 7FB0H, OZ
      MVB   STR, R0, ONZ
      MVB   STR, SP, ONZ
      MVB   STR, STR, ONZ
      MV    STR, R0, ONZ
      MV    STR, SP, ONZ
      MV    STR, STR, ONZ
      MVWI  STR, 7FC0H, ONZ
      MVB   STR, R0, LMZ
      MVB   STR, SP, LMZ
      MVB   STR, STR, LMZ
      MV    STR, R0, LMZ
      MV    STR, SP, LMZ
      MV    STR, STR, LMZ
      MVWI  STR, 7FD0H, LMZ
      MVB   STR, R0, LP
      MVB   STR, SP, LP
      MVB   STR, STR, LP
      MV    STR, R0, LP
      MV    STR, SP, LP
      MV    STR, STR, LP
      MVWI  STR, 7FE0H, LP
      MVB   STR, R0, LPZ
      MVB   STR, SP, LPZ
      MVB   STR, STR, LPZ
      MV    STR, R0, LPZ
      MV    STR, SP, LPZ
      MV    STR, STR, LPZ
      MVWI  STR, 7FF0H, LPZ
      MVB   STR, R0, LM
      MVB   STR, SP, LM
      MVB   STR, STR, LM
      MV    STR, R0, LM
      MV    STR, SP, LM
      MV    STR, STR, LM
      MVWI  STR, 8000H, LM
      MVBR  R0, (R1)
      MVWR  R0, (R1)
      M     DR0, (R1)
      MVBR  R0, (R1), SKP
      MVWR  R0, (R1), SKP
      M     DR0, (R1), SKP
      MVBR  R0, (R1), M
      MVWR  R0, (R1), M
      M     DR0, (R1), M
      MVBR  R0, (R1), PZ
      MVWR  R0, (R1), PZ
      M     DR0, (R1), PZ
      MVBR  R0, (R1), Z
      MVWR  R0, (R1), Z
      M     DR0, (R1), Z
      MVBR  R0, (R1), NZ
      MVWR  R0, (R1), NZ
      M     DR0, (R1), NZ
      MVBR  R0, (R1), MZ
      MVWR  R0, (R1), MZ
      M     DR0, (R1), MZ
      MVBR  R0, (R1), P
      MVWR  R0, (R1), P
      M     DR0, (R1), P
      MVBR  R0, (R1), EZ
      MVWR  R0, (R1), EZ
      M     DR0, (R1), EZ
      MVBR  R0, (R1), ENZ
      MVWR  R0, (R1), ENZ
      M     DR0, (R1), ENZ
      MVBR  R0, (R1), OZ
      MVWR  R0, (R1), OZ
      M     DR0, (R1), OZ
      MVBR  R0, (R1), ONZ
      MVWR  R0, (R1), ONZ
      M     DR0, (R1), ONZ
      MVBR  R0, (R1), LMZ
      MVWR  R0, (R1), LMZ
      M     DR0, (R1), LMZ
      MVBR  R0, (R1), LP
      MVWR  R0, (R1), LP
      M     DR0, (R1), LP
      MVBR  R0, (R1), LPZ
      MVWR  R0, (R1), LPZ
      M     DR0, (R1), LPZ
      MVBR  R0, (R1), LM
      MVWR  R0, (R1), LM
      M     DR0, (R1), LM
      ST    R0, 00H
      ST    SP, 00H
      DMS   00H
      BAL   00H
      ST    R0, *
      ST    SP, *
      DMS   *
      BAL   *
      ST    R0, (00H)
      ST    SP, (00H)
      DMS   (00H)
      BAL   (00H)
      ST    R0, (*)
      ST    SP, (*)
      DMS   (*)
      BAL   (*)
      ST    R0, 0(X0)
      ST    SP, 0(X0)
      DMS   0(X0)
      BAL   0(X0)
      ST    R0, (00H)(X0)
      ST    SP, (00H)(X0)
      DMS   (00H)(X0)
      BAL   (00H)(X0)
      L     R0, 00H
      L     SP, 00H
      IMS   00H
      B     00H
      L     R0, *
      L     SP, *
      IMS   *
      B     *
      L     R0, (00H)
      L     SP, (00H)
      IMS   (00H)
      B     (00H)
      L     R0, (*)
      L     SP, (*)
      IMS   (*)
      B     (*)
      L     R0, 0(X0)
      L     SP, 0(X0)
      IMS   0(X0)
      B     0(X0)
      L     R0, (00H)(X0)
      L     SP, (00H)(X0)
      IMS   (00H)(X0)
      B     (00H)(X0)
