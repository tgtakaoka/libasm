;;; AUTO GENERATED FILE
;;; generated by: gen_mc68hc12 -i -u -C 68HCS12 -o gen_mc68hcs12.inc -l gen_mc68hcs12.lst
      BGND
      MEM
      INY
      DEY
      DBEQ  X, *+9
      DBEQ  Y, *+10
      DBEQ  SP, *+11
      DBEQ  A, *-236
      DBEQ  B, *-235
      DBEQ  D, *-232
      DBNE  A, *+36
      DBNE  B, *+37
      DBNE  D, *+40
      DBNE  X, *+41
      DBNE  Y, *+42
      DBNE  SP, *+43
      TBEQ  A, *+68
      TBEQ  B, *+69
      TBEQ  D, *+72
      TBEQ  X, *+73
      TBEQ  Y, *+74
      TBEQ  SP, *+75
      TBNE  A, *+100
      TBNE  B, *+101
      TBNE  D, *+104
      TBNE  X, *+105
      TBNE  Y, *+106
      TBNE  SP, *+107
      IBEQ  A, *+132
      IBEQ  B, *+133
      IBEQ  D, *+136
      IBEQ  X, *+137
      IBEQ  Y, *+138
      IBEQ  SP, *+139
      IBNE  A, *+164
      IBNE  B, *+165
      IBNE  D, *+168
      IBNE  X, *+169
      IBNE  Y, *+170
      IBNE  SP, *+171
      JMP   6,X
      JMP   1,+X
      JMP   8,-X
      JMP   1,X+
      JMP   8,X-
      JMP   0,Y
      JMP   1,+Y
      JMP   8,-Y
      JMP   1,Y+
      JMP   8,Y-
      JMP   0,SP
      JMP   1,+SP
      JMP   8,-SP
      JMP   1,SP+
      JMP   8,SP-
      JMP   $0190,PC
      JMP   $E1,X
      JMP   $E3E4,X
      JMP   [$E4E5,X]
      JMP   A,X
      JMP   B,X
      JMP   D,X
      JMP   [D,X]
      JMP   $E9,Y
      JMP   $EBEC,Y
      JMP   [$ECED,Y]
      JMP   A,Y
      JMP   B,Y
      JMP   D,Y
      JMP   [D,Y]
      JMP   $F1,SP
      JMP   $F3F4,SP
      JMP   [$F4F5,SP]
      JMP   A,SP
      JMP   B,SP
      JMP   D,SP
      JMP   [D,SP]
      JMP   $02C5,PC
      JMP   <$01CF,PC
      JMP   $FDCF,PC
      JMP   >$00D7,PC
      JMP   [$FED8,PC]
      JMP   A,PC
      JMP   B,PC
      JMP   D,PC
      JMP   [D,PC]
      JMP   $0708
      JMP   >$0001
      BSR   *+10
      INX
      DEX
      RTC
      RTI
      BSET  13,X, #14
      BSET  1,+X, #$21
      BSET  8,-X, #$29
      BSET  1,X+, #$31
      BSET  8,X-, #$39
      BSET  0,Y, #$41
      BSET  1,+Y, #$61
      BSET  8,-Y, #$69
      BSET  1,Y+, #$71
      BSET  8,Y-, #$79
      BSET  0,SP, #$81
      BSET  1,+SP, #$A1
      BSET  8,-SP, #$A9
      BSET  1,SP+, #$B1
      BSET  8,SP-, #$B9
      BSET  $021F,PC, #$C1
      BSET  $E1,X, #$E2
      BSET  $E3E4,X, #$E5
      BSET  A,X, #$E5
      BSET  B,X, #$E6
      BSET  D,X, #$E7
      BSET  $E9,Y, #$EA
      BSET  $EBEC,Y, #$ED
      BSET  A,Y, #$ED
      BSET  B,Y, #$EE
      BSET  D,Y, #$EF
      BSET  $F1,SP, #$F2
      BSET  $F3F4,SP, #$F5
      BSET  A,SP, #$F5
      BSET  B,SP, #$F6
      BSET  D,SP, #$F7
      BSET  $0352,PC, #$FA
      BSET  <$025D,PC, #1
      BSET  $FE5E,PC, #$FD
      BSET  >$0167,PC, #1
      BSET  A,PC, #$FD
      BSET  B,PC, #$FE
      BSET  D,PC, #$FF
      BCLR  14,X, #15
      BCLR  1,+X, #$21
      BCLR  8,-X, #$29
      BCLR  1,X+, #$31
      BCLR  8,X-, #$39
      BCLR  0,Y, #$41
      BCLR  1,+Y, #$61
      BCLR  8,-Y, #$69
      BCLR  1,Y+, #$71
      BCLR  8,Y-, #$79
      BCLR  0,SP, #$81
      BCLR  1,+SP, #$A1
      BCLR  8,-SP, #$A9
      BCLR  1,SP+, #$B1
      BCLR  8,SP-, #$B9
      BCLR  $02A0,PC, #$C1
      BCLR  $E1,X, #$E2
      BCLR  $E3E4,X, #$E5
      BCLR  A,X, #$E5
      BCLR  B,X, #$E6
      BCLR  D,X, #$E7
      BCLR  $E9,Y, #$EA
      BCLR  $EBEC,Y, #$ED
      BCLR  A,Y, #$ED
      BCLR  B,Y, #$EE
      BCLR  D,Y, #$EF
      BCLR  $F1,SP, #$F2
      BCLR  $F3F4,SP, #$F5
      BCLR  A,SP, #$F5
      BCLR  B,SP, #$F6
      BCLR  D,SP, #$F7
      BCLR  $03D3,PC, #$FA
      BCLR  <$02DE,PC, #1
      BCLR  $FEDF,PC, #$FD
      BCLR  >$01E8,PC, #1
      BCLR  A,PC, #$FD
      BCLR  B,PC, #$FE
      BCLR  D,PC, #$FF
      BRSET 15,X, #16, *+21
      BRSET 1,+X, #$21, *+38
      BRSET 8,-X, #$29, *+46
      BRSET 1,X+, #$31, *+54
      BRSET 8,X-, #$39, *+62
      BRSET 0,Y, #$41, *+70
      BRSET 1,+Y, #$61, *+102
      BRSET 8,-Y, #$69, *+110
      BRSET 1,Y+, #$71, *+118
      BRSET 8,Y-, #$79, *+126
      BRSET 0,SP, #$81, *-122
      BRSET 1,+SP, #$A1, *-90
      BRSET 8,-SP, #$A9, *-82
      BRSET 1,SP+, #$B1, *-74
      BRSET 8,SP-, #$B9, *-66
      BRSET $0331,PC, #$C1, *-58
      BRSET $E1,X, #$E2, *-24
      BRSET $E3E4,X, #$E5, *-20
      BRSET A,X, #$E5, *-22
      BRSET B,X, #$E6, *-21
      BRSET D,X, #$E7, *-20
      BRSET $E9,Y, #$EA, *-16
      BRSET $EBEC,Y, #$ED, *-12
      BRSET A,Y, #$ED, *-14
      BRSET B,Y, #$EE, *-13
      BRSET D,Y, #$EF, *-12
      BRSET $F1,SP, #$F2, *-8
      BRSET $F3F4,SP, #$F5, *-4
      BRSET A,SP, #$F5, *-6
      BRSET B,SP, #$F6, *-5
      BRSET D,SP, #$F7, *-4
      BRSET $0474,PC, #$FA, *
      BRSET <$0380,PC, #1, *+7
      BRSET $FF82,PC, #$FD, *+4
      BRSET >$028C,PC, #1, *+8
      BRSET A,PC, #$FD, *+2
      BRSET B,PC, #$FE, *+3
      BRSET D,PC, #$FF, *+4
      BRCLR -16,X, #17, *+22
      BRCLR 1,+X, #$21, *+38
      BRCLR 8,-X, #$29, *+46
      BRCLR 1,X+, #$31, *+54
      BRCLR 8,X-, #$39, *+62
      BRCLR 0,Y, #$41, *+70
      BRCLR 1,+Y, #$61, *+102
      BRCLR 8,-Y, #$69, *+110
      BRCLR 1,Y+, #$71, *+118
      BRCLR 8,Y-, #$79, *+126
      BRCLR 0,SP, #$81, *-122
      BRCLR 1,+SP, #$A1, *-90
      BRCLR 8,-SP, #$A9, *-82
      BRCLR 1,SP+, #$B1, *-74
      BRCLR 8,SP-, #$B9, *-66
      BRCLR $03D8,PC, #$C1, *-58
      BRCLR $E1,X, #$E2, *-24
      BRCLR $E3E4,X, #$E5, *-20
      BRCLR A,X, #$E5, *-22
      BRCLR B,X, #$E6, *-21
      BRCLR D,X, #$E7, *-20
      BRCLR $E9,Y, #$EA, *-16
      BRCLR $EBEC,Y, #$ED, *-12
      BRCLR A,Y, #$ED, *-14
      BRCLR B,Y, #$EE, *-13
      BRCLR D,Y, #$EF, *-12
      BRCLR $F1,SP, #$F2, *-8
      BRCLR $F3F4,SP, #$F5, *-4
      BRCLR A,SP, #$F5, *-6
      BRCLR B,SP, #$F6, *-5
      BRCLR D,SP, #$F7, *-4
      BRCLR $051B,PC, #$FA, *
      BRCLR <$0427,PC, #1, *+7
      BRCLR $0029,PC, #$FD, *+4
      BRCLR >$0333,PC, #1, *+8
      BRCLR A,PC, #$FD, *+2
      BRCLR B,PC, #$FE, *+3
      BRCLR D,PC, #$FF, *+4
      ANDCC #17
      EDIV
      MUL
      EMUL
      ORCC  #21
      JSR   -10,X
      JSR   1,+X
      JSR   8,-X
      JSR   1,X+
      JSR   8,X-
      JSR   0,Y
      JSR   1,+Y
      JSR   8,-Y
      JSR   1,Y+
      JSR   8,Y-
      JSR   0,SP
      JSR   1,+SP
      JSR   8,-SP
      JSR   1,SP+
      JSR   8,SP-
      JSR   $0466,PC
      JSR   $E1,X
      JSR   $E3E4,X
      JSR   [$E4E5,X]
      JSR   A,X
      JSR   B,X
      JSR   D,X
      JSR   [D,X]
      JSR   $E9,Y
      JSR   $EBEC,Y
      JSR   [$ECED,Y]
      JSR   A,Y
      JSR   B,Y
      JSR   D,Y
      JSR   [D,Y]
      JSR   $F1,SP
      JSR   $F3F4,SP
      JSR   [$F4F5,SP]
      JSR   A,SP
      JSR   B,SP
      JSR   D,SP
      JSR   [D,SP]
      JSR   $059B,PC
      JSR   <$04A5,PC
      JSR   $00A5,PC
      JSR   >$03AD,PC
      JSR   [$01AE,PC]
      JSR   A,PC
      JSR   B,PC
      JSR   D,PC
      JSR   [D,PC]
      JSR   $1718
      JSR   >$0001
      JSR   $18
      MINA  -6,X
      MINA  1,+X
      MINA  8,-X
      MINA  1,X+
      MINA  8,X-
      MINA  0,Y
      MINA  1,+Y
      MINA  8,-Y
      MINA  1,Y+
      MINA  8,Y-
      MINA  0,SP
      MINA  1,+SP
      MINA  8,-SP
      MINA  1,SP+
      MINA  8,SP-
      MINA  $04F1,PC
      MINA  $E1,X
      MINA  $E3E4,X
      MINA  [$E4E5,X]
      MINA  A,X
      MINA  B,X
      MINA  D,X
      MINA  [D,X]
      MINA  $E9,Y
      MINA  $EBEC,Y
      MINA  [$ECED,Y]
      MINA  A,Y
      MINA  B,Y
      MINA  D,Y
      MINA  [D,Y]
      MINA  $F1,SP
      MINA  $F3F4,SP
      MINA  [$F4F5,SP]
      MINA  A,SP
      MINA  B,SP
      MINA  D,SP
      MINA  [D,SP]
      MINA  $063C,PC
      MINA  <$0547,PC
      MINA  $0148,PC
      MINA  >$0451,PC
      MINA  [$0253,PC]
      MINA  A,PC
      MINA  B,PC
      MINA  D,PC
      MINA  [D,PC]
      EMAXD -5,X
      EMAXD 1,+X
      EMAXD 8,-X
      EMAXD 1,X+
      EMAXD 8,X-
      EMAXD 0,Y
      EMAXD 1,+Y
      EMAXD 8,-Y
      EMAXD 1,Y+
      EMAXD 8,Y-
      EMAXD 0,SP
      EMAXD 1,+SP
      EMAXD 8,-SP
      EMAXD 1,SP+
      EMAXD 8,SP-
      EMAXD $0592,PC
      EMAXD $E1,X
      EMAXD $E3E4,X
      EMAXD [$E4E5,X]
      EMAXD A,X
      EMAXD B,X
      EMAXD D,X
      EMAXD [D,X]
      EMAXD $E9,Y
      EMAXD $EBEC,Y
      EMAXD [$ECED,Y]
      EMAXD A,Y
      EMAXD B,Y
      EMAXD D,Y
      EMAXD [D,Y]
      EMAXD $F1,SP
      EMAXD $F3F4,SP
      EMAXD [$F4F5,SP]
      EMAXD A,SP
      EMAXD B,SP
      EMAXD D,SP
      EMAXD [D,SP]
      EMAXD $06DD,PC
      EMAXD <$05E8,PC
      EMAXD $01E9,PC
      EMAXD >$04F2,PC
      EMAXD [$02F4,PC]
      EMAXD A,PC
      EMAXD B,PC
      EMAXD D,PC
      EMAXD [D,PC]
      EMIND -4,X
      EMIND 1,+X
      EMIND 8,-X
      EMIND 1,X+
      EMIND 8,X-
      EMIND 0,Y
      EMIND 1,+Y
      EMIND 8,-Y
      EMIND 1,Y+
      EMIND 8,Y-
      EMIND 0,SP
      EMIND 1,+SP
      EMIND 8,-SP
      EMIND 1,SP+
      EMIND 8,SP-
      EMIND $0633,PC
      EMIND $E1,X
      EMIND $E3E4,X
      EMIND [$E4E5,X]
      EMIND A,X
      EMIND B,X
      EMIND D,X
      EMIND [D,X]
      EMIND $E9,Y
      EMIND $EBEC,Y
      EMIND [$ECED,Y]
      EMIND A,Y
      EMIND B,Y
      EMIND D,Y
      EMIND [D,Y]
      EMIND $F1,SP
      EMIND $F3F4,SP
      EMIND [$F4F5,SP]
      EMIND A,SP
      EMIND B,SP
      EMIND D,SP
      EMIND [D,SP]
      EMIND $077E,PC
      EMIND <$0689,PC
      EMIND $028A,PC
      EMIND >$0593,PC
      EMIND [$0395,PC]
      EMIND A,PC
      EMIND B,PC
      EMIND D,PC
      EMIND [D,PC]
      MAXM  -3,X
      MAXM  1,+X
      MAXM  8,-X
      MAXM  1,X+
      MAXM  8,X-
      MAXM  0,Y
      MAXM  1,+Y
      MAXM  8,-Y
      MAXM  1,Y+
      MAXM  8,Y-
      MAXM  0,SP
      MAXM  1,+SP
      MAXM  8,-SP
      MAXM  1,SP+
      MAXM  8,SP-
      MAXM  $06D4,PC
      MAXM  $E1,X
      MAXM  $E3E4,X
      MAXM  [$E4E5,X]
      MAXM  A,X
      MAXM  B,X
      MAXM  D,X
      MAXM  [D,X]
      MAXM  $E9,Y
      MAXM  $EBEC,Y
      MAXM  [$ECED,Y]
      MAXM  A,Y
      MAXM  B,Y
      MAXM  D,Y
      MAXM  [D,Y]
      MAXM  $F1,SP
      MAXM  $F3F4,SP
      MAXM  [$F4F5,SP]
      MAXM  A,SP
      MAXM  B,SP
      MAXM  D,SP
      MAXM  [D,SP]
      MAXM  $081F,PC
      MAXM  <$072A,PC
      MAXM  $032B,PC
      MAXM  >$0634,PC
      MAXM  [$0436,PC]
      MAXM  A,PC
      MAXM  B,PC
      MAXM  D,PC
      MAXM  [D,PC]
      MINM  -2,X
      MINM  1,+X
      MINM  8,-X
      MINM  1,X+
      MINM  8,X-
      MINM  0,Y
      MINM  1,+Y
      MINM  8,-Y
      MINM  1,Y+
      MINM  8,Y-
      MINM  0,SP
      MINM  1,+SP
      MINM  8,-SP
      MINM  1,SP+
      MINM  8,SP-
      MINM  $0775,PC
      MINM  $E1,X
      MINM  $E3E4,X
      MINM  [$E4E5,X]
      MINM  A,X
      MINM  B,X
      MINM  D,X
      MINM  [D,X]
      MINM  $E9,Y
      MINM  $EBEC,Y
      MINM  [$ECED,Y]
      MINM  A,Y
      MINM  B,Y
      MINM  D,Y
      MINM  [D,Y]
      MINM  $F1,SP
      MINM  $F3F4,SP
      MINM  [$F4F5,SP]
      MINM  A,SP
      MINM  B,SP
      MINM  D,SP
      MINM  [D,SP]
      MINM  $08C0,PC
      MINM  <$07CB,PC
      MINM  $03CC,PC
      MINM  >$06D5,PC
      MINM  [$04D7,PC]
      MINM  A,PC
      MINM  B,PC
      MINM  D,PC
      MINM  [D,PC]
      EMAXM -1,X
      EMAXM 1,+X
      EMAXM 8,-X
      EMAXM 1,X+
      EMAXM 8,X-
      EMAXM 0,Y
      EMAXM 1,+Y
      EMAXM 8,-Y
      EMAXM 1,Y+
      EMAXM 8,Y-
      EMAXM 0,SP
      EMAXM 1,+SP
      EMAXM 8,-SP
      EMAXM 1,SP+
      EMAXM 8,SP-
      EMAXM $0816,PC
      EMAXM $E1,X
      EMAXM $E3E4,X
      EMAXM [$E4E5,X]
      EMAXM A,X
      EMAXM B,X
      EMAXM D,X
      EMAXM [D,X]
      EMAXM $E9,Y
      EMAXM $EBEC,Y
      EMAXM [$ECED,Y]
      EMAXM A,Y
      EMAXM B,Y
      EMAXM D,Y
      EMAXM [D,Y]
      EMAXM $F1,SP
      EMAXM $F3F4,SP
      EMAXM [$F4F5,SP]
      EMAXM A,SP
      EMAXM B,SP
      EMAXM D,SP
      EMAXM [D,SP]
      EMAXM $0961,PC
      EMAXM <$086C,PC
      EMAXM $046D,PC
      EMAXM >$0776,PC
      EMAXM [$0578,PC]
      EMAXM A,PC
      EMAXM B,PC
      EMAXM D,PC
      EMAXM [D,PC]
      EMINM 1,+X
      EMINM 8,-X
      EMINM 1,X+
      EMINM 8,X-
      EMINM 0,Y
      EMINM 1,+Y
      EMINM 8,-Y
      EMINM 1,Y+
      EMINM 8,Y-
      EMINM 0,SP
      EMINM 1,+SP
      EMINM 8,-SP
      EMINM 1,SP+
      EMINM 8,SP-
      EMINM $08B4,PC
      EMINM $E1,X
      EMINM $E3E4,X
      EMINM [$E4E5,X]
      EMINM A,X
      EMINM B,X
      EMINM D,X
      EMINM [D,X]
      EMINM $E9,Y
      EMINM $EBEC,Y
      EMINM [$ECED,Y]
      EMINM A,Y
      EMINM B,Y
      EMINM D,Y
      EMINM [D,Y]
      EMINM $F1,SP
      EMINM $F3F4,SP
      EMINM [$F4F5,SP]
      EMINM A,SP
      EMINM B,SP
      EMINM D,SP
      EMINM [D,SP]
      EMINM $09FF,PC
      EMINM <$090A,PC
      EMINM $050B,PC
      EMINM >$0814,PC
      EMINM [$0616,PC]
      EMINM A,PC
      EMINM B,PC
      EMINM D,PC
      EMINM [D,PC]
      EMINM 0,X
      LBRA  *+$2126
      LBRN  *+$2227
      LBHI  *+$2328
      LBLS  *+$2429
      LBCC  *+$252A
      LBCS  *+$262B
      LBNE  *+$272C
      LBEQ  *+$282D
      LBVC  *+$292E
      LBVS  *+$2A2F
      LBPL  *+$2B30
      LBMI  *+$2C31
      LBGE  *+$2D32
      LBLT  *+$2E33
      LBGT  *+$2F34
      LBLE  *+$3035
      TRAP  $30
      REV
      REVW
      WAV
      TBL   2,X-
      TBL   0,Y
      TBL   1,+Y
      TBL   8,-Y
      TBL   1,Y+
      TBL   8,Y-
      TBL   0,SP
      TBL   1,+SP
      TBL   8,-SP
      TBL   1,SP+
      TBL   8,SP-
      TBL   $0994,PC
      TBL   A,X
      TBL   B,X
      TBL   D,X
      TBL   A,Y
      TBL   B,Y
      TBL   D,Y
      TBL   A,SP
      TBL   B,SP
      TBL   D,SP
      TBL   A,PC
      TBL   B,PC
      TBL   D,PC
      TBL   0,X
      TBL   1,+X
      TBL   8,-X
      TBL   1,X+
      STOP
      ETBL  0,Y
      ETBL  1,+Y
      ETBL  8,-Y
      ETBL  1,Y+
      ETBL  8,Y-
      ETBL  0,SP
      ETBL  1,+SP
      ETBL  8,-SP
      ETBL  1,SP+
      ETBL  8,SP-
      ETBL  $09E7,PC
      ETBL  A,X
      ETBL  B,X
      ETBL  D,X
      ETBL  A,Y
      ETBL  B,Y
      ETBL  D,Y
      ETBL  A,SP
      ETBL  B,SP
      ETBL  D,SP
      ETBL  A,PC
      ETBL  B,PC
      ETBL  D,PC
      ETBL  0,X
      ETBL  1,+X
      ETBL  8,-X
      ETBL  1,X+
      ETBL  8,X-
      MOVW  #$0203, 1,X
      MOVW  #$2122, 1,+X
      MOVW  #$292A, 8,-X
      MOVW  #$3132, 1,X+
      MOVW  #$393A, 8,X-
      MOVW  #$4142, 0,Y
      MOVW  #$6162, 1,+Y
      MOVW  #$696A, 8,-Y
      MOVW  #$7172, 1,Y+
      MOVW  #$797A, 8,Y-
      MOVW  #$8182, 0,SP
      MOVW  #$A1A2, 1,+SP
      MOVW  #$A9AA, 8,-SP
      MOVW  #$B1B2, 1,SP+
      MOVW  #$B9BA, 8,SP-
      MOVW  #$C1C2, $0A6A,PC
      MOVW  #$E5E6, A,X
      MOVW  #$E6E7, B,X
      MOVW  #$E7E8, D,X
      MOVW  #$EDEE, A,Y
      MOVW  #$EEEF, B,Y
      MOVW  #$EFF0, D,Y
      MOVW  #$F5F6, A,SP
      MOVW  #$F6F7, B,SP
      MOVW  #$F7F8, D,SP
      MOVW  #$FDFE, A,PC
      MOVW  #$FEFF, B,PC
      MOVW  #$FF00, D,PC
      MOVW  $0304, 2,X
      MOVW  >$0001, 2,X
      MOVW  $2122, 1,+X
      MOVW  >$0001, 1,+X
      MOVW  $292A, 8,-X
      MOVW  >$0001, 8,-X
      MOVW  $3132, 1,X+
      MOVW  >$0001, 1,X+
      MOVW  $393A, 8,X-
      MOVW  >$0001, 8,X-
      MOVW  $4142, 0,Y
      MOVW  >$0001, 0,Y
      MOVW  $6162, 1,+Y
      MOVW  >$0001, 1,+Y
      MOVW  $696A, 8,-Y
      MOVW  >$0001, 8,-Y
      MOVW  $7172, 1,Y+
      MOVW  >$0001, 1,Y+
      MOVW  $797A, 8,Y-
      MOVW  >$0001, 8,Y-
      MOVW  $8182, 0,SP
      MOVW  >$0001, 0,SP
      MOVW  $A1A2, 1,+SP
      MOVW  >$0001, 1,+SP
      MOVW  $A9AA, 8,-SP
      MOVW  >$0001, 8,-SP
      MOVW  $B1B2, 1,SP+
      MOVW  >$0001, 1,SP+
      MOVW  $B9BA, 8,SP-
      MOVW  >$0001, 8,SP-
      MOVW  $C1C2, $0B41,PC
      MOVW  >$0001, $0B46,PC
      MOVW  $E5E6, A,X
      MOVW  >$0001, A,X
      MOVW  $E6E7, B,X
      MOVW  >$0001, B,X
      MOVW  $E7E8, D,X
      MOVW  >$0001, D,X
      MOVW  $EDEE, A,Y
      MOVW  >$0001, A,Y
      MOVW  $EEEF, B,Y
      MOVW  >$0001, B,Y
      MOVW  $EFF0, D,Y
      MOVW  >$0001, D,Y
      MOVW  $F5F6, A,SP
      MOVW  >$0001, A,SP
      MOVW  $F6F7, B,SP
      MOVW  >$0001, B,SP
      MOVW  $F7F8, D,SP
      MOVW  >$0001, D,SP
      MOVW  $FDFE, A,PC
      MOVW  >$0001, A,PC
      MOVW  $FEFF, B,PC
      MOVW  >$0001, B,PC
      MOVW  $FF00, D,PC
      MOVW  >$0001, D,PC
      MOVW  3,X, 4,X
      MOVW  3,X, 1,+X
      MOVW  3,X, 8,-X
      MOVW  3,X, 1,X+
      MOVW  3,X, 8,X-
      MOVW  3,X, 0,Y
      MOVW  3,X, 1,+Y
      MOVW  3,X, 8,-Y
      MOVW  3,X, 1,Y+
      MOVW  3,X, 8,Y-
      MOVW  3,X, 0,SP
      MOVW  3,X, 1,+SP
      MOVW  3,X, 8,-SP
      MOVW  3,X, 1,SP+
      MOVW  3,X, 8,SP-
      MOVW  3,X, $0BFE,PC
      MOVW  3,X, A,X
      MOVW  3,X, B,X
      MOVW  3,X, D,X
      MOVW  3,X, A,Y
      MOVW  3,X, B,Y
      MOVW  3,X, D,Y
      MOVW  3,X, A,SP
      MOVW  3,X, B,SP
      MOVW  3,X, D,SP
      MOVW  3,X, A,PC
      MOVW  3,X, B,PC
      MOVW  3,X, D,PC
      MOVW  1,+X, 2,+X
      MOVW  1,+X, 8,-X
      MOVW  1,+X, 1,X+
      MOVW  1,+X, 8,X-
      MOVW  1,+X, 0,Y
      MOVW  1,+X, 1,+Y
      MOVW  1,+X, 8,-Y
      MOVW  1,+X, 1,Y+
      MOVW  1,+X, 8,Y-
      MOVW  1,+X, 0,SP
      MOVW  1,+X, 1,+SP
      MOVW  1,+X, 8,-SP
      MOVW  1,+X, 1,SP+
      MOVW  1,+X, 8,SP-
      MOVW  1,+X, $0C6A,PC
      MOVW  1,+X, A,X
      MOVW  1,+X, B,X
      MOVW  1,+X, D,X
      MOVW  1,+X, A,Y
      MOVW  1,+X, B,Y
      MOVW  1,+X, D,Y
      MOVW  1,+X, A,SP
      MOVW  1,+X, B,SP
      MOVW  1,+X, D,SP
      MOVW  1,+X, A,PC
      MOVW  1,+X, B,PC
      MOVW  1,+X, D,PC
      MOVW  1,+X, 0,X
      MOVW  8,-X, 7,-X
      MOVW  8,-X, 1,X+
      MOVW  8,-X, 8,X-
      MOVW  8,-X, 0,Y
      MOVW  8,-X, 1,+Y
      MOVW  8,-X, 8,-Y
      MOVW  8,-X, 1,Y+
      MOVW  8,-X, 8,Y-
      MOVW  8,-X, 0,SP
      MOVW  8,-X, 1,+SP
      MOVW  8,-X, 8,-SP
      MOVW  8,-X, 1,SP+
      MOVW  8,-X, 8,SP-
      MOVW  8,-X, $0CD6,PC
      MOVW  8,-X, A,X
      MOVW  8,-X, B,X
      MOVW  8,-X, D,X
      MOVW  8,-X, A,Y
      MOVW  8,-X, B,Y
      MOVW  8,-X, D,Y
      MOVW  8,-X, A,SP
      MOVW  8,-X, B,SP
      MOVW  8,-X, D,SP
      MOVW  8,-X, A,PC
      MOVW  8,-X, B,PC
      MOVW  8,-X, D,PC
      MOVW  8,-X, 0,X
      MOVW  8,-X, 1,+X
      MOVW  1,X+, 2,X+
      MOVW  1,X+, 8,X-
      MOVW  1,X+, 0,Y
      MOVW  1,X+, 1,+Y
      MOVW  1,X+, 8,-Y
      MOVW  1,X+, 1,Y+
      MOVW  1,X+, 8,Y-
      MOVW  1,X+, 0,SP
      MOVW  1,X+, 1,+SP
      MOVW  1,X+, 8,-SP
      MOVW  1,X+, 1,SP+
      MOVW  1,X+, 8,SP-
      MOVW  1,X+, $0D42,PC
      MOVW  1,X+, A,X
      MOVW  1,X+, B,X
      MOVW  1,X+, D,X
      MOVW  1,X+, A,Y
      MOVW  1,X+, B,Y
      MOVW  1,X+, D,Y
      MOVW  1,X+, A,SP
      MOVW  1,X+, B,SP
      MOVW  1,X+, D,SP
      MOVW  1,X+, A,PC
      MOVW  1,X+, B,PC
      MOVW  1,X+, D,PC
      MOVW  1,X+, 0,X
      MOVW  1,X+, 1,+X
      MOVW  1,X+, 8,-X
      MOVW  8,X-, 7,X-
      MOVW  8,X-, 0,Y
      MOVW  8,X-, 1,+Y
      MOVW  8,X-, 8,-Y
      MOVW  8,X-, 1,Y+
      MOVW  8,X-, 8,Y-
      MOVW  8,X-, 0,SP
      MOVW  8,X-, 1,+SP
      MOVW  8,X-, 8,-SP
      MOVW  8,X-, 1,SP+
      MOVW  8,X-, 8,SP-
      MOVW  8,X-, $0DAE,PC
      MOVW  8,X-, A,X
      MOVW  8,X-, B,X
      MOVW  8,X-, D,X
      MOVW  8,X-, A,Y
      MOVW  8,X-, B,Y
      MOVW  8,X-, D,Y
      MOVW  8,X-, A,SP
      MOVW  8,X-, B,SP
      MOVW  8,X-, D,SP
      MOVW  8,X-, A,PC
      MOVW  8,X-, B,PC
      MOVW  8,X-, D,PC
      MOVW  8,X-, 0,X
      MOVW  8,X-, 1,+X
      MOVW  8,X-, 8,-X
      MOVW  8,X-, 1,X+
      MOVW  0,Y, 1,Y
      MOVW  0,Y, 1,+Y
      MOVW  0,Y, 8,-Y
      MOVW  0,Y, 1,Y+
      MOVW  0,Y, 8,Y-
      MOVW  0,Y, 0,SP
      MOVW  0,Y, 1,+SP
      MOVW  0,Y, 8,-SP
      MOVW  0,Y, 1,SP+
      MOVW  0,Y, 8,SP-
      MOVW  0,Y, $0E1A,PC
      MOVW  0,Y, A,X
      MOVW  0,Y, B,X
      MOVW  0,Y, D,X
      MOVW  0,Y, A,Y
      MOVW  0,Y, B,Y
      MOVW  0,Y, D,Y
      MOVW  0,Y, A,SP
      MOVW  0,Y, B,SP
      MOVW  0,Y, D,SP
      MOVW  0,Y, A,PC
      MOVW  0,Y, B,PC
      MOVW  0,Y, D,PC
      MOVW  0,Y, 0,X
      MOVW  0,Y, 1,+X
      MOVW  0,Y, 8,-X
      MOVW  0,Y, 1,X+
      MOVW  0,Y, 8,X-
      MOVW  1,+Y, 2,+Y
      MOVW  1,+Y, 8,-Y
      MOVW  1,+Y, 1,Y+
      MOVW  1,+Y, 8,Y-
      MOVW  1,+Y, 0,SP
      MOVW  1,+Y, 1,+SP
      MOVW  1,+Y, 8,-SP
      MOVW  1,+Y, 1,SP+
      MOVW  1,+Y, 8,SP-
      MOVW  1,+Y, $0E86,PC
      MOVW  1,+Y, A,X
      MOVW  1,+Y, B,X
      MOVW  1,+Y, D,X
      MOVW  1,+Y, A,Y
      MOVW  1,+Y, B,Y
      MOVW  1,+Y, D,Y
      MOVW  1,+Y, A,SP
      MOVW  1,+Y, B,SP
      MOVW  1,+Y, D,SP
      MOVW  1,+Y, A,PC
      MOVW  1,+Y, B,PC
      MOVW  1,+Y, D,PC
      MOVW  1,+Y, 0,X
      MOVW  1,+Y, 1,+X
      MOVW  1,+Y, 8,-X
      MOVW  1,+Y, 1,X+
      MOVW  1,+Y, 8,X-
      MOVW  1,+Y, 0,Y
      MOVW  8,-Y, 7,-Y
      MOVW  8,-Y, 1,Y+
      MOVW  8,-Y, 8,Y-
      MOVW  8,-Y, 0,SP
      MOVW  8,-Y, 1,+SP
      MOVW  8,-Y, 8,-SP
      MOVW  8,-Y, 1,SP+
      MOVW  8,-Y, 8,SP-
      MOVW  8,-Y, $0EF2,PC
      MOVW  8,-Y, A,X
      MOVW  8,-Y, B,X
      MOVW  8,-Y, D,X
      MOVW  8,-Y, A,Y
      MOVW  8,-Y, B,Y
      MOVW  8,-Y, D,Y
      MOVW  8,-Y, A,SP
      MOVW  8,-Y, B,SP
      MOVW  8,-Y, D,SP
      MOVW  8,-Y, A,PC
      MOVW  8,-Y, B,PC
      MOVW  8,-Y, D,PC
      MOVW  8,-Y, 0,X
      MOVW  8,-Y, 1,+X
      MOVW  8,-Y, 8,-X
      MOVW  8,-Y, 1,X+
      MOVW  8,-Y, 8,X-
      MOVW  8,-Y, 0,Y
      MOVW  8,-Y, 1,+Y
      MOVW  1,Y+, 2,Y+
      MOVW  1,Y+, 8,Y-
      MOVW  1,Y+, 0,SP
      MOVW  1,Y+, 1,+SP
      MOVW  1,Y+, 8,-SP
      MOVW  1,Y+, 1,SP+
      MOVW  1,Y+, 8,SP-
      MOVW  1,Y+, $0F5E,PC
      MOVW  1,Y+, A,X
      MOVW  1,Y+, B,X
      MOVW  1,Y+, D,X
      MOVW  1,Y+, A,Y
      MOVW  1,Y+, B,Y
      MOVW  1,Y+, D,Y
      MOVW  1,Y+, A,SP
      MOVW  1,Y+, B,SP
      MOVW  1,Y+, D,SP
      MOVW  1,Y+, A,PC
      MOVW  1,Y+, B,PC
      MOVW  1,Y+, D,PC
      MOVW  1,Y+, 0,X
      MOVW  1,Y+, 1,+X
      MOVW  1,Y+, 8,-X
      MOVW  1,Y+, 1,X+
      MOVW  1,Y+, 8,X-
      MOVW  1,Y+, 0,Y
      MOVW  1,Y+, 1,+Y
      MOVW  1,Y+, 8,-Y
      MOVW  8,Y-, 7,Y-
      MOVW  8,Y-, 0,SP
      MOVW  8,Y-, 1,+SP
      MOVW  8,Y-, 8,-SP
      MOVW  8,Y-, 1,SP+
      MOVW  8,Y-, 8,SP-
      MOVW  8,Y-, $0FCA,PC
      MOVW  8,Y-, A,X
      MOVW  8,Y-, B,X
      MOVW  8,Y-, D,X
      MOVW  8,Y-, A,Y
      MOVW  8,Y-, B,Y
      MOVW  8,Y-, D,Y
      MOVW  8,Y-, A,SP
      MOVW  8,Y-, B,SP
      MOVW  8,Y-, D,SP
      MOVW  8,Y-, A,PC
      MOVW  8,Y-, B,PC
      MOVW  8,Y-, D,PC
      MOVW  8,Y-, 0,X
      MOVW  8,Y-, 1,+X
      MOVW  8,Y-, 8,-X
      MOVW  8,Y-, 1,X+
      MOVW  8,Y-, 8,X-
      MOVW  8,Y-, 0,Y
      MOVW  8,Y-, 1,+Y
      MOVW  8,Y-, 8,-Y
      MOVW  8,Y-, 1,Y+
      MOVW  0,SP, 1,SP
      MOVW  0,SP, 1,+SP
      MOVW  0,SP, 8,-SP
      MOVW  0,SP, 1,SP+
      MOVW  0,SP, 8,SP-
      MOVW  0,SP, $1036,PC
      MOVW  0,SP, A,X
      MOVW  0,SP, B,X
      MOVW  0,SP, D,X
      MOVW  0,SP, A,Y
      MOVW  0,SP, B,Y
      MOVW  0,SP, D,Y
      MOVW  0,SP, A,SP
      MOVW  0,SP, B,SP
      MOVW  0,SP, D,SP
      MOVW  0,SP, A,PC
      MOVW  0,SP, B,PC
      MOVW  0,SP, D,PC
      MOVW  0,SP, 0,X
      MOVW  0,SP, 1,+X
      MOVW  0,SP, 8,-X
      MOVW  0,SP, 1,X+
      MOVW  0,SP, 8,X-
      MOVW  0,SP, 0,Y
      MOVW  0,SP, 1,+Y
      MOVW  0,SP, 8,-Y
      MOVW  0,SP, 1,Y+
      MOVW  0,SP, 8,Y-
      MOVW  1,+SP, 2,+SP
      MOVW  1,+SP, 8,-SP
      MOVW  1,+SP, 1,SP+
      MOVW  1,+SP, 8,SP-
      MOVW  1,+SP, $10A2,PC
      MOVW  1,+SP, A,X
      MOVW  1,+SP, B,X
      MOVW  1,+SP, D,X
      MOVW  1,+SP, A,Y
      MOVW  1,+SP, B,Y
      MOVW  1,+SP, D,Y
      MOVW  1,+SP, A,SP
      MOVW  1,+SP, B,SP
      MOVW  1,+SP, D,SP
      MOVW  1,+SP, A,PC
      MOVW  1,+SP, B,PC
      MOVW  1,+SP, D,PC
      MOVW  1,+SP, 0,X
      MOVW  1,+SP, 1,+X
      MOVW  1,+SP, 8,-X
      MOVW  1,+SP, 1,X+
      MOVW  1,+SP, 8,X-
      MOVW  1,+SP, 0,Y
      MOVW  1,+SP, 1,+Y
      MOVW  1,+SP, 8,-Y
      MOVW  1,+SP, 1,Y+
      MOVW  1,+SP, 8,Y-
      MOVW  1,+SP, 0,SP
      MOVW  8,-SP, 7,-SP
      MOVW  8,-SP, 1,SP+
      MOVW  8,-SP, 8,SP-
      MOVW  8,-SP, $110E,PC
      MOVW  8,-SP, A,X
      MOVW  8,-SP, B,X
      MOVW  8,-SP, D,X
      MOVW  8,-SP, A,Y
      MOVW  8,-SP, B,Y
      MOVW  8,-SP, D,Y
      MOVW  8,-SP, A,SP
      MOVW  8,-SP, B,SP
      MOVW  8,-SP, D,SP
      MOVW  8,-SP, A,PC
      MOVW  8,-SP, B,PC
      MOVW  8,-SP, D,PC
      MOVW  8,-SP, 0,X
      MOVW  8,-SP, 1,+X
      MOVW  8,-SP, 8,-X
      MOVW  8,-SP, 1,X+
      MOVW  8,-SP, 8,X-
      MOVW  8,-SP, 0,Y
      MOVW  8,-SP, 1,+Y
      MOVW  8,-SP, 8,-Y
      MOVW  8,-SP, 1,Y+
      MOVW  8,-SP, 8,Y-
      MOVW  8,-SP, 0,SP
      MOVW  8,-SP, 1,+SP
      MOVW  1,SP+, 2,SP+
      MOVW  1,SP+, 8,SP-
      MOVW  1,SP+, $117A,PC
      MOVW  1,SP+, A,X
      MOVW  1,SP+, B,X
      MOVW  1,SP+, D,X
      MOVW  1,SP+, A,Y
      MOVW  1,SP+, B,Y
      MOVW  1,SP+, D,Y
      MOVW  1,SP+, A,SP
      MOVW  1,SP+, B,SP
      MOVW  1,SP+, D,SP
      MOVW  1,SP+, A,PC
      MOVW  1,SP+, B,PC
      MOVW  1,SP+, D,PC
      MOVW  1,SP+, 0,X
      MOVW  1,SP+, 1,+X
      MOVW  1,SP+, 8,-X
      MOVW  1,SP+, 1,X+
      MOVW  1,SP+, 8,X-
      MOVW  1,SP+, 0,Y
      MOVW  1,SP+, 1,+Y
      MOVW  1,SP+, 8,-Y
      MOVW  1,SP+, 1,Y+
      MOVW  1,SP+, 8,Y-
      MOVW  1,SP+, 0,SP
      MOVW  1,SP+, 1,+SP
      MOVW  1,SP+, 8,-SP
      MOVW  8,SP-, 7,SP-
      MOVW  8,SP-, $11E6,PC
      MOVW  8,SP-, A,X
      MOVW  8,SP-, B,X
      MOVW  8,SP-, D,X
      MOVW  8,SP-, A,Y
      MOVW  8,SP-, B,Y
      MOVW  8,SP-, D,Y
      MOVW  8,SP-, A,SP
      MOVW  8,SP-, B,SP
      MOVW  8,SP-, D,SP
      MOVW  8,SP-, A,PC
      MOVW  8,SP-, B,PC
      MOVW  8,SP-, D,PC
      MOVW  8,SP-, 0,X
      MOVW  8,SP-, 1,+X
      MOVW  8,SP-, 8,-X
      MOVW  8,SP-, 1,X+
      MOVW  8,SP-, 8,X-
      MOVW  8,SP-, 0,Y
      MOVW  8,SP-, 1,+Y
      MOVW  8,SP-, 8,-Y
      MOVW  8,SP-, 1,Y+
      MOVW  8,SP-, 8,Y-
      MOVW  8,SP-, 0,SP
      MOVW  8,SP-, 1,+SP
      MOVW  8,SP-, 8,-SP
      MOVW  8,SP-, 1,SP+
      MOVW  $1252,PC, $1253,PC
      MOVW  $1256,PC, A,X
      MOVW  $125A,PC, B,X
      MOVW  $125E,PC, D,X
      MOVW  $1262,PC, A,Y
      MOVW  $1266,PC, B,Y
      MOVW  $126A,PC, D,Y
      MOVW  $126E,PC, A,SP
      MOVW  $1272,PC, B,SP
      MOVW  $1276,PC, D,SP
      MOVW  $127A,PC, A,PC
      MOVW  $127E,PC, B,PC
      MOVW  $1282,PC, D,PC
      MOVW  $1286,PC, 0,X
      MOVW  $128A,PC, 1,+X
      MOVW  $128E,PC, 8,-X
      MOVW  $1292,PC, 1,X+
      MOVW  $1296,PC, 8,X-
      MOVW  $129A,PC, 0,Y
      MOVW  $129E,PC, 1,+Y
      MOVW  $12A2,PC, 8,-Y
      MOVW  $12A6,PC, 1,Y+
      MOVW  $12AA,PC, 8,Y-
      MOVW  $12AE,PC, 0,SP
      MOVW  $12B2,PC, 1,+SP
      MOVW  $12B6,PC, 8,-SP
      MOVW  $12BA,PC, 1,SP+
      MOVW  $12BE,PC, 8,SP-
      MOVW  A,X, B,X
      MOVW  A,X, D,X
      MOVW  A,X, A,Y
      MOVW  A,X, B,Y
      MOVW  A,X, D,Y
      MOVW  A,X, A,SP
      MOVW  A,X, B,SP
      MOVW  A,X, D,SP
      MOVW  A,X, A,PC
      MOVW  A,X, B,PC
      MOVW  A,X, D,PC
      MOVW  A,X, 0,X
      MOVW  A,X, 1,+X
      MOVW  A,X, 8,-X
      MOVW  A,X, 1,X+
      MOVW  A,X, 8,X-
      MOVW  A,X, 0,Y
      MOVW  A,X, 1,+Y
      MOVW  A,X, 8,-Y
      MOVW  A,X, 1,Y+
      MOVW  A,X, 8,Y-
      MOVW  A,X, 0,SP
      MOVW  A,X, 1,+SP
      MOVW  A,X, 8,-SP
      MOVW  A,X, 1,SP+
      MOVW  A,X, 8,SP-
      MOVW  A,X, $132A,PC
      MOVW  A,X, A,X
      MOVW  B,X, D,X
      MOVW  B,X, A,Y
      MOVW  B,X, B,Y
      MOVW  B,X, D,Y
      MOVW  B,X, A,SP
      MOVW  B,X, B,SP
      MOVW  B,X, D,SP
      MOVW  B,X, A,PC
      MOVW  B,X, B,PC
      MOVW  B,X, D,PC
      MOVW  B,X, 0,X
      MOVW  B,X, 1,+X
      MOVW  B,X, 8,-X
      MOVW  B,X, 1,X+
      MOVW  B,X, 8,X-
      MOVW  B,X, 0,Y
      MOVW  B,X, 1,+Y
      MOVW  B,X, 8,-Y
      MOVW  B,X, 1,Y+
      MOVW  B,X, 8,Y-
      MOVW  B,X, 0,SP
      MOVW  B,X, 1,+SP
      MOVW  B,X, 8,-SP
      MOVW  B,X, 1,SP+
      MOVW  B,X, 8,SP-
      MOVW  B,X, $1396,PC
      MOVW  B,X, A,X
      MOVW  B,X, B,X
      MOVW  D,X, A,Y
      MOVW  D,X, B,Y
      MOVW  D,X, D,Y
      MOVW  D,X, A,SP
      MOVW  D,X, B,SP
      MOVW  D,X, D,SP
      MOVW  D,X, A,PC
      MOVW  D,X, B,PC
      MOVW  D,X, D,PC
      MOVW  D,X, 0,X
      MOVW  D,X, 1,+X
      MOVW  D,X, 8,-X
      MOVW  D,X, 1,X+
      MOVW  D,X, 8,X-
      MOVW  D,X, 0,Y
      MOVW  D,X, 1,+Y
      MOVW  D,X, 8,-Y
      MOVW  D,X, 1,Y+
      MOVW  D,X, 8,Y-
      MOVW  D,X, 0,SP
      MOVW  D,X, 1,+SP
      MOVW  D,X, 8,-SP
      MOVW  D,X, 1,SP+
      MOVW  D,X, 8,SP-
      MOVW  D,X, $1402,PC
      MOVW  D,X, A,X
      MOVW  D,X, B,X
      MOVW  D,X, D,X
      MOVW  A,Y, B,Y
      MOVW  A,Y, D,Y
      MOVW  A,Y, A,SP
      MOVW  A,Y, B,SP
      MOVW  A,Y, D,SP
      MOVW  A,Y, A,PC
      MOVW  A,Y, B,PC
      MOVW  A,Y, D,PC
      MOVW  A,Y, 0,X
      MOVW  A,Y, 1,+X
      MOVW  A,Y, 8,-X
      MOVW  A,Y, 1,X+
      MOVW  A,Y, 8,X-
      MOVW  A,Y, 0,Y
      MOVW  A,Y, 1,+Y
      MOVW  A,Y, 8,-Y
      MOVW  A,Y, 1,Y+
      MOVW  A,Y, 8,Y-
      MOVW  A,Y, 0,SP
      MOVW  A,Y, 1,+SP
      MOVW  A,Y, 8,-SP
      MOVW  A,Y, 1,SP+
      MOVW  A,Y, 8,SP-
      MOVW  A,Y, $146E,PC
      MOVW  A,Y, A,X
      MOVW  A,Y, B,X
      MOVW  A,Y, D,X
      MOVW  A,Y, A,Y
      MOVW  B,Y, D,Y
      MOVW  B,Y, A,SP
      MOVW  B,Y, B,SP
      MOVW  B,Y, D,SP
      MOVW  B,Y, A,PC
      MOVW  B,Y, B,PC
      MOVW  B,Y, D,PC
      MOVW  B,Y, 0,X
      MOVW  B,Y, 1,+X
      MOVW  B,Y, 8,-X
      MOVW  B,Y, 1,X+
      MOVW  B,Y, 8,X-
      MOVW  B,Y, 0,Y
      MOVW  B,Y, 1,+Y
      MOVW  B,Y, 8,-Y
      MOVW  B,Y, 1,Y+
      MOVW  B,Y, 8,Y-
      MOVW  B,Y, 0,SP
      MOVW  B,Y, 1,+SP
      MOVW  B,Y, 8,-SP
      MOVW  B,Y, 1,SP+
      MOVW  B,Y, 8,SP-
      MOVW  B,Y, $14DA,PC
      MOVW  B,Y, A,X
      MOVW  B,Y, B,X
      MOVW  B,Y, D,X
      MOVW  B,Y, A,Y
      MOVW  B,Y, B,Y
      MOVW  D,Y, A,SP
      MOVW  D,Y, B,SP
      MOVW  D,Y, D,SP
      MOVW  D,Y, A,PC
      MOVW  D,Y, B,PC
      MOVW  D,Y, D,PC
      MOVW  D,Y, 0,X
      MOVW  D,Y, 1,+X
      MOVW  D,Y, 8,-X
      MOVW  D,Y, 1,X+
      MOVW  D,Y, 8,X-
      MOVW  D,Y, 0,Y
      MOVW  D,Y, 1,+Y
      MOVW  D,Y, 8,-Y
      MOVW  D,Y, 1,Y+
      MOVW  D,Y, 8,Y-
      MOVW  D,Y, 0,SP
      MOVW  D,Y, 1,+SP
      MOVW  D,Y, 8,-SP
      MOVW  D,Y, 1,SP+
      MOVW  D,Y, 8,SP-
      MOVW  D,Y, $1546,PC
      MOVW  D,Y, A,X
      MOVW  D,Y, B,X
      MOVW  D,Y, D,X
      MOVW  D,Y, A,Y
      MOVW  D,Y, B,Y
      MOVW  D,Y, D,Y
      MOVW  A,SP, B,SP
      MOVW  A,SP, D,SP
      MOVW  A,SP, A,PC
      MOVW  A,SP, B,PC
      MOVW  A,SP, D,PC
      MOVW  A,SP, 0,X
      MOVW  A,SP, 1,+X
      MOVW  A,SP, 8,-X
      MOVW  A,SP, 1,X+
      MOVW  A,SP, 8,X-
      MOVW  A,SP, 0,Y
      MOVW  A,SP, 1,+Y
      MOVW  A,SP, 8,-Y
      MOVW  A,SP, 1,Y+
      MOVW  A,SP, 8,Y-
      MOVW  A,SP, 0,SP
      MOVW  A,SP, 1,+SP
      MOVW  A,SP, 8,-SP
      MOVW  A,SP, 1,SP+
      MOVW  A,SP, 8,SP-
      MOVW  A,SP, $15B2,PC
      MOVW  A,SP, A,X
      MOVW  A,SP, B,X
      MOVW  A,SP, D,X
      MOVW  A,SP, A,Y
      MOVW  A,SP, B,Y
      MOVW  A,SP, D,Y
      MOVW  A,SP, A,SP
      MOVW  B,SP, D,SP
      MOVW  B,SP, A,PC
      MOVW  B,SP, B,PC
      MOVW  B,SP, D,PC
      MOVW  B,SP, 0,X
      MOVW  B,SP, 1,+X
      MOVW  B,SP, 8,-X
      MOVW  B,SP, 1,X+
      MOVW  B,SP, 8,X-
      MOVW  B,SP, 0,Y
      MOVW  B,SP, 1,+Y
      MOVW  B,SP, 8,-Y
      MOVW  B,SP, 1,Y+
      MOVW  B,SP, 8,Y-
      MOVW  B,SP, 0,SP
      MOVW  B,SP, 1,+SP
      MOVW  B,SP, 8,-SP
      MOVW  B,SP, 1,SP+
      MOVW  B,SP, 8,SP-
      MOVW  B,SP, $161E,PC
      MOVW  B,SP, A,X
      MOVW  B,SP, B,X
      MOVW  B,SP, D,X
      MOVW  B,SP, A,Y
      MOVW  B,SP, B,Y
      MOVW  B,SP, D,Y
      MOVW  B,SP, A,SP
      MOVW  B,SP, B,SP
      MOVW  D,SP, A,PC
      MOVW  D,SP, B,PC
      MOVW  D,SP, D,PC
      MOVW  D,SP, 0,X
      MOVW  D,SP, 1,+X
      MOVW  D,SP, 8,-X
      MOVW  D,SP, 1,X+
      MOVW  D,SP, 8,X-
      MOVW  D,SP, 0,Y
      MOVW  D,SP, 1,+Y
      MOVW  D,SP, 8,-Y
      MOVW  D,SP, 1,Y+
      MOVW  D,SP, 8,Y-
      MOVW  D,SP, 0,SP
      MOVW  D,SP, 1,+SP
      MOVW  D,SP, 8,-SP
      MOVW  D,SP, 1,SP+
      MOVW  D,SP, 8,SP-
      MOVW  D,SP, $168A,PC
      MOVW  D,SP, A,X
      MOVW  D,SP, B,X
      MOVW  D,SP, D,X
      MOVW  D,SP, A,Y
      MOVW  D,SP, B,Y
      MOVW  D,SP, D,Y
      MOVW  D,SP, A,SP
      MOVW  D,SP, B,SP
      MOVW  D,SP, D,SP
      MOVW  A,PC, B,PC
      MOVW  A,PC, D,PC
      MOVW  A,PC, 0,X
      MOVW  A,PC, 1,+X
      MOVW  A,PC, 8,-X
      MOVW  A,PC, 1,X+
      MOVW  A,PC, 8,X-
      MOVW  A,PC, 0,Y
      MOVW  A,PC, 1,+Y
      MOVW  A,PC, 8,-Y
      MOVW  A,PC, 1,Y+
      MOVW  A,PC, 8,Y-
      MOVW  A,PC, 0,SP
      MOVW  A,PC, 1,+SP
      MOVW  A,PC, 8,-SP
      MOVW  A,PC, 1,SP+
      MOVW  A,PC, 8,SP-
      MOVW  A,PC, $16F6,PC
      MOVW  A,PC, A,X
      MOVW  A,PC, B,X
      MOVW  A,PC, D,X
      MOVW  A,PC, A,Y
      MOVW  A,PC, B,Y
      MOVW  A,PC, D,Y
      MOVW  A,PC, A,SP
      MOVW  A,PC, B,SP
      MOVW  A,PC, D,SP
      MOVW  A,PC, A,PC
      MOVW  B,PC, D,PC
      MOVW  B,PC, 0,X
      MOVW  B,PC, 1,+X
      MOVW  B,PC, 8,-X
      MOVW  B,PC, 1,X+
      MOVW  B,PC, 8,X-
      MOVW  B,PC, 0,Y
      MOVW  B,PC, 1,+Y
      MOVW  B,PC, 8,-Y
      MOVW  B,PC, 1,Y+
      MOVW  B,PC, 8,Y-
      MOVW  B,PC, 0,SP
      MOVW  B,PC, 1,+SP
      MOVW  B,PC, 8,-SP
      MOVW  B,PC, 1,SP+
      MOVW  B,PC, 8,SP-
      MOVW  B,PC, $1762,PC
      MOVW  B,PC, A,X
      MOVW  B,PC, B,X
      MOVW  B,PC, D,X
      MOVW  B,PC, A,Y
      MOVW  B,PC, B,Y
      MOVW  B,PC, D,Y
      MOVW  B,PC, A,SP
      MOVW  B,PC, B,SP
      MOVW  B,PC, D,SP
      MOVW  B,PC, A,PC
      MOVW  B,PC, B,PC
      MOVW  D,PC, 0,X
      MOVW  D,PC, 1,+X
      MOVW  D,PC, 8,-X
      MOVW  D,PC, 1,X+
      MOVW  D,PC, 8,X-
      MOVW  D,PC, 0,Y
      MOVW  D,PC, 1,+Y
      MOVW  D,PC, 8,-Y
      MOVW  D,PC, 1,Y+
      MOVW  D,PC, 8,Y-
      MOVW  D,PC, 0,SP
      MOVW  D,PC, 1,+SP
      MOVW  D,PC, 8,-SP
      MOVW  D,PC, 1,SP+
      MOVW  D,PC, 8,SP-
      MOVW  D,PC, $17CE,PC
      MOVW  D,PC, A,X
      MOVW  D,PC, B,X
      MOVW  D,PC, D,X
      MOVW  D,PC, A,Y
      MOVW  D,PC, B,Y
      MOVW  D,PC, D,Y
      MOVW  D,PC, A,SP
      MOVW  D,PC, B,SP
      MOVW  D,PC, D,SP
      MOVW  D,PC, A,PC
      MOVW  D,PC, B,PC
      MOVW  D,PC, D,PC
      MOVW  #$0405, $0607
      MOVW  #$0405, >$0001
      MOVW  $0506, $0708
      MOVW  $0506, >$0001
      MOVW  >$0001, $0203
      MOVW  >$0001, >$0001
      MOVW  6,X, $0708
      MOVW  6,X, >$0001
      MOVW  1,+X, $2122
      MOVW  1,+X, >$0001
      MOVW  8,-X, $292A
      MOVW  8,-X, >$0001
      MOVW  1,X+, $3132
      MOVW  1,X+, >$0001
      MOVW  8,X-, $393A
      MOVW  8,X-, >$0001
      MOVW  0,Y, $4142
      MOVW  0,Y, >$0001
      MOVW  1,+Y, $6162
      MOVW  1,+Y, >$0001
      MOVW  8,-Y, $696A
      MOVW  8,-Y, >$0001
      MOVW  1,Y+, $7172
      MOVW  1,Y+, >$0001
      MOVW  8,Y-, $797A
      MOVW  8,Y-, >$0001
      MOVW  0,SP, $8182
      MOVW  0,SP, >$0001
      MOVW  1,+SP, $A1A2
      MOVW  1,+SP, >$0001
      MOVW  8,-SP, $A9AA
      MOVW  8,-SP, >$0001
      MOVW  1,SP+, $B1B2
      MOVW  1,SP+, >$0001
      MOVW  8,SP-, $B9BA
      MOVW  8,SP-, >$0001
      MOVW  $18BD,PC, $C1C2
      MOVW  $18C2,PC, >$0001
      MOVW  A,X, $E5E6
      MOVW  A,X, >$0001
      MOVW  B,X, $E6E7
      MOVW  B,X, >$0001
      MOVW  D,X, $E7E8
      MOVW  D,X, >$0001
      MOVW  A,Y, $EDEE
      MOVW  A,Y, >$0001
      MOVW  B,Y, $EEEF
      MOVW  B,Y, >$0001
      MOVW  D,Y, $EFF0
      MOVW  D,Y, >$0001
      MOVW  A,SP, $F5F6
      MOVW  A,SP, >$0001
      MOVW  B,SP, $F6F7
      MOVW  B,SP, >$0001
      MOVW  D,SP, $F7F8
      MOVW  D,SP, >$0001
      MOVW  A,PC, $FDFE
      MOVW  A,PC, >$0001
      MOVW  B,PC, $FEFF
      MOVW  B,PC, >$0001
      MOVW  D,PC, $FF00
      MOVW  D,PC, >$0001
      ABA
      DAA
      MOVB  #10, 9,X
      MOVB  #$21, 1,+X
      MOVB  #$29, 8,-X
      MOVB  #$31, 1,X+
      MOVB  #$39, 8,X-
      MOVB  #$41, 0,Y
      MOVB  #$61, 1,+Y
      MOVB  #$69, 8,-Y
      MOVB  #$71, 1,Y+
      MOVB  #$79, 8,Y-
      MOVB  #$81, 0,SP
      MOVB  #$A1, 1,+SP
      MOVB  #$A9, 8,-SP
      MOVB  #$B1, 1,SP+
      MOVB  #$B9, 8,SP-
      MOVB  #$C1, $197E,PC
      MOVB  #$E5, A,X
      MOVB  #$E6, B,X
      MOVB  #$E7, D,X
      MOVB  #$ED, A,Y
      MOVB  #$EE, B,Y
      MOVB  #$EF, D,Y
      MOVB  #$F5, A,SP
      MOVB  #$F6, B,SP
      MOVB  #$F7, D,SP
      MOVB  #$FD, A,PC
      MOVB  #$FE, B,PC
      MOVB  #$FF, D,PC
      MOVB  $0B0C, 10,X
      MOVB  >$0001, 10,X
      MOVB  $2122, 1,+X
      MOVB  >$0001, 1,+X
      MOVB  $292A, 8,-X
      MOVB  >$0001, 8,-X
      MOVB  $3132, 1,X+
      MOVB  >$0001, 1,X+
      MOVB  $393A, 8,X-
      MOVB  >$0001, 8,X-
      MOVB  $4142, 0,Y
      MOVB  >$0001, 0,Y
      MOVB  $6162, 1,+Y
      MOVB  >$0001, 1,+Y
      MOVB  $696A, 8,-Y
      MOVB  >$0001, 8,-Y
      MOVB  $7172, 1,Y+
      MOVB  >$0001, 1,Y+
      MOVB  $797A, 8,Y-
      MOVB  >$0001, 8,Y-
      MOVB  $8182, 0,SP
      MOVB  >$0001, 0,SP
      MOVB  $A1A2, 1,+SP
      MOVB  >$0001, 1,+SP
      MOVB  $A9AA, 8,-SP
      MOVB  >$0001, 8,-SP
      MOVB  $B1B2, 1,SP+
      MOVB  >$0001, 1,SP+
      MOVB  $B9BA, 8,SP-
      MOVB  >$0001, 8,SP-
      MOVB  $C1C2, $1A49,PC
      MOVB  >$0001, $1A4E,PC
      MOVB  $E5E6, A,X
      MOVB  >$0001, A,X
      MOVB  $E6E7, B,X
      MOVB  >$0001, B,X
      MOVB  $E7E8, D,X
      MOVB  >$0001, D,X
      MOVB  $EDEE, A,Y
      MOVB  >$0001, A,Y
      MOVB  $EEEF, B,Y
      MOVB  >$0001, B,Y
      MOVB  $EFF0, D,Y
      MOVB  >$0001, D,Y
      MOVB  $F5F6, A,SP
      MOVB  >$0001, A,SP
      MOVB  $F6F7, B,SP
      MOVB  >$0001, B,SP
      MOVB  $F7F8, D,SP
      MOVB  >$0001, D,SP
      MOVB  $FDFE, A,PC
      MOVB  >$0001, A,PC
      MOVB  $FEFF, B,PC
      MOVB  >$0001, B,PC
      MOVB  $FF00, D,PC
      MOVB  >$0001, D,PC
      MOVB  11,X, 12,X
      MOVB  11,X, 1,+X
      MOVB  11,X, 8,-X
      MOVB  11,X, 1,X+
      MOVB  11,X, 8,X-
      MOVB  11,X, 0,Y
      MOVB  11,X, 1,+Y
      MOVB  11,X, 8,-Y
      MOVB  11,X, 1,Y+
      MOVB  11,X, 8,Y-
      MOVB  11,X, 0,SP
      MOVB  11,X, 1,+SP
      MOVB  11,X, 8,-SP
      MOVB  11,X, 1,SP+
      MOVB  11,X, 8,SP-
      MOVB  11,X, $1B06,PC
      MOVB  11,X, A,X
      MOVB  11,X, B,X
      MOVB  11,X, D,X
      MOVB  11,X, A,Y
      MOVB  11,X, B,Y
      MOVB  11,X, D,Y
      MOVB  11,X, A,SP
      MOVB  11,X, B,SP
      MOVB  11,X, D,SP
      MOVB  11,X, A,PC
      MOVB  11,X, B,PC
      MOVB  11,X, D,PC
      MOVB  1,+X, 2,+X
      MOVB  1,+X, 8,-X
      MOVB  1,+X, 1,X+
      MOVB  1,+X, 8,X-
      MOVB  1,+X, 0,Y
      MOVB  1,+X, 1,+Y
      MOVB  1,+X, 8,-Y
      MOVB  1,+X, 1,Y+
      MOVB  1,+X, 8,Y-
      MOVB  1,+X, 0,SP
      MOVB  1,+X, 1,+SP
      MOVB  1,+X, 8,-SP
      MOVB  1,+X, 1,SP+
      MOVB  1,+X, 8,SP-
      MOVB  1,+X, $1B72,PC
      MOVB  1,+X, A,X
      MOVB  1,+X, B,X
      MOVB  1,+X, D,X
      MOVB  1,+X, A,Y
      MOVB  1,+X, B,Y
      MOVB  1,+X, D,Y
      MOVB  1,+X, A,SP
      MOVB  1,+X, B,SP
      MOVB  1,+X, D,SP
      MOVB  1,+X, A,PC
      MOVB  1,+X, B,PC
      MOVB  1,+X, D,PC
      MOVB  1,+X, 0,X
      MOVB  8,-X, 7,-X
      MOVB  8,-X, 1,X+
      MOVB  8,-X, 8,X-
      MOVB  8,-X, 0,Y
      MOVB  8,-X, 1,+Y
      MOVB  8,-X, 8,-Y
      MOVB  8,-X, 1,Y+
      MOVB  8,-X, 8,Y-
      MOVB  8,-X, 0,SP
      MOVB  8,-X, 1,+SP
      MOVB  8,-X, 8,-SP
      MOVB  8,-X, 1,SP+
      MOVB  8,-X, 8,SP-
      MOVB  8,-X, $1BDE,PC
      MOVB  8,-X, A,X
      MOVB  8,-X, B,X
      MOVB  8,-X, D,X
      MOVB  8,-X, A,Y
      MOVB  8,-X, B,Y
      MOVB  8,-X, D,Y
      MOVB  8,-X, A,SP
      MOVB  8,-X, B,SP
      MOVB  8,-X, D,SP
      MOVB  8,-X, A,PC
      MOVB  8,-X, B,PC
      MOVB  8,-X, D,PC
      MOVB  8,-X, 0,X
      MOVB  8,-X, 1,+X
      MOVB  1,X+, 2,X+
      MOVB  1,X+, 8,X-
      MOVB  1,X+, 0,Y
      MOVB  1,X+, 1,+Y
      MOVB  1,X+, 8,-Y
      MOVB  1,X+, 1,Y+
      MOVB  1,X+, 8,Y-
      MOVB  1,X+, 0,SP
      MOVB  1,X+, 1,+SP
      MOVB  1,X+, 8,-SP
      MOVB  1,X+, 1,SP+
      MOVB  1,X+, 8,SP-
      MOVB  1,X+, $1C4A,PC
      MOVB  1,X+, A,X
      MOVB  1,X+, B,X
      MOVB  1,X+, D,X
      MOVB  1,X+, A,Y
      MOVB  1,X+, B,Y
      MOVB  1,X+, D,Y
      MOVB  1,X+, A,SP
      MOVB  1,X+, B,SP
      MOVB  1,X+, D,SP
      MOVB  1,X+, A,PC
      MOVB  1,X+, B,PC
      MOVB  1,X+, D,PC
      MOVB  1,X+, 0,X
      MOVB  1,X+, 1,+X
      MOVB  1,X+, 8,-X
      MOVB  8,X-, 7,X-
      MOVB  8,X-, 0,Y
      MOVB  8,X-, 1,+Y
      MOVB  8,X-, 8,-Y
      MOVB  8,X-, 1,Y+
      MOVB  8,X-, 8,Y-
      MOVB  8,X-, 0,SP
      MOVB  8,X-, 1,+SP
      MOVB  8,X-, 8,-SP
      MOVB  8,X-, 1,SP+
      MOVB  8,X-, 8,SP-
      MOVB  8,X-, $1CB6,PC
      MOVB  8,X-, A,X
      MOVB  8,X-, B,X
      MOVB  8,X-, D,X
      MOVB  8,X-, A,Y
      MOVB  8,X-, B,Y
      MOVB  8,X-, D,Y
      MOVB  8,X-, A,SP
      MOVB  8,X-, B,SP
      MOVB  8,X-, D,SP
      MOVB  8,X-, A,PC
      MOVB  8,X-, B,PC
      MOVB  8,X-, D,PC
      MOVB  8,X-, 0,X
      MOVB  8,X-, 1,+X
      MOVB  8,X-, 8,-X
      MOVB  8,X-, 1,X+
      MOVB  0,Y, 1,Y
      MOVB  0,Y, 1,+Y
      MOVB  0,Y, 8,-Y
      MOVB  0,Y, 1,Y+
      MOVB  0,Y, 8,Y-
      MOVB  0,Y, 0,SP
      MOVB  0,Y, 1,+SP
      MOVB  0,Y, 8,-SP
      MOVB  0,Y, 1,SP+
      MOVB  0,Y, 8,SP-
      MOVB  0,Y, $1D22,PC
      MOVB  0,Y, A,X
      MOVB  0,Y, B,X
      MOVB  0,Y, D,X
      MOVB  0,Y, A,Y
      MOVB  0,Y, B,Y
      MOVB  0,Y, D,Y
      MOVB  0,Y, A,SP
      MOVB  0,Y, B,SP
      MOVB  0,Y, D,SP
      MOVB  0,Y, A,PC
      MOVB  0,Y, B,PC
      MOVB  0,Y, D,PC
      MOVB  0,Y, 0,X
      MOVB  0,Y, 1,+X
      MOVB  0,Y, 8,-X
      MOVB  0,Y, 1,X+
      MOVB  0,Y, 8,X-
      MOVB  1,+Y, 2,+Y
      MOVB  1,+Y, 8,-Y
      MOVB  1,+Y, 1,Y+
      MOVB  1,+Y, 8,Y-
      MOVB  1,+Y, 0,SP
      MOVB  1,+Y, 1,+SP
      MOVB  1,+Y, 8,-SP
      MOVB  1,+Y, 1,SP+
      MOVB  1,+Y, 8,SP-
      MOVB  1,+Y, $1D8E,PC
      MOVB  1,+Y, A,X
      MOVB  1,+Y, B,X
      MOVB  1,+Y, D,X
      MOVB  1,+Y, A,Y
      MOVB  1,+Y, B,Y
      MOVB  1,+Y, D,Y
      MOVB  1,+Y, A,SP
      MOVB  1,+Y, B,SP
      MOVB  1,+Y, D,SP
      MOVB  1,+Y, A,PC
      MOVB  1,+Y, B,PC
      MOVB  1,+Y, D,PC
      MOVB  1,+Y, 0,X
      MOVB  1,+Y, 1,+X
      MOVB  1,+Y, 8,-X
      MOVB  1,+Y, 1,X+
      MOVB  1,+Y, 8,X-
      MOVB  1,+Y, 0,Y
      MOVB  8,-Y, 7,-Y
      MOVB  8,-Y, 1,Y+
      MOVB  8,-Y, 8,Y-
      MOVB  8,-Y, 0,SP
      MOVB  8,-Y, 1,+SP
      MOVB  8,-Y, 8,-SP
      MOVB  8,-Y, 1,SP+
      MOVB  8,-Y, 8,SP-
      MOVB  8,-Y, $1DFA,PC
      MOVB  8,-Y, A,X
      MOVB  8,-Y, B,X
      MOVB  8,-Y, D,X
      MOVB  8,-Y, A,Y
      MOVB  8,-Y, B,Y
      MOVB  8,-Y, D,Y
      MOVB  8,-Y, A,SP
      MOVB  8,-Y, B,SP
      MOVB  8,-Y, D,SP
      MOVB  8,-Y, A,PC
      MOVB  8,-Y, B,PC
      MOVB  8,-Y, D,PC
      MOVB  8,-Y, 0,X
      MOVB  8,-Y, 1,+X
      MOVB  8,-Y, 8,-X
      MOVB  8,-Y, 1,X+
      MOVB  8,-Y, 8,X-
      MOVB  8,-Y, 0,Y
      MOVB  8,-Y, 1,+Y
      MOVB  1,Y+, 2,Y+
      MOVB  1,Y+, 8,Y-
      MOVB  1,Y+, 0,SP
      MOVB  1,Y+, 1,+SP
      MOVB  1,Y+, 8,-SP
      MOVB  1,Y+, 1,SP+
      MOVB  1,Y+, 8,SP-
      MOVB  1,Y+, $1E66,PC
      MOVB  1,Y+, A,X
      MOVB  1,Y+, B,X
      MOVB  1,Y+, D,X
      MOVB  1,Y+, A,Y
      MOVB  1,Y+, B,Y
      MOVB  1,Y+, D,Y
      MOVB  1,Y+, A,SP
      MOVB  1,Y+, B,SP
      MOVB  1,Y+, D,SP
      MOVB  1,Y+, A,PC
      MOVB  1,Y+, B,PC
      MOVB  1,Y+, D,PC
      MOVB  1,Y+, 0,X
      MOVB  1,Y+, 1,+X
      MOVB  1,Y+, 8,-X
      MOVB  1,Y+, 1,X+
      MOVB  1,Y+, 8,X-
      MOVB  1,Y+, 0,Y
      MOVB  1,Y+, 1,+Y
      MOVB  1,Y+, 8,-Y
      MOVB  8,Y-, 7,Y-
      MOVB  8,Y-, 0,SP
      MOVB  8,Y-, 1,+SP
      MOVB  8,Y-, 8,-SP
      MOVB  8,Y-, 1,SP+
      MOVB  8,Y-, 8,SP-
      MOVB  8,Y-, $1ED2,PC
      MOVB  8,Y-, A,X
      MOVB  8,Y-, B,X
      MOVB  8,Y-, D,X
      MOVB  8,Y-, A,Y
      MOVB  8,Y-, B,Y
      MOVB  8,Y-, D,Y
      MOVB  8,Y-, A,SP
      MOVB  8,Y-, B,SP
      MOVB  8,Y-, D,SP
      MOVB  8,Y-, A,PC
      MOVB  8,Y-, B,PC
      MOVB  8,Y-, D,PC
      MOVB  8,Y-, 0,X
      MOVB  8,Y-, 1,+X
      MOVB  8,Y-, 8,-X
      MOVB  8,Y-, 1,X+
      MOVB  8,Y-, 8,X-
      MOVB  8,Y-, 0,Y
      MOVB  8,Y-, 1,+Y
      MOVB  8,Y-, 8,-Y
      MOVB  8,Y-, 1,Y+
      MOVB  0,SP, 1,SP
      MOVB  0,SP, 1,+SP
      MOVB  0,SP, 8,-SP
      MOVB  0,SP, 1,SP+
      MOVB  0,SP, 8,SP-
      MOVB  0,SP, $1F3E,PC
      MOVB  0,SP, A,X
      MOVB  0,SP, B,X
      MOVB  0,SP, D,X
      MOVB  0,SP, A,Y
      MOVB  0,SP, B,Y
      MOVB  0,SP, D,Y
      MOVB  0,SP, A,SP
      MOVB  0,SP, B,SP
      MOVB  0,SP, D,SP
      MOVB  0,SP, A,PC
      MOVB  0,SP, B,PC
      MOVB  0,SP, D,PC
      MOVB  0,SP, 0,X
      MOVB  0,SP, 1,+X
      MOVB  0,SP, 8,-X
      MOVB  0,SP, 1,X+
      MOVB  0,SP, 8,X-
      MOVB  0,SP, 0,Y
      MOVB  0,SP, 1,+Y
      MOVB  0,SP, 8,-Y
      MOVB  0,SP, 1,Y+
      MOVB  0,SP, 8,Y-
      MOVB  1,+SP, 2,+SP
      MOVB  1,+SP, 8,-SP
      MOVB  1,+SP, 1,SP+
      MOVB  1,+SP, 8,SP-
      MOVB  1,+SP, $1FAA,PC
      MOVB  1,+SP, A,X
      MOVB  1,+SP, B,X
      MOVB  1,+SP, D,X
      MOVB  1,+SP, A,Y
      MOVB  1,+SP, B,Y
      MOVB  1,+SP, D,Y
      MOVB  1,+SP, A,SP
      MOVB  1,+SP, B,SP
      MOVB  1,+SP, D,SP
      MOVB  1,+SP, A,PC
      MOVB  1,+SP, B,PC
      MOVB  1,+SP, D,PC
      MOVB  1,+SP, 0,X
      MOVB  1,+SP, 1,+X
      MOVB  1,+SP, 8,-X
      MOVB  1,+SP, 1,X+
      MOVB  1,+SP, 8,X-
      MOVB  1,+SP, 0,Y
      MOVB  1,+SP, 1,+Y
      MOVB  1,+SP, 8,-Y
      MOVB  1,+SP, 1,Y+
      MOVB  1,+SP, 8,Y-
      MOVB  1,+SP, 0,SP
      MOVB  8,-SP, 7,-SP
      MOVB  8,-SP, 1,SP+
      MOVB  8,-SP, 8,SP-
      MOVB  8,-SP, $2016,PC
      MOVB  8,-SP, A,X
      MOVB  8,-SP, B,X
      MOVB  8,-SP, D,X
      MOVB  8,-SP, A,Y
      MOVB  8,-SP, B,Y
      MOVB  8,-SP, D,Y
      MOVB  8,-SP, A,SP
      MOVB  8,-SP, B,SP
      MOVB  8,-SP, D,SP
      MOVB  8,-SP, A,PC
      MOVB  8,-SP, B,PC
      MOVB  8,-SP, D,PC
      MOVB  8,-SP, 0,X
      MOVB  8,-SP, 1,+X
      MOVB  8,-SP, 8,-X
      MOVB  8,-SP, 1,X+
      MOVB  8,-SP, 8,X-
      MOVB  8,-SP, 0,Y
      MOVB  8,-SP, 1,+Y
      MOVB  8,-SP, 8,-Y
      MOVB  8,-SP, 1,Y+
      MOVB  8,-SP, 8,Y-
      MOVB  8,-SP, 0,SP
      MOVB  8,-SP, 1,+SP
      MOVB  1,SP+, 2,SP+
      MOVB  1,SP+, 8,SP-
      MOVB  1,SP+, $2082,PC
      MOVB  1,SP+, A,X
      MOVB  1,SP+, B,X
      MOVB  1,SP+, D,X
      MOVB  1,SP+, A,Y
      MOVB  1,SP+, B,Y
      MOVB  1,SP+, D,Y
      MOVB  1,SP+, A,SP
      MOVB  1,SP+, B,SP
      MOVB  1,SP+, D,SP
      MOVB  1,SP+, A,PC
      MOVB  1,SP+, B,PC
      MOVB  1,SP+, D,PC
      MOVB  1,SP+, 0,X
      MOVB  1,SP+, 1,+X
      MOVB  1,SP+, 8,-X
      MOVB  1,SP+, 1,X+
      MOVB  1,SP+, 8,X-
      MOVB  1,SP+, 0,Y
      MOVB  1,SP+, 1,+Y
      MOVB  1,SP+, 8,-Y
      MOVB  1,SP+, 1,Y+
      MOVB  1,SP+, 8,Y-
      MOVB  1,SP+, 0,SP
      MOVB  1,SP+, 1,+SP
      MOVB  1,SP+, 8,-SP
      MOVB  8,SP-, 7,SP-
      MOVB  8,SP-, $20EE,PC
      MOVB  8,SP-, A,X
      MOVB  8,SP-, B,X
      MOVB  8,SP-, D,X
      MOVB  8,SP-, A,Y
      MOVB  8,SP-, B,Y
      MOVB  8,SP-, D,Y
      MOVB  8,SP-, A,SP
      MOVB  8,SP-, B,SP
      MOVB  8,SP-, D,SP
      MOVB  8,SP-, A,PC
      MOVB  8,SP-, B,PC
      MOVB  8,SP-, D,PC
      MOVB  8,SP-, 0,X
      MOVB  8,SP-, 1,+X
      MOVB  8,SP-, 8,-X
      MOVB  8,SP-, 1,X+
      MOVB  8,SP-, 8,X-
      MOVB  8,SP-, 0,Y
      MOVB  8,SP-, 1,+Y
      MOVB  8,SP-, 8,-Y
      MOVB  8,SP-, 1,Y+
      MOVB  8,SP-, 8,Y-
      MOVB  8,SP-, 0,SP
      MOVB  8,SP-, 1,+SP
      MOVB  8,SP-, 8,-SP
      MOVB  8,SP-, 1,SP+
      MOVB  $215A,PC, $215B,PC
      MOVB  $215E,PC, A,X
      MOVB  $2162,PC, B,X
      MOVB  $2166,PC, D,X
      MOVB  $216A,PC, A,Y
      MOVB  $216E,PC, B,Y
      MOVB  $2172,PC, D,Y
      MOVB  $2176,PC, A,SP
      MOVB  $217A,PC, B,SP
      MOVB  $217E,PC, D,SP
      MOVB  $2182,PC, A,PC
      MOVB  $2186,PC, B,PC
      MOVB  $218A,PC, D,PC
      MOVB  $218E,PC, 0,X
      MOVB  $2192,PC, 1,+X
      MOVB  $2196,PC, 8,-X
      MOVB  $219A,PC, 1,X+
      MOVB  $219E,PC, 8,X-
      MOVB  $21A2,PC, 0,Y
      MOVB  $21A6,PC, 1,+Y
      MOVB  $21AA,PC, 8,-Y
      MOVB  $21AE,PC, 1,Y+
      MOVB  $21B2,PC, 8,Y-
      MOVB  $21B6,PC, 0,SP
      MOVB  $21BA,PC, 1,+SP
      MOVB  $21BE,PC, 8,-SP
      MOVB  $21C2,PC, 1,SP+
      MOVB  $21C6,PC, 8,SP-
      MOVB  A,X, B,X
      MOVB  A,X, D,X
      MOVB  A,X, A,Y
      MOVB  A,X, B,Y
      MOVB  A,X, D,Y
      MOVB  A,X, A,SP
      MOVB  A,X, B,SP
      MOVB  A,X, D,SP
      MOVB  A,X, A,PC
      MOVB  A,X, B,PC
      MOVB  A,X, D,PC
      MOVB  A,X, 0,X
      MOVB  A,X, 1,+X
      MOVB  A,X, 8,-X
      MOVB  A,X, 1,X+
      MOVB  A,X, 8,X-
      MOVB  A,X, 0,Y
      MOVB  A,X, 1,+Y
      MOVB  A,X, 8,-Y
      MOVB  A,X, 1,Y+
      MOVB  A,X, 8,Y-
      MOVB  A,X, 0,SP
      MOVB  A,X, 1,+SP
      MOVB  A,X, 8,-SP
      MOVB  A,X, 1,SP+
      MOVB  A,X, 8,SP-
      MOVB  A,X, $2232,PC
      MOVB  A,X, A,X
      MOVB  B,X, D,X
      MOVB  B,X, A,Y
      MOVB  B,X, B,Y
      MOVB  B,X, D,Y
      MOVB  B,X, A,SP
      MOVB  B,X, B,SP
      MOVB  B,X, D,SP
      MOVB  B,X, A,PC
      MOVB  B,X, B,PC
      MOVB  B,X, D,PC
      MOVB  B,X, 0,X
      MOVB  B,X, 1,+X
      MOVB  B,X, 8,-X
      MOVB  B,X, 1,X+
      MOVB  B,X, 8,X-
      MOVB  B,X, 0,Y
      MOVB  B,X, 1,+Y
      MOVB  B,X, 8,-Y
      MOVB  B,X, 1,Y+
      MOVB  B,X, 8,Y-
      MOVB  B,X, 0,SP
      MOVB  B,X, 1,+SP
      MOVB  B,X, 8,-SP
      MOVB  B,X, 1,SP+
      MOVB  B,X, 8,SP-
      MOVB  B,X, $229E,PC
      MOVB  B,X, A,X
      MOVB  B,X, B,X
      MOVB  D,X, A,Y
      MOVB  D,X, B,Y
      MOVB  D,X, D,Y
      MOVB  D,X, A,SP
      MOVB  D,X, B,SP
      MOVB  D,X, D,SP
      MOVB  D,X, A,PC
      MOVB  D,X, B,PC
      MOVB  D,X, D,PC
      MOVB  D,X, 0,X
      MOVB  D,X, 1,+X
      MOVB  D,X, 8,-X
      MOVB  D,X, 1,X+
      MOVB  D,X, 8,X-
      MOVB  D,X, 0,Y
      MOVB  D,X, 1,+Y
      MOVB  D,X, 8,-Y
      MOVB  D,X, 1,Y+
      MOVB  D,X, 8,Y-
      MOVB  D,X, 0,SP
      MOVB  D,X, 1,+SP
      MOVB  D,X, 8,-SP
      MOVB  D,X, 1,SP+
      MOVB  D,X, 8,SP-
      MOVB  D,X, $230A,PC
      MOVB  D,X, A,X
      MOVB  D,X, B,X
      MOVB  D,X, D,X
      MOVB  A,Y, B,Y
      MOVB  A,Y, D,Y
      MOVB  A,Y, A,SP
      MOVB  A,Y, B,SP
      MOVB  A,Y, D,SP
      MOVB  A,Y, A,PC
      MOVB  A,Y, B,PC
      MOVB  A,Y, D,PC
      MOVB  A,Y, 0,X
      MOVB  A,Y, 1,+X
      MOVB  A,Y, 8,-X
      MOVB  A,Y, 1,X+
      MOVB  A,Y, 8,X-
      MOVB  A,Y, 0,Y
      MOVB  A,Y, 1,+Y
      MOVB  A,Y, 8,-Y
      MOVB  A,Y, 1,Y+
      MOVB  A,Y, 8,Y-
      MOVB  A,Y, 0,SP
      MOVB  A,Y, 1,+SP
      MOVB  A,Y, 8,-SP
      MOVB  A,Y, 1,SP+
      MOVB  A,Y, 8,SP-
      MOVB  A,Y, $2376,PC
      MOVB  A,Y, A,X
      MOVB  A,Y, B,X
      MOVB  A,Y, D,X
      MOVB  A,Y, A,Y
      MOVB  B,Y, D,Y
      MOVB  B,Y, A,SP
      MOVB  B,Y, B,SP
      MOVB  B,Y, D,SP
      MOVB  B,Y, A,PC
      MOVB  B,Y, B,PC
      MOVB  B,Y, D,PC
      MOVB  B,Y, 0,X
      MOVB  B,Y, 1,+X
      MOVB  B,Y, 8,-X
      MOVB  B,Y, 1,X+
      MOVB  B,Y, 8,X-
      MOVB  B,Y, 0,Y
      MOVB  B,Y, 1,+Y
      MOVB  B,Y, 8,-Y
      MOVB  B,Y, 1,Y+
      MOVB  B,Y, 8,Y-
      MOVB  B,Y, 0,SP
      MOVB  B,Y, 1,+SP
      MOVB  B,Y, 8,-SP
      MOVB  B,Y, 1,SP+
      MOVB  B,Y, 8,SP-
      MOVB  B,Y, $23E2,PC
      MOVB  B,Y, A,X
      MOVB  B,Y, B,X
      MOVB  B,Y, D,X
      MOVB  B,Y, A,Y
      MOVB  B,Y, B,Y
      MOVB  D,Y, A,SP
      MOVB  D,Y, B,SP
      MOVB  D,Y, D,SP
      MOVB  D,Y, A,PC
      MOVB  D,Y, B,PC
      MOVB  D,Y, D,PC
      MOVB  D,Y, 0,X
      MOVB  D,Y, 1,+X
      MOVB  D,Y, 8,-X
      MOVB  D,Y, 1,X+
      MOVB  D,Y, 8,X-
      MOVB  D,Y, 0,Y
      MOVB  D,Y, 1,+Y
      MOVB  D,Y, 8,-Y
      MOVB  D,Y, 1,Y+
      MOVB  D,Y, 8,Y-
      MOVB  D,Y, 0,SP
      MOVB  D,Y, 1,+SP
      MOVB  D,Y, 8,-SP
      MOVB  D,Y, 1,SP+
      MOVB  D,Y, 8,SP-
      MOVB  D,Y, $244E,PC
      MOVB  D,Y, A,X
      MOVB  D,Y, B,X
      MOVB  D,Y, D,X
      MOVB  D,Y, A,Y
      MOVB  D,Y, B,Y
      MOVB  D,Y, D,Y
      MOVB  A,SP, B,SP
      MOVB  A,SP, D,SP
      MOVB  A,SP, A,PC
      MOVB  A,SP, B,PC
      MOVB  A,SP, D,PC
      MOVB  A,SP, 0,X
      MOVB  A,SP, 1,+X
      MOVB  A,SP, 8,-X
      MOVB  A,SP, 1,X+
      MOVB  A,SP, 8,X-
      MOVB  A,SP, 0,Y
      MOVB  A,SP, 1,+Y
      MOVB  A,SP, 8,-Y
      MOVB  A,SP, 1,Y+
      MOVB  A,SP, 8,Y-
      MOVB  A,SP, 0,SP
      MOVB  A,SP, 1,+SP
      MOVB  A,SP, 8,-SP
      MOVB  A,SP, 1,SP+
      MOVB  A,SP, 8,SP-
      MOVB  A,SP, $24BA,PC
      MOVB  A,SP, A,X
      MOVB  A,SP, B,X
      MOVB  A,SP, D,X
      MOVB  A,SP, A,Y
      MOVB  A,SP, B,Y
      MOVB  A,SP, D,Y
      MOVB  A,SP, A,SP
      MOVB  B,SP, D,SP
      MOVB  B,SP, A,PC
      MOVB  B,SP, B,PC
      MOVB  B,SP, D,PC
      MOVB  B,SP, 0,X
      MOVB  B,SP, 1,+X
      MOVB  B,SP, 8,-X
      MOVB  B,SP, 1,X+
      MOVB  B,SP, 8,X-
      MOVB  B,SP, 0,Y
      MOVB  B,SP, 1,+Y
      MOVB  B,SP, 8,-Y
      MOVB  B,SP, 1,Y+
      MOVB  B,SP, 8,Y-
      MOVB  B,SP, 0,SP
      MOVB  B,SP, 1,+SP
      MOVB  B,SP, 8,-SP
      MOVB  B,SP, 1,SP+
      MOVB  B,SP, 8,SP-
      MOVB  B,SP, $2526,PC
      MOVB  B,SP, A,X
      MOVB  B,SP, B,X
      MOVB  B,SP, D,X
      MOVB  B,SP, A,Y
      MOVB  B,SP, B,Y
      MOVB  B,SP, D,Y
      MOVB  B,SP, A,SP
      MOVB  B,SP, B,SP
      MOVB  D,SP, A,PC
      MOVB  D,SP, B,PC
      MOVB  D,SP, D,PC
      MOVB  D,SP, 0,X
      MOVB  D,SP, 1,+X
      MOVB  D,SP, 8,-X
      MOVB  D,SP, 1,X+
      MOVB  D,SP, 8,X-
      MOVB  D,SP, 0,Y
      MOVB  D,SP, 1,+Y
      MOVB  D,SP, 8,-Y
      MOVB  D,SP, 1,Y+
      MOVB  D,SP, 8,Y-
      MOVB  D,SP, 0,SP
      MOVB  D,SP, 1,+SP
      MOVB  D,SP, 8,-SP
      MOVB  D,SP, 1,SP+
      MOVB  D,SP, 8,SP-
      MOVB  D,SP, $2592,PC
      MOVB  D,SP, A,X
      MOVB  D,SP, B,X
      MOVB  D,SP, D,X
      MOVB  D,SP, A,Y
      MOVB  D,SP, B,Y
      MOVB  D,SP, D,Y
      MOVB  D,SP, A,SP
      MOVB  D,SP, B,SP
      MOVB  D,SP, D,SP
      MOVB  A,PC, B,PC
      MOVB  A,PC, D,PC
      MOVB  A,PC, 0,X
      MOVB  A,PC, 1,+X
      MOVB  A,PC, 8,-X
      MOVB  A,PC, 1,X+
      MOVB  A,PC, 8,X-
      MOVB  A,PC, 0,Y
      MOVB  A,PC, 1,+Y
      MOVB  A,PC, 8,-Y
      MOVB  A,PC, 1,Y+
      MOVB  A,PC, 8,Y-
      MOVB  A,PC, 0,SP
      MOVB  A,PC, 1,+SP
      MOVB  A,PC, 8,-SP
      MOVB  A,PC, 1,SP+
      MOVB  A,PC, 8,SP-
      MOVB  A,PC, $25FE,PC
      MOVB  A,PC, A,X
      MOVB  A,PC, B,X
      MOVB  A,PC, D,X
      MOVB  A,PC, A,Y
      MOVB  A,PC, B,Y
      MOVB  A,PC, D,Y
      MOVB  A,PC, A,SP
      MOVB  A,PC, B,SP
      MOVB  A,PC, D,SP
      MOVB  A,PC, A,PC
      MOVB  B,PC, D,PC
      MOVB  B,PC, 0,X
      MOVB  B,PC, 1,+X
      MOVB  B,PC, 8,-X
      MOVB  B,PC, 1,X+
      MOVB  B,PC, 8,X-
      MOVB  B,PC, 0,Y
      MOVB  B,PC, 1,+Y
      MOVB  B,PC, 8,-Y
      MOVB  B,PC, 1,Y+
      MOVB  B,PC, 8,Y-
      MOVB  B,PC, 0,SP
      MOVB  B,PC, 1,+SP
      MOVB  B,PC, 8,-SP
      MOVB  B,PC, 1,SP+
      MOVB  B,PC, 8,SP-
      MOVB  B,PC, $266A,PC
      MOVB  B,PC, A,X
      MOVB  B,PC, B,X
      MOVB  B,PC, D,X
      MOVB  B,PC, A,Y
      MOVB  B,PC, B,Y
      MOVB  B,PC, D,Y
      MOVB  B,PC, A,SP
      MOVB  B,PC, B,SP
      MOVB  B,PC, D,SP
      MOVB  B,PC, A,PC
      MOVB  B,PC, B,PC
      MOVB  D,PC, 0,X
      MOVB  D,PC, 1,+X
      MOVB  D,PC, 8,-X
      MOVB  D,PC, 1,X+
      MOVB  D,PC, 8,X-
      MOVB  D,PC, 0,Y
      MOVB  D,PC, 1,+Y
      MOVB  D,PC, 8,-Y
      MOVB  D,PC, 1,Y+
      MOVB  D,PC, 8,Y-
      MOVB  D,PC, 0,SP
      MOVB  D,PC, 1,+SP
      MOVB  D,PC, 8,-SP
      MOVB  D,PC, 1,SP+
      MOVB  D,PC, 8,SP-
      MOVB  D,PC, $26D6,PC
      MOVB  D,PC, A,X
      MOVB  D,PC, B,X
      MOVB  D,PC, D,X
      MOVB  D,PC, A,Y
      MOVB  D,PC, B,Y
      MOVB  D,PC, D,Y
      MOVB  D,PC, A,SP
      MOVB  D,PC, B,SP
      MOVB  D,PC, D,SP
      MOVB  D,PC, A,PC
      MOVB  D,PC, B,PC
      MOVB  D,PC, D,PC
      MOVB  #12, $0D0E
      MOVB  #12, >$0001
      MOVB  $0D0E, $0F10
      MOVB  $0D0E, >$0001
      MOVB  >$0001, $0203
      MOVB  >$0001, >$0001
      MOVB  14,X, $0F10
      MOVB  14,X, >$0001
      MOVB  1,+X, $2122
      MOVB  1,+X, >$0001
      MOVB  8,-X, $292A
      MOVB  8,-X, >$0001
      MOVB  1,X+, $3132
      MOVB  1,X+, >$0001
      MOVB  8,X-, $393A
      MOVB  8,X-, >$0001
      MOVB  0,Y, $4142
      MOVB  0,Y, >$0001
      MOVB  1,+Y, $6162
      MOVB  1,+Y, >$0001
      MOVB  8,-Y, $696A
      MOVB  8,-Y, >$0001
      MOVB  1,Y+, $7172
      MOVB  1,Y+, >$0001
      MOVB  8,Y-, $797A
      MOVB  8,Y-, >$0001
      MOVB  0,SP, $8182
      MOVB  0,SP, >$0001
      MOVB  1,+SP, $A1A2
      MOVB  1,+SP, >$0001
      MOVB  8,-SP, $A9AA
      MOVB  8,-SP, >$0001
      MOVB  1,SP+, $B1B2
      MOVB  1,SP+, >$0001
      MOVB  8,SP-, $B9BA
      MOVB  8,SP-, >$0001
      MOVB  $27C3,PC, $C1C2
      MOVB  $27C8,PC, >$0001
      MOVB  A,X, $E5E6
      MOVB  A,X, >$0001
      MOVB  B,X, $E6E7
      MOVB  B,X, >$0001
      MOVB  D,X, $E7E8
      MOVB  D,X, >$0001
      MOVB  A,Y, $EDEE
      MOVB  A,Y, >$0001
      MOVB  B,Y, $EEEF
      MOVB  B,Y, >$0001
      MOVB  D,Y, $EFF0
      MOVB  D,Y, >$0001
      MOVB  A,SP, $F5F6
      MOVB  A,SP, >$0001
      MOVB  B,SP, $F6F7
      MOVB  B,SP, >$0001
      MOVB  D,SP, $F7F8
      MOVB  D,SP, >$0001
      MOVB  A,PC, $FDFE
      MOVB  A,PC, >$0001
      MOVB  B,PC, $FEFF
      MOVB  B,PC, >$0001
      MOVB  D,PC, $FF00
      MOVB  D,PC, >$0001
      TAB
      TBA
      IDIV
      FDIV
      EMACS $1314
      EMACS >$0001
      EMULS
      EDIVS
      IDIVS
      SBA
      CBA
      MAXA  -7,X
      MAXA  1,+X
      MAXA  8,-X
      MAXA  1,X+
      MAXA  8,X-
      MAXA  0,Y
      MAXA  1,+Y
      MAXA  8,-Y
      MAXA  1,Y+
      MAXA  8,Y-
      MAXA  0,SP
      MAXA  1,+SP
      MAXA  8,-SP
      MAXA  1,SP+
      MAXA  8,SP-
      MAXA  $288A,PC
      MAXA  $E1,X
      MAXA  $E3E4,X
      MAXA  [$E4E5,X]
      MAXA  A,X
      MAXA  B,X
      MAXA  D,X
      MAXA  [D,X]
      MAXA  $E9,Y
      MAXA  $EBEC,Y
      MAXA  [$ECED,Y]
      MAXA  A,Y
      MAXA  B,Y
      MAXA  D,Y
      MAXA  [D,Y]
      MAXA  $F1,SP
      MAXA  $F3F4,SP
      MAXA  [$F4F5,SP]
      MAXA  A,SP
      MAXA  B,SP
      MAXA  D,SP
      MAXA  [D,SP]
      MAXA  $29D5,PC
      MAXA  <$28E0,PC
      MAXA  $24E1,PC
      MAXA  >$27EA,PC
      MAXA  [$25EC,PC]
      MAXA  A,PC
      MAXA  B,PC
      MAXA  D,PC
      MAXA  [D,PC]
      LEAY  -6,X
      LEAY  1,+X
      LEAY  8,-X
      LEAY  1,X+
      LEAY  8,X-
      LEAY  0,Y
      LEAY  1,+Y
      LEAY  8,-Y
      LEAY  1,Y+
      LEAY  8,Y-
      LEAY  0,SP
      LEAY  1,+SP
      LEAY  8,-SP
      LEAY  1,SP+
      LEAY  8,SP-
      LEAY  $291B,PC
      LEAY  $E1,X
      LEAY  $E3E4,X
      LEAY  A,X
      LEAY  B,X
      LEAY  D,X
      LEAY  $E9,Y
      LEAY  $EBEC,Y
      LEAY  A,Y
      LEAY  B,Y
      LEAY  D,Y
      LEAY  $F1,SP
      LEAY  $F3F4,SP
      LEAY  A,SP
      LEAY  B,SP
      LEAY  D,SP
      LEAY  $2A3E,PC
      LEAY  <$2948,PC
      LEAY  $2548,PC
      LEAY  >$2850,PC
      LEAY  A,PC
      LEAY  B,PC
      LEAY  D,PC
      LEAX  -5,X
      LEAX  1,+X
      LEAX  8,-X
      LEAX  1,X+
      LEAX  8,X-
      LEAX  0,Y
      LEAX  1,+Y
      LEAX  8,-Y
      LEAX  1,Y+
      LEAX  8,Y-
      LEAX  0,SP
      LEAX  1,+SP
      LEAX  8,-SP
      LEAX  1,SP+
      LEAX  8,SP-
      LEAX  $2976,PC
      LEAX  $E1,X
      LEAX  $E3E4,X
      LEAX  A,X
      LEAX  B,X
      LEAX  D,X
      LEAX  $E9,Y
      LEAX  $EBEC,Y
      LEAX  A,Y
      LEAX  B,Y
      LEAX  D,Y
      LEAX  $F1,SP
      LEAX  $F3F4,SP
      LEAX  A,SP
      LEAX  B,SP
      LEAX  D,SP
      LEAX  $2A99,PC
      LEAX  <$29A3,PC
      LEAX  $25A3,PC
      LEAX  >$28AB,PC
      LEAX  A,PC
      LEAX  B,PC
      LEAX  D,PC
      LEAS  -4,X
      LEAS  1,+X
      LEAS  8,-X
      LEAS  1,X+
      LEAS  8,X-
      LEAS  0,Y
      LEAS  1,+Y
      LEAS  8,-Y
      LEAS  1,Y+
      LEAS  8,Y-
      LEAS  0,SP
      LEAS  1,+SP
      LEAS  8,-SP
      LEAS  1,SP+
      LEAS  8,SP-
      LEAS  $29D1,PC
      LEAS  $E1,X
      LEAS  $E3E4,X
      LEAS  A,X
      LEAS  B,X
      LEAS  D,X
      LEAS  $E9,Y
      LEAS  $EBEC,Y
      LEAS  A,Y
      LEAS  B,Y
      LEAS  D,Y
      LEAS  $F1,SP
      LEAS  $F3F4,SP
      LEAS  A,SP
      LEAS  B,SP
      LEAS  D,SP
      LEAS  $2AF4,PC
      LEAS  <$29FE,PC
      LEAS  $25FE,PC
      LEAS  >$2906,PC
      LEAS  A,PC
      LEAS  B,PC
      LEAS  D,PC
      BSET  $1D1E, #31
      BSET  >$0001, #2
      BCLR  $1E1F, #32
      BCLR  >$0001, #2
      BRSET $1F20, #$21, *+39
      BRSET >$0001, #2, *+8
      BRCLR $2021, #$22, *+40
      BRCLR >$0001, #2, *+8
      BRA   *+35
      BRN   *+36
      BHI   *+37
      BLS   *+38
      BCC   *+39
      BCS   *+40
      BNE   *+41
      BEQ   *+42
      BVC   *+43
      BVS   *+44
      BPL   *+45
      BMI   *+46
      BGE   *+47
      BLT   *+48
      BGT   *+49
      BLE   *+50
      PULX
      PULY
      PULA
      PULB
      PSHX
      PSHY
      PSHA
      PSHB
      PULC
      PSHC
      PULD
      PSHD
      RTS
      WAI
      SWI
      NEGA
      COMA
      INCA
      DECA
      LSRA
      ROLA
      RORA
      ASRA
      ASLA
      LSRD
      CALL  $4B4C, $4D
      CALL  >$0001, 2
      CALL  12,Y, $4D
      CALL  1,+Y, $61
      CALL  8,-Y, $69
      CALL  1,Y+, $71
      CALL  8,Y-, $79
      CALL  0,SP, $81
      CALL  1,+SP, $A1
      CALL  8,-SP, $A9
      CALL  1,SP+, $B1
      CALL  8,SP-, $B9
      CALL  $2A92,PC, $C1
      CALL  $E1,X, $E2
      CALL  $E3E4,X, $E5
      CALL  [$E4E5,X]
      CALL  A,X, $E5
      CALL  B,X, $E6
      CALL  D,X, $E7
      CALL  [D,X]
      CALL  $E9,Y, $EA
      CALL  $EBEC,Y, $ED
      CALL  [$ECED,Y]
      CALL  A,Y, $ED
      CALL  B,Y, $EE
      CALL  D,Y, $EF
      CALL  [D,Y]
      CALL  $F1,SP, $F2
      CALL  $F3F4,SP, $F5
      CALL  [$F4F5,SP]
      CALL  A,SP, $F5
      CALL  B,SP, $F6
      CALL  D,SP, $F7
      CALL  [D,SP]
      CALL  $2BD7,PC, $FA
      CALL  <$2AE2,PC, 1
      CALL  $26E3,PC, $FD
      CALL  >$29EC,PC, 1
      CALL  [$27ED,PC]
      CALL  A,PC, $FD
      CALL  B,PC, $FE
      CALL  D,PC, $FF
      CALL  [D,PC]
      CALL  0,X, 1
      CALL  1,+X, $21
      CALL  8,-X, $29
      CALL  1,X+, $31
      CALL  8,X-, $39
      BSET  $4D, #$4E
      BCLR  $4E, #$4F
      BRSET $4F, #$50, *+85
      BRCLR $50, #$51, *+86
      NEGB
      COMB
      INCB
      DECB
      LSRB
      ROLB
      RORB
      ASRB
      ASLB
      ASLD
      STAA  $5B
      STAB  $5C
      STD   $5D
      STY   $5E
      STX   $5F
      STS   $60
      NEG   2,+Y
      NEG   8,-Y
      NEG   1,Y+
      NEG   8,Y-
      NEG   0,SP
      NEG   1,+SP
      NEG   8,-SP
      NEG   1,SP+
      NEG   8,SP-
      NEG   $2B42,PC
      NEG   $E1,X
      NEG   $E3E4,X
      NEG   [$E4E5,X]
      NEG   A,X
      NEG   B,X
      NEG   D,X
      NEG   [D,X]
      NEG   $E9,Y
      NEG   $EBEC,Y
      NEG   [$ECED,Y]
      NEG   A,Y
      NEG   B,Y
      NEG   D,Y
      NEG   [D,Y]
      NEG   $F1,SP
      NEG   $F3F4,SP
      NEG   [$F4F5,SP]
      NEG   A,SP
      NEG   B,SP
      NEG   D,SP
      NEG   [D,SP]
      NEG   $2C77,PC
      NEG   <$2B81,PC
      NEG   $2781,PC
      NEG   >$2A89,PC
      NEG   [$288A,PC]
      NEG   A,PC
      NEG   B,PC
      NEG   D,PC
      NEG   [D,PC]
      NEG   0,X
      NEG   1,+X
      NEG   8,-X
      NEG   1,X+
      NEG   8,X-
      NEG   0,Y
      COM   3,+Y
      COM   8,-Y
      COM   1,Y+
      COM   8,Y-
      COM   0,SP
      COM   1,+SP
      COM   8,-SP
      COM   1,SP+
      COM   8,SP-
      COM   $2BB5,PC
      COM   $E1,X
      COM   $E3E4,X
      COM   [$E4E5,X]
      COM   A,X
      COM   B,X
      COM   D,X
      COM   [D,X]
      COM   $E9,Y
      COM   $EBEC,Y
      COM   [$ECED,Y]
      COM   A,Y
      COM   B,Y
      COM   D,Y
      COM   [D,Y]
      COM   $F1,SP
      COM   $F3F4,SP
      COM   [$F4F5,SP]
      COM   A,SP
      COM   B,SP
      COM   D,SP
      COM   [D,SP]
      COM   $2CEA,PC
      COM   <$2BF4,PC
      COM   $27F4,PC
      COM   >$2AFC,PC
      COM   [$28FD,PC]
      COM   A,PC
      COM   B,PC
      COM   D,PC
      COM   [D,PC]
      COM   0,X
      COM   1,+X
      COM   8,-X
      COM   1,X+
      COM   8,X-
      COM   0,Y
      INC   4,+Y
      INC   8,-Y
      INC   1,Y+
      INC   8,Y-
      INC   0,SP
      INC   1,+SP
      INC   8,-SP
      INC   1,SP+
      INC   8,SP-
      INC   $2C28,PC
      INC   $E1,X
      INC   $E3E4,X
      INC   [$E4E5,X]
      INC   A,X
      INC   B,X
      INC   D,X
      INC   [D,X]
      INC   $E9,Y
      INC   $EBEC,Y
      INC   [$ECED,Y]
      INC   A,Y
      INC   B,Y
      INC   D,Y
      INC   [D,Y]
      INC   $F1,SP
      INC   $F3F4,SP
      INC   [$F4F5,SP]
      INC   A,SP
      INC   B,SP
      INC   D,SP
      INC   [D,SP]
      INC   $2D5D,PC
      INC   <$2C67,PC
      INC   $2867,PC
      INC   >$2B6F,PC
      INC   [$2970,PC]
      INC   A,PC
      INC   B,PC
      INC   D,PC
      INC   [D,PC]
      INC   0,X
      INC   1,+X
      INC   8,-X
      INC   1,X+
      INC   8,X-
      INC   0,Y
      DEC   5,+Y
      DEC   8,-Y
      DEC   1,Y+
      DEC   8,Y-
      DEC   0,SP
      DEC   1,+SP
      DEC   8,-SP
      DEC   1,SP+
      DEC   8,SP-
      DEC   $2C9B,PC
      DEC   $E1,X
      DEC   $E3E4,X
      DEC   [$E4E5,X]
      DEC   A,X
      DEC   B,X
      DEC   D,X
      DEC   [D,X]
      DEC   $E9,Y
      DEC   $EBEC,Y
      DEC   [$ECED,Y]
      DEC   A,Y
      DEC   B,Y
      DEC   D,Y
      DEC   [D,Y]
      DEC   $F1,SP
      DEC   $F3F4,SP
      DEC   [$F4F5,SP]
      DEC   A,SP
      DEC   B,SP
      DEC   D,SP
      DEC   [D,SP]
      DEC   $2DD0,PC
      DEC   <$2CDA,PC
      DEC   $28DA,PC
      DEC   >$2BE2,PC
      DEC   [$29E3,PC]
      DEC   A,PC
      DEC   B,PC
      DEC   D,PC
      DEC   [D,PC]
      DEC   0,X
      DEC   1,+X
      DEC   8,-X
      DEC   1,X+
      DEC   8,X-
      DEC   0,Y
      LSR   6,+Y
      LSR   8,-Y
      LSR   1,Y+
      LSR   8,Y-
      LSR   0,SP
      LSR   1,+SP
      LSR   8,-SP
      LSR   1,SP+
      LSR   8,SP-
      LSR   $2D0E,PC
      LSR   $E1,X
      LSR   $E3E4,X
      LSR   [$E4E5,X]
      LSR   A,X
      LSR   B,X
      LSR   D,X
      LSR   [D,X]
      LSR   $E9,Y
      LSR   $EBEC,Y
      LSR   [$ECED,Y]
      LSR   A,Y
      LSR   B,Y
      LSR   D,Y
      LSR   [D,Y]
      LSR   $F1,SP
      LSR   $F3F4,SP
      LSR   [$F4F5,SP]
      LSR   A,SP
      LSR   B,SP
      LSR   D,SP
      LSR   [D,SP]
      LSR   $2E43,PC
      LSR   <$2D4D,PC
      LSR   $294D,PC
      LSR   >$2C55,PC
      LSR   [$2A56,PC]
      LSR   A,PC
      LSR   B,PC
      LSR   D,PC
      LSR   [D,PC]
      LSR   0,X
      LSR   1,+X
      LSR   8,-X
      LSR   1,X+
      LSR   8,X-
      LSR   0,Y
      ROL   7,+Y
      ROL   8,-Y
      ROL   1,Y+
      ROL   8,Y-
      ROL   0,SP
      ROL   1,+SP
      ROL   8,-SP
      ROL   1,SP+
      ROL   8,SP-
      ROL   $2D81,PC
      ROL   $E1,X
      ROL   $E3E4,X
      ROL   [$E4E5,X]
      ROL   A,X
      ROL   B,X
      ROL   D,X
      ROL   [D,X]
      ROL   $E9,Y
      ROL   $EBEC,Y
      ROL   [$ECED,Y]
      ROL   A,Y
      ROL   B,Y
      ROL   D,Y
      ROL   [D,Y]
      ROL   $F1,SP
      ROL   $F3F4,SP
      ROL   [$F4F5,SP]
      ROL   A,SP
      ROL   B,SP
      ROL   D,SP
      ROL   [D,SP]
      ROL   $2EB6,PC
      ROL   <$2DC0,PC
      ROL   $29C0,PC
      ROL   >$2CC8,PC
      ROL   [$2AC9,PC]
      ROL   A,PC
      ROL   B,PC
      ROL   D,PC
      ROL   [D,PC]
      ROL   0,X
      ROL   1,+X
      ROL   8,-X
      ROL   1,X+
      ROL   8,X-
      ROL   0,Y
      ROR   8,+Y
      ROR   8,-Y
      ROR   1,Y+
      ROR   8,Y-
      ROR   0,SP
      ROR   1,+SP
      ROR   8,-SP
      ROR   1,SP+
      ROR   8,SP-
      ROR   $2DF4,PC
      ROR   $E1,X
      ROR   $E3E4,X
      ROR   [$E4E5,X]
      ROR   A,X
      ROR   B,X
      ROR   D,X
      ROR   [D,X]
      ROR   $E9,Y
      ROR   $EBEC,Y
      ROR   [$ECED,Y]
      ROR   A,Y
      ROR   B,Y
      ROR   D,Y
      ROR   [D,Y]
      ROR   $F1,SP
      ROR   $F3F4,SP
      ROR   [$F4F5,SP]
      ROR   A,SP
      ROR   B,SP
      ROR   D,SP
      ROR   [D,SP]
      ROR   $2F29,PC
      ROR   <$2E33,PC
      ROR   $2A33,PC
      ROR   >$2D3B,PC
      ROR   [$2B3C,PC]
      ROR   A,PC
      ROR   B,PC
      ROR   D,PC
      ROR   [D,PC]
      ROR   0,X
      ROR   1,+X
      ROR   8,-X
      ROR   1,X+
      ROR   8,X-
      ROR   0,Y
      ASR   8,-Y
      ASR   1,Y+
      ASR   8,Y-
      ASR   0,SP
      ASR   1,+SP
      ASR   8,-SP
      ASR   1,SP+
      ASR   8,SP-
      ASR   $2E65,PC
      ASR   $E1,X
      ASR   $E3E4,X
      ASR   [$E4E5,X]
      ASR   A,X
      ASR   B,X
      ASR   D,X
      ASR   [D,X]
      ASR   $E9,Y
      ASR   $EBEC,Y
      ASR   [$ECED,Y]
      ASR   A,Y
      ASR   B,Y
      ASR   D,Y
      ASR   [D,Y]
      ASR   $F1,SP
      ASR   $F3F4,SP
      ASR   [$F4F5,SP]
      ASR   A,SP
      ASR   B,SP
      ASR   D,SP
      ASR   [D,SP]
      ASR   $2F9A,PC
      ASR   <$2EA4,PC
      ASR   $2AA4,PC
      ASR   >$2DAC,PC
      ASR   [$2BAD,PC]
      ASR   A,PC
      ASR   B,PC
      ASR   D,PC
      ASR   [D,PC]
      ASR   0,X
      ASR   1,+X
      ASR   8,-X
      ASR   1,X+
      ASR   8,X-
      ASR   0,Y
      ASR   1,+Y
      ASL   7,-Y
      ASL   1,Y+
      ASL   8,Y-
      ASL   0,SP
      ASL   1,+SP
      ASL   8,-SP
      ASL   1,SP+
      ASL   8,SP-
      ASL   $2ED8,PC
      ASL   $E1,X
      ASL   $E3E4,X
      ASL   [$E4E5,X]
      ASL   A,X
      ASL   B,X
      ASL   D,X
      ASL   [D,X]
      ASL   $E9,Y
      ASL   $EBEC,Y
      ASL   [$ECED,Y]
      ASL   A,Y
      ASL   B,Y
      ASL   D,Y
      ASL   [D,Y]
      ASL   $F1,SP
      ASL   $F3F4,SP
      ASL   [$F4F5,SP]
      ASL   A,SP
      ASL   B,SP
      ASL   D,SP
      ASL   [D,SP]
      ASL   $300D,PC
      ASL   <$2F17,PC
      ASL   $2B17,PC
      ASL   >$2E1F,PC
      ASL   [$2C20,PC]
      ASL   A,PC
      ASL   B,PC
      ASL   D,PC
      ASL   [D,PC]
      ASL   0,X
      ASL   1,+X
      ASL   8,-X
      ASL   1,X+
      ASL   8,X-
      ASL   0,Y
      ASL   1,+Y
      CLR   6,-Y
      CLR   1,Y+
      CLR   8,Y-
      CLR   0,SP
      CLR   1,+SP
      CLR   8,-SP
      CLR   1,SP+
      CLR   8,SP-
      CLR   $2F4B,PC
      CLR   $E1,X
      CLR   $E3E4,X
      CLR   [$E4E5,X]
      CLR   A,X
      CLR   B,X
      CLR   D,X
      CLR   [D,X]
      CLR   $E9,Y
      CLR   $EBEC,Y
      CLR   [$ECED,Y]
      CLR   A,Y
      CLR   B,Y
      CLR   D,Y
      CLR   [D,Y]
      CLR   $F1,SP
      CLR   $F3F4,SP
      CLR   [$F4F5,SP]
      CLR   A,SP
      CLR   B,SP
      CLR   D,SP
      CLR   [D,SP]
      CLR   $3080,PC
      CLR   <$2F8A,PC
      CLR   $2B8A,PC
      CLR   >$2E92,PC
      CLR   [$2C93,PC]
      CLR   A,PC
      CLR   B,PC
      CLR   D,PC
      CLR   [D,PC]
      CLR   0,X
      CLR   1,+X
      CLR   8,-X
      CLR   1,X+
      CLR   8,X-
      CLR   0,Y
      CLR   1,+Y
      STAA  5,-Y
      STAA  1,Y+
      STAA  8,Y-
      STAA  0,SP
      STAA  1,+SP
      STAA  8,-SP
      STAA  1,SP+
      STAA  8,SP-
      STAA  $2FBE,PC
      STAA  $E1,X
      STAA  $E3E4,X
      STAA  [$E4E5,X]
      STAA  A,X
      STAA  B,X
      STAA  D,X
      STAA  [D,X]
      STAA  $E9,Y
      STAA  $EBEC,Y
      STAA  [$ECED,Y]
      STAA  A,Y
      STAA  B,Y
      STAA  D,Y
      STAA  [D,Y]
      STAA  $F1,SP
      STAA  $F3F4,SP
      STAA  [$F4F5,SP]
      STAA  A,SP
      STAA  B,SP
      STAA  D,SP
      STAA  [D,SP]
      STAA  $30F3,PC
      STAA  <$2FFD,PC
      STAA  $2BFD,PC
      STAA  >$2F05,PC
      STAA  [$2D06,PC]
      STAA  A,PC
      STAA  B,PC
      STAA  D,PC
      STAA  [D,PC]
      STAA  0,X
      STAA  1,+X
      STAA  8,-X
      STAA  1,X+
      STAA  8,X-
      STAA  0,Y
      STAA  1,+Y
      STAB  4,-Y
      STAB  1,Y+
      STAB  8,Y-
      STAB  0,SP
      STAB  1,+SP
      STAB  8,-SP
      STAB  1,SP+
      STAB  8,SP-
      STAB  $3031,PC
      STAB  $E1,X
      STAB  $E3E4,X
      STAB  [$E4E5,X]
      STAB  A,X
      STAB  B,X
      STAB  D,X
      STAB  [D,X]
      STAB  $E9,Y
      STAB  $EBEC,Y
      STAB  [$ECED,Y]
      STAB  A,Y
      STAB  B,Y
      STAB  D,Y
      STAB  [D,Y]
      STAB  $F1,SP
      STAB  $F3F4,SP
      STAB  [$F4F5,SP]
      STAB  A,SP
      STAB  B,SP
      STAB  D,SP
      STAB  [D,SP]
      STAB  $3166,PC
      STAB  <$3070,PC
      STAB  $2C70,PC
      STAB  >$2F78,PC
      STAB  [$2D79,PC]
      STAB  A,PC
      STAB  B,PC
      STAB  D,PC
      STAB  [D,PC]
      STAB  0,X
      STAB  1,+X
      STAB  8,-X
      STAB  1,X+
      STAB  8,X-
      STAB  0,Y
      STAB  1,+Y
      STD   3,-Y
      STD   1,Y+
      STD   8,Y-
      STD   0,SP
      STD   1,+SP
      STD   8,-SP
      STD   1,SP+
      STD   8,SP-
      STD   $30A4,PC
      STD   $E1,X
      STD   $E3E4,X
      STD   [$E4E5,X]
      STD   A,X
      STD   B,X
      STD   D,X
      STD   [D,X]
      STD   $E9,Y
      STD   $EBEC,Y
      STD   [$ECED,Y]
      STD   A,Y
      STD   B,Y
      STD   D,Y
      STD   [D,Y]
      STD   $F1,SP
      STD   $F3F4,SP
      STD   [$F4F5,SP]
      STD   A,SP
      STD   B,SP
      STD   D,SP
      STD   [D,SP]
      STD   $31D9,PC
      STD   <$30E3,PC
      STD   $2CE3,PC
      STD   >$2FEB,PC
      STD   [$2DEC,PC]
      STD   A,PC
      STD   B,PC
      STD   D,PC
      STD   [D,PC]
      STD   0,X
      STD   1,+X
      STD   8,-X
      STD   1,X+
      STD   8,X-
      STD   0,Y
      STD   1,+Y
      STY   2,-Y
      STY   1,Y+
      STY   8,Y-
      STY   0,SP
      STY   1,+SP
      STY   8,-SP
      STY   1,SP+
      STY   8,SP-
      STY   $3117,PC
      STY   $E1,X
      STY   $E3E4,X
      STY   [$E4E5,X]
      STY   A,X
      STY   B,X
      STY   D,X
      STY   [D,X]
      STY   $E9,Y
      STY   $EBEC,Y
      STY   [$ECED,Y]
      STY   A,Y
      STY   B,Y
      STY   D,Y
      STY   [D,Y]
      STY   $F1,SP
      STY   $F3F4,SP
      STY   [$F4F5,SP]
      STY   A,SP
      STY   B,SP
      STY   D,SP
      STY   [D,SP]
      STY   $324C,PC
      STY   <$3156,PC
      STY   $2D56,PC
      STY   >$305E,PC
      STY   [$2E5F,PC]
      STY   A,PC
      STY   B,PC
      STY   D,PC
      STY   [D,PC]
      STY   0,X
      STY   1,+X
      STY   8,-X
      STY   1,X+
      STY   8,X-
      STY   0,Y
      STY   1,+Y
      STX   1,-Y
      STX   1,Y+
      STX   8,Y-
      STX   0,SP
      STX   1,+SP
      STX   8,-SP
      STX   1,SP+
      STX   8,SP-
      STX   $318A,PC
      STX   $E1,X
      STX   $E3E4,X
      STX   [$E4E5,X]
      STX   A,X
      STX   B,X
      STX   D,X
      STX   [D,X]
      STX   $E9,Y
      STX   $EBEC,Y
      STX   [$ECED,Y]
      STX   A,Y
      STX   B,Y
      STX   D,Y
      STX   [D,Y]
      STX   $F1,SP
      STX   $F3F4,SP
      STX   [$F4F5,SP]
      STX   A,SP
      STX   B,SP
      STX   D,SP
      STX   [D,SP]
      STX   $32BF,PC
      STX   <$31C9,PC
      STX   $2DC9,PC
      STX   >$30D1,PC
      STX   [$2ED2,PC]
      STX   A,PC
      STX   B,PC
      STX   D,PC
      STX   [D,PC]
      STX   0,X
      STX   1,+X
      STX   8,-X
      STX   1,X+
      STX   8,X-
      STX   0,Y
      STX   1,+Y
      STS   1,Y+
      STS   8,Y-
      STS   0,SP
      STS   1,+SP
      STS   8,-SP
      STS   1,SP+
      STS   8,SP-
      STS   $31FB,PC
      STS   $E1,X
      STS   $E3E4,X
      STS   [$E4E5,X]
      STS   A,X
      STS   B,X
      STS   D,X
      STS   [D,X]
      STS   $E9,Y
      STS   $EBEC,Y
      STS   [$ECED,Y]
      STS   A,Y
      STS   B,Y
      STS   D,Y
      STS   [D,Y]
      STS   $F1,SP
      STS   $F3F4,SP
      STS   [$F4F5,SP]
      STS   A,SP
      STS   B,SP
      STS   D,SP
      STS   [D,SP]
      STS   $3330,PC
      STS   <$323A,PC
      STS   $2E3A,PC
      STS   >$3142,PC
      STS   [$2F43,PC]
      STS   A,PC
      STS   B,PC
      STS   D,PC
      STS   [D,PC]
      STS   0,X
      STS   1,+X
      STS   8,-X
      STS   1,X+
      STS   8,X-
      STS   0,Y
      STS   1,+Y
      STS   8,-Y
      NEG   $7172
      NEG   >$0001
      COM   $7273
      COM   >$0001
      INC   $7374
      INC   >$0001
      DEC   $7475
      DEC   >$0001
      LSR   $7576
      LSR   >$0001
      ROL   $7677
      ROL   >$0001
      ROR   $7778
      ROR   >$0001
      ASR   $7879
      ASR   >$0001
      ASL   $797A
      ASL   >$0001
      CLR   $7A7B
      CLR   >$0001
      STAA  $7B7C
      STAA  >$0001
      STAB  $7C7D
      STAB  >$0001
      STD   $7D7E
      STD   >$0001
      STY   $7E7F
      STY   >$0001
      STX   $7F80
      STX   >$0001
      STS   $8081
      STS   >$0001
      SUBA  #$81
      CMPA  #$82
      SBCA  #$83
      SUBD  #$8485
      ANDA  #$85
      BITA  #$86
      LDAA  #$87
      CLRA
      EORA  #$89
      ADCA  #$8A
      ORAA  #$8B
      ADDA  #$8C
      CPD   #$8D8E
      CPY   #$8E8F
      CPX   #$8F90
      CPS   #$9091
      SUBA  $91
      CMPA  $92
      SBCA  $93
      SUBD  $94
      ANDA  $95
      BITA  $96
      LDAA  $97
      TSTA
      EORA  $99
      ADCA  $9A
      ORAA  $9B
      ADDA  $9C
      CPD   $9D
      CPY   $9E
      CPX   $9F
      CPS   $A0
      SUBA  2,+SP
      SUBA  8,-SP
      SUBA  1,SP+
      SUBA  8,SP-
      SUBA  $330B,PC
      SUBA  $E1,X
      SUBA  $E3E4,X
      SUBA  [$E4E5,X]
      SUBA  A,X
      SUBA  B,X
      SUBA  D,X
      SUBA  [D,X]
      SUBA  $E9,Y
      SUBA  $EBEC,Y
      SUBA  [$ECED,Y]
      SUBA  A,Y
      SUBA  B,Y
      SUBA  D,Y
      SUBA  [D,Y]
      SUBA  $F1,SP
      SUBA  $F3F4,SP
      SUBA  [$F4F5,SP]
      SUBA  A,SP
      SUBA  B,SP
      SUBA  D,SP
      SUBA  [D,SP]
      SUBA  $3440,PC
      SUBA  <$334A,PC
      SUBA  $2F4A,PC
      SUBA  >$3252,PC
      SUBA  [$3053,PC]
      SUBA  A,PC
      SUBA  B,PC
      SUBA  D,PC
      SUBA  [D,PC]
      SUBA  0,X
      SUBA  1,+X
      SUBA  8,-X
      SUBA  1,X+
      SUBA  8,X-
      SUBA  0,Y
      SUBA  1,+Y
      SUBA  8,-Y
      SUBA  1,Y+
      SUBA  8,Y-
      SUBA  0,SP
      CMPA  3,+SP
      CMPA  8,-SP
      CMPA  1,SP+
      CMPA  8,SP-
      CMPA  $337E,PC
      CMPA  $E1,X
      CMPA  $E3E4,X
      CMPA  [$E4E5,X]
      CMPA  A,X
      CMPA  B,X
      CMPA  D,X
      CMPA  [D,X]
      CMPA  $E9,Y
      CMPA  $EBEC,Y
      CMPA  [$ECED,Y]
      CMPA  A,Y
      CMPA  B,Y
      CMPA  D,Y
      CMPA  [D,Y]
      CMPA  $F1,SP
      CMPA  $F3F4,SP
      CMPA  [$F4F5,SP]
      CMPA  A,SP
      CMPA  B,SP
      CMPA  D,SP
      CMPA  [D,SP]
      CMPA  $34B3,PC
      CMPA  <$33BD,PC
      CMPA  $2FBD,PC
      CMPA  >$32C5,PC
      CMPA  [$30C6,PC]
      CMPA  A,PC
      CMPA  B,PC
      CMPA  D,PC
      CMPA  [D,PC]
      CMPA  0,X
      CMPA  1,+X
      CMPA  8,-X
      CMPA  1,X+
      CMPA  8,X-
      CMPA  0,Y
      CMPA  1,+Y
      CMPA  8,-Y
      CMPA  1,Y+
      CMPA  8,Y-
      CMPA  0,SP
      SBCA  4,+SP
      SBCA  8,-SP
      SBCA  1,SP+
      SBCA  8,SP-
      SBCA  $33F1,PC
      SBCA  $E1,X
      SBCA  $E3E4,X
      SBCA  [$E4E5,X]
      SBCA  A,X
      SBCA  B,X
      SBCA  D,X
      SBCA  [D,X]
      SBCA  $E9,Y
      SBCA  $EBEC,Y
      SBCA  [$ECED,Y]
      SBCA  A,Y
      SBCA  B,Y
      SBCA  D,Y
      SBCA  [D,Y]
      SBCA  $F1,SP
      SBCA  $F3F4,SP
      SBCA  [$F4F5,SP]
      SBCA  A,SP
      SBCA  B,SP
      SBCA  D,SP
      SBCA  [D,SP]
      SBCA  $3526,PC
      SBCA  <$3430,PC
      SBCA  $3030,PC
      SBCA  >$3338,PC
      SBCA  [$3139,PC]
      SBCA  A,PC
      SBCA  B,PC
      SBCA  D,PC
      SBCA  [D,PC]
      SBCA  0,X
      SBCA  1,+X
      SBCA  8,-X
      SBCA  1,X+
      SBCA  8,X-
      SBCA  0,Y
      SBCA  1,+Y
      SBCA  8,-Y
      SBCA  1,Y+
      SBCA  8,Y-
      SBCA  0,SP
      SUBD  5,+SP
      SUBD  8,-SP
      SUBD  1,SP+
      SUBD  8,SP-
      SUBD  $3464,PC
      SUBD  $E1,X
      SUBD  $E3E4,X
      SUBD  [$E4E5,X]
      SUBD  A,X
      SUBD  B,X
      SUBD  D,X
      SUBD  [D,X]
      SUBD  $E9,Y
      SUBD  $EBEC,Y
      SUBD  [$ECED,Y]
      SUBD  A,Y
      SUBD  B,Y
      SUBD  D,Y
      SUBD  [D,Y]
      SUBD  $F1,SP
      SUBD  $F3F4,SP
      SUBD  [$F4F5,SP]
      SUBD  A,SP
      SUBD  B,SP
      SUBD  D,SP
      SUBD  [D,SP]
      SUBD  $3599,PC
      SUBD  <$34A3,PC
      SUBD  $30A3,PC
      SUBD  >$33AB,PC
      SUBD  [$31AC,PC]
      SUBD  A,PC
      SUBD  B,PC
      SUBD  D,PC
      SUBD  [D,PC]
      SUBD  0,X
      SUBD  1,+X
      SUBD  8,-X
      SUBD  1,X+
      SUBD  8,X-
      SUBD  0,Y
      SUBD  1,+Y
      SUBD  8,-Y
      SUBD  1,Y+
      SUBD  8,Y-
      SUBD  0,SP
      ANDA  6,+SP
      ANDA  8,-SP
      ANDA  1,SP+
      ANDA  8,SP-
      ANDA  $34D7,PC
      ANDA  $E1,X
      ANDA  $E3E4,X
      ANDA  [$E4E5,X]
      ANDA  A,X
      ANDA  B,X
      ANDA  D,X
      ANDA  [D,X]
      ANDA  $E9,Y
      ANDA  $EBEC,Y
      ANDA  [$ECED,Y]
      ANDA  A,Y
      ANDA  B,Y
      ANDA  D,Y
      ANDA  [D,Y]
      ANDA  $F1,SP
      ANDA  $F3F4,SP
      ANDA  [$F4F5,SP]
      ANDA  A,SP
      ANDA  B,SP
      ANDA  D,SP
      ANDA  [D,SP]
      ANDA  $360C,PC
      ANDA  <$3516,PC
      ANDA  $3116,PC
      ANDA  >$341E,PC
      ANDA  [$321F,PC]
      ANDA  A,PC
      ANDA  B,PC
      ANDA  D,PC
      ANDA  [D,PC]
      ANDA  0,X
      ANDA  1,+X
      ANDA  8,-X
      ANDA  1,X+
      ANDA  8,X-
      ANDA  0,Y
      ANDA  1,+Y
      ANDA  8,-Y
      ANDA  1,Y+
      ANDA  8,Y-
      ANDA  0,SP
      BITA  7,+SP
      BITA  8,-SP
      BITA  1,SP+
      BITA  8,SP-
      BITA  $354A,PC
      BITA  $E1,X
      BITA  $E3E4,X
      BITA  [$E4E5,X]
      BITA  A,X
      BITA  B,X
      BITA  D,X
      BITA  [D,X]
      BITA  $E9,Y
      BITA  $EBEC,Y
      BITA  [$ECED,Y]
      BITA  A,Y
      BITA  B,Y
      BITA  D,Y
      BITA  [D,Y]
      BITA  $F1,SP
      BITA  $F3F4,SP
      BITA  [$F4F5,SP]
      BITA  A,SP
      BITA  B,SP
      BITA  D,SP
      BITA  [D,SP]
      BITA  $367F,PC
      BITA  <$3589,PC
      BITA  $3189,PC
      BITA  >$3491,PC
      BITA  [$3292,PC]
      BITA  A,PC
      BITA  B,PC
      BITA  D,PC
      BITA  [D,PC]
      BITA  0,X
      BITA  1,+X
      BITA  8,-X
      BITA  1,X+
      BITA  8,X-
      BITA  0,Y
      BITA  1,+Y
      BITA  8,-Y
      BITA  1,Y+
      BITA  8,Y-
      BITA  0,SP
      LDAA  8,+SP
      LDAA  8,-SP
      LDAA  1,SP+
      LDAA  8,SP-
      LDAA  $35BD,PC
      LDAA  $E1,X
      LDAA  $E3E4,X
      LDAA  [$E4E5,X]
      LDAA  A,X
      LDAA  B,X
      LDAA  D,X
      LDAA  [D,X]
      LDAA  $E9,Y
      LDAA  $EBEC,Y
      LDAA  [$ECED,Y]
      LDAA  A,Y
      LDAA  B,Y
      LDAA  D,Y
      LDAA  [D,Y]
      LDAA  $F1,SP
      LDAA  $F3F4,SP
      LDAA  [$F4F5,SP]
      LDAA  A,SP
      LDAA  B,SP
      LDAA  D,SP
      LDAA  [D,SP]
      LDAA  $36F2,PC
      LDAA  <$35FC,PC
      LDAA  $31FC,PC
      LDAA  >$3504,PC
      LDAA  [$3305,PC]
      LDAA  A,PC
      LDAA  B,PC
      LDAA  D,PC
      LDAA  [D,PC]
      LDAA  0,X
      LDAA  1,+X
      LDAA  8,-X
      LDAA  1,X+
      LDAA  8,X-
      LDAA  0,Y
      LDAA  1,+Y
      LDAA  8,-Y
      LDAA  1,Y+
      LDAA  8,Y-
      LDAA  0,SP
      NOP
      EORA  7,-SP
      EORA  1,SP+
      EORA  8,SP-
      EORA  $362F,PC
      EORA  $E1,X
      EORA  $E3E4,X
      EORA  [$E4E5,X]
      EORA  A,X
      EORA  B,X
      EORA  D,X
      EORA  [D,X]
      EORA  $E9,Y
      EORA  $EBEC,Y
      EORA  [$ECED,Y]
      EORA  A,Y
      EORA  B,Y
      EORA  D,Y
      EORA  [D,Y]
      EORA  $F1,SP
      EORA  $F3F4,SP
      EORA  [$F4F5,SP]
      EORA  A,SP
      EORA  B,SP
      EORA  D,SP
      EORA  [D,SP]
      EORA  $3764,PC
      EORA  <$366E,PC
      EORA  $326E,PC
      EORA  >$3576,PC
      EORA  [$3377,PC]
      EORA  A,PC
      EORA  B,PC
      EORA  D,PC
      EORA  [D,PC]
      EORA  0,X
      EORA  1,+X
      EORA  8,-X
      EORA  1,X+
      EORA  8,X-
      EORA  0,Y
      EORA  1,+Y
      EORA  8,-Y
      EORA  1,Y+
      EORA  8,Y-
      EORA  0,SP
      EORA  1,+SP
      ADCA  6,-SP
      ADCA  1,SP+
      ADCA  8,SP-
      ADCA  $36A2,PC
      ADCA  $E1,X
      ADCA  $E3E4,X
      ADCA  [$E4E5,X]
      ADCA  A,X
      ADCA  B,X
      ADCA  D,X
      ADCA  [D,X]
      ADCA  $E9,Y
      ADCA  $EBEC,Y
      ADCA  [$ECED,Y]
      ADCA  A,Y
      ADCA  B,Y
      ADCA  D,Y
      ADCA  [D,Y]
      ADCA  $F1,SP
      ADCA  $F3F4,SP
      ADCA  [$F4F5,SP]
      ADCA  A,SP
      ADCA  B,SP
      ADCA  D,SP
      ADCA  [D,SP]
      ADCA  $37D7,PC
      ADCA  <$36E1,PC
      ADCA  $32E1,PC
      ADCA  >$35E9,PC
      ADCA  [$33EA,PC]
      ADCA  A,PC
      ADCA  B,PC
      ADCA  D,PC
      ADCA  [D,PC]
      ADCA  0,X
      ADCA  1,+X
      ADCA  8,-X
      ADCA  1,X+
      ADCA  8,X-
      ADCA  0,Y
      ADCA  1,+Y
      ADCA  8,-Y
      ADCA  1,Y+
      ADCA  8,Y-
      ADCA  0,SP
      ADCA  1,+SP
      ORAA  5,-SP
      ORAA  1,SP+
      ORAA  8,SP-
      ORAA  $3715,PC
      ORAA  $E1,X
      ORAA  $E3E4,X
      ORAA  [$E4E5,X]
      ORAA  A,X
      ORAA  B,X
      ORAA  D,X
      ORAA  [D,X]
      ORAA  $E9,Y
      ORAA  $EBEC,Y
      ORAA  [$ECED,Y]
      ORAA  A,Y
      ORAA  B,Y
      ORAA  D,Y
      ORAA  [D,Y]
      ORAA  $F1,SP
      ORAA  $F3F4,SP
      ORAA  [$F4F5,SP]
      ORAA  A,SP
      ORAA  B,SP
      ORAA  D,SP
      ORAA  [D,SP]
      ORAA  $384A,PC
      ORAA  <$3754,PC
      ORAA  $3354,PC
      ORAA  >$365C,PC
      ORAA  [$345D,PC]
      ORAA  A,PC
      ORAA  B,PC
      ORAA  D,PC
      ORAA  [D,PC]
      ORAA  0,X
      ORAA  1,+X
      ORAA  8,-X
      ORAA  1,X+
      ORAA  8,X-
      ORAA  0,Y
      ORAA  1,+Y
      ORAA  8,-Y
      ORAA  1,Y+
      ORAA  8,Y-
      ORAA  0,SP
      ORAA  1,+SP
      ADDA  4,-SP
      ADDA  1,SP+
      ADDA  8,SP-
      ADDA  $3788,PC
      ADDA  $E1,X
      ADDA  $E3E4,X
      ADDA  [$E4E5,X]
      ADDA  A,X
      ADDA  B,X
      ADDA  D,X
      ADDA  [D,X]
      ADDA  $E9,Y
      ADDA  $EBEC,Y
      ADDA  [$ECED,Y]
      ADDA  A,Y
      ADDA  B,Y
      ADDA  D,Y
      ADDA  [D,Y]
      ADDA  $F1,SP
      ADDA  $F3F4,SP
      ADDA  [$F4F5,SP]
      ADDA  A,SP
      ADDA  B,SP
      ADDA  D,SP
      ADDA  [D,SP]
      ADDA  $38BD,PC
      ADDA  <$37C7,PC
      ADDA  $33C7,PC
      ADDA  >$36CF,PC
      ADDA  [$34D0,PC]
      ADDA  A,PC
      ADDA  B,PC
      ADDA  D,PC
      ADDA  [D,PC]
      ADDA  0,X
      ADDA  1,+X
      ADDA  8,-X
      ADDA  1,X+
      ADDA  8,X-
      ADDA  0,Y
      ADDA  1,+Y
      ADDA  8,-Y
      ADDA  1,Y+
      ADDA  8,Y-
      ADDA  0,SP
      ADDA  1,+SP
      CPD   3,-SP
      CPD   1,SP+
      CPD   8,SP-
      CPD   $37FB,PC
      CPD   $E1,X
      CPD   $E3E4,X
      CPD   [$E4E5,X]
      CPD   A,X
      CPD   B,X
      CPD   D,X
      CPD   [D,X]
      CPD   $E9,Y
      CPD   $EBEC,Y
      CPD   [$ECED,Y]
      CPD   A,Y
      CPD   B,Y
      CPD   D,Y
      CPD   [D,Y]
      CPD   $F1,SP
      CPD   $F3F4,SP
      CPD   [$F4F5,SP]
      CPD   A,SP
      CPD   B,SP
      CPD   D,SP
      CPD   [D,SP]
      CPD   $3930,PC
      CPD   <$383A,PC
      CPD   $343A,PC
      CPD   >$3742,PC
      CPD   [$3543,PC]
      CPD   A,PC
      CPD   B,PC
      CPD   D,PC
      CPD   [D,PC]
      CPD   0,X
      CPD   1,+X
      CPD   8,-X
      CPD   1,X+
      CPD   8,X-
      CPD   0,Y
      CPD   1,+Y
      CPD   8,-Y
      CPD   1,Y+
      CPD   8,Y-
      CPD   0,SP
      CPD   1,+SP
      CPY   2,-SP
      CPY   1,SP+
      CPY   8,SP-
      CPY   $386E,PC
      CPY   $E1,X
      CPY   $E3E4,X
      CPY   [$E4E5,X]
      CPY   A,X
      CPY   B,X
      CPY   D,X
      CPY   [D,X]
      CPY   $E9,Y
      CPY   $EBEC,Y
      CPY   [$ECED,Y]
      CPY   A,Y
      CPY   B,Y
      CPY   D,Y
      CPY   [D,Y]
      CPY   $F1,SP
      CPY   $F3F4,SP
      CPY   [$F4F5,SP]
      CPY   A,SP
      CPY   B,SP
      CPY   D,SP
      CPY   [D,SP]
      CPY   $39A3,PC
      CPY   <$38AD,PC
      CPY   $34AD,PC
      CPY   >$37B5,PC
      CPY   [$35B6,PC]
      CPY   A,PC
      CPY   B,PC
      CPY   D,PC
      CPY   [D,PC]
      CPY   0,X
      CPY   1,+X
      CPY   8,-X
      CPY   1,X+
      CPY   8,X-
      CPY   0,Y
      CPY   1,+Y
      CPY   8,-Y
      CPY   1,Y+
      CPY   8,Y-
      CPY   0,SP
      CPY   1,+SP
      CPX   1,-SP
      CPX   1,SP+
      CPX   8,SP-
      CPX   $38E1,PC
      CPX   $E1,X
      CPX   $E3E4,X
      CPX   [$E4E5,X]
      CPX   A,X
      CPX   B,X
      CPX   D,X
      CPX   [D,X]
      CPX   $E9,Y
      CPX   $EBEC,Y
      CPX   [$ECED,Y]
      CPX   A,Y
      CPX   B,Y
      CPX   D,Y
      CPX   [D,Y]
      CPX   $F1,SP
      CPX   $F3F4,SP
      CPX   [$F4F5,SP]
      CPX   A,SP
      CPX   B,SP
      CPX   D,SP
      CPX   [D,SP]
      CPX   $3A16,PC
      CPX   <$3920,PC
      CPX   $3520,PC
      CPX   >$3828,PC
      CPX   [$3629,PC]
      CPX   A,PC
      CPX   B,PC
      CPX   D,PC
      CPX   [D,PC]
      CPX   0,X
      CPX   1,+X
      CPX   8,-X
      CPX   1,X+
      CPX   8,X-
      CPX   0,Y
      CPX   1,+Y
      CPX   8,-Y
      CPX   1,Y+
      CPX   8,Y-
      CPX   0,SP
      CPX   1,+SP
      CPS   1,SP+
      CPS   8,SP-
      CPS   $3952,PC
      CPS   $E1,X
      CPS   $E3E4,X
      CPS   [$E4E5,X]
      CPS   A,X
      CPS   B,X
      CPS   D,X
      CPS   [D,X]
      CPS   $E9,Y
      CPS   $EBEC,Y
      CPS   [$ECED,Y]
      CPS   A,Y
      CPS   B,Y
      CPS   D,Y
      CPS   [D,Y]
      CPS   $F1,SP
      CPS   $F3F4,SP
      CPS   [$F4F5,SP]
      CPS   A,SP
      CPS   B,SP
      CPS   D,SP
      CPS   [D,SP]
      CPS   $3A87,PC
      CPS   <$3991,PC
      CPS   $3591,PC
      CPS   >$3899,PC
      CPS   [$369A,PC]
      CPS   A,PC
      CPS   B,PC
      CPS   D,PC
      CPS   [D,PC]
      CPS   0,X
      CPS   1,+X
      CPS   8,-X
      CPS   1,X+
      CPS   8,X-
      CPS   0,Y
      CPS   1,+Y
      CPS   8,-Y
      CPS   1,Y+
      CPS   8,Y-
      CPS   0,SP
      CPS   1,+SP
      CPS   8,-SP
      SUBA  $B1B2
      SUBA  >$0001
      CMPA  $B2B3
      CMPA  >$0001
      SBCA  $B3B4
      SBCA  >$0001
      SUBD  $B4B5
      SUBD  >$0001
      ANDA  $B5B6
      ANDA  >$0001
      BITA  $B6B7
      BITA  >$0001
      LDAA  $B7B8
      LDAA  >$0001
      EXG   D, A
      EXG   D, B
      EXG   D, CCR
      EXG   D, D
      EXG   D, X
      EXG   D, Y
      EXG   D, SP
      EXG   X, A
      EXG   X, B
      EXG   X, CCR
      EXG   X, D
      EXG   X, X
      EXG   X, Y
      EXG   X, SP
      EXG   Y, A
      EXG   Y, B
      EXG   Y, CCR
      EXG   Y, D
      EXG   Y, X
      EXG   Y, Y
      EXG   Y, SP
      EXG   SP, A
      EXG   SP, B
      EXG   SP, CCR
      EXG   SP, D
      EXG   SP, X
      EXG   SP, Y
      EXG   SP, SP
      TFR   A, A
      TFR   A, B
      TFR   A, CCR
      SEX   A, D
      SEX   A, X
      SEX   A, Y
      SEX   A, SP
      TFR   B, A
      TFR   B, B
      TFR   B, CCR
      SEX   B, D
      SEX   B, X
      SEX   B, Y
      SEX   B, SP
      TFR   CCR, A
      TFR   CCR, B
      TFR   CCR, CCR
      SEX   CCR, D
      SEX   CCR, X
      SEX   CCR, Y
      SEX   CCR, SP
      TFR   D, A
      TFR   D, B
      TFR   D, CCR
      TFR   D, D
      TFR   D, X
      TFR   D, Y
      TFR   D, SP
      TFR   X, A
      TFR   X, B
      TFR   X, CCR
      TFR   X, D
      TFR   X, X
      TFR   X, Y
      TFR   X, SP
      TFR   Y, A
      TFR   Y, B
      TFR   Y, CCR
      TFR   Y, D
      TFR   Y, X
      TFR   Y, Y
      TFR   Y, SP
      TFR   SP, A
      TFR   SP, B
      TFR   SP, CCR
      TFR   SP, D
      TFR   SP, X
      TFR   SP, Y
      TFR   SP, SP
      EXG   A, A
      EXG   A, B
      EXG   A, CCR
      EXG   A, D
      EXG   A, X
      EXG   A, Y
      EXG   A, SP
      EXG   B, A
      EXG   B, B
      EXG   B, CCR
      EXG   B, D
      EXG   B, X
      EXG   B, Y
      EXG   B, SP
      EXG   CCR, A
      EXG   CCR, B
      EXG   CCR, CCR
      EXG   CCR, D
      EXG   CCR, X
      EXG   CCR, Y
      EXG   CCR, SP
      EORA  $B9BA
      EORA  >$0001
      ADCA  $BABB
      ADCA  >$0001
      ORAA  $BBBC
      ORAA  >$0001
      ADDA  $BCBD
      ADDA  >$0001
      CPD   $BDBE
      CPD   >$0001
      CPY   $BEBF
      CPY   >$0001
      CPX   $BFC0
      CPX   >$0001
      CPS   $C0C1
      CPS   >$0001
      SUBB  #$C1
      CMPB  #$C2
      SBCB  #$C3
      ADDD  #$C4C5
      ANDB  #$C5
      BITB  #$C6
      LDAB  #$C7
      CLRB
      EORB  #$C9
      ADCB  #$CA
      ORAB  #$CB
      ADDB  #$CC
      LDD   #$CDCE
      LDY   #$CECF
      LDX   #$CFD0
      LDS   #$D0D1
      SUBB  $D1
      CMPB  $D2
      SBCB  $D3
      ADDD  $D4
      ANDB  $D5
      BITB  $D6
      LDAB  $D7
      TSTB
      EORB  $D9
      ADCB  $DA
      ORAB  $DB
      ADDB  $DC
      LDD   $DD
      LDY   $DE
      LDX   $DF
      LDS   $E0
      SUBB  -30,X
      SUBB  $E3E4,X
      SUBB  [$E4E5,X]
      SUBB  A,X
      SUBB  B,X
      SUBB  D,X
      SUBB  [D,X]
      SUBB  $E9,Y
      SUBB  $EBEC,Y
      SUBB  [$ECED,Y]
      SUBB  A,Y
      SUBB  B,Y
      SUBB  D,Y
      SUBB  [D,Y]
      SUBB  $F1,SP
      SUBB  $F3F4,SP
      SUBB  [$F4F5,SP]
      SUBB  A,SP
      SUBB  B,SP
      SUBB  D,SP
      SUBB  [D,SP]
      SUBB  $3C55,PC
      SUBB  <$3B5F,PC
      SUBB  $375F,PC
      SUBB  >$3A67,PC
      SUBB  [$3868,PC]
      SUBB  A,PC
      SUBB  B,PC
      SUBB  D,PC
      SUBB  [D,PC]
      SUBB  0,X
      SUBB  1,+X
      SUBB  8,-X
      SUBB  1,X+
      SUBB  8,X-
      SUBB  0,Y
      SUBB  1,+Y
      SUBB  8,-Y
      SUBB  1,Y+
      SUBB  8,Y-
      SUBB  0,SP
      SUBB  1,+SP
      SUBB  8,-SP
      SUBB  1,SP+
      SUBB  8,SP-
      SUBB  $3B93,PC
      CMPB  $E3E4,X
      CMPB  [$E4E5,X]
      CMPB  A,X
      CMPB  B,X
      CMPB  D,X
      CMPB  [D,X]
      CMPB  $E9,Y
      CMPB  $EBEC,Y
      CMPB  [$ECED,Y]
      CMPB  A,Y
      CMPB  B,Y
      CMPB  D,Y
      CMPB  [D,Y]
      CMPB  $F1,SP
      CMPB  $F3F4,SP
      CMPB  [$F4F5,SP]
      CMPB  A,SP
      CMPB  B,SP
      CMPB  D,SP
      CMPB  [D,SP]
      CMPB  $3CC5,PC
      CMPB  <$3BCF,PC
      CMPB  $37CF,PC
      CMPB  >$3AD7,PC
      CMPB  [$38D8,PC]
      CMPB  A,PC
      CMPB  B,PC
      CMPB  D,PC
      CMPB  [D,PC]
      CMPB  0,X
      CMPB  1,+X
      CMPB  8,-X
      CMPB  1,X+
      CMPB  8,X-
      CMPB  0,Y
      CMPB  1,+Y
      CMPB  8,-Y
      CMPB  1,Y+
      CMPB  8,Y-
      CMPB  0,SP
      CMPB  1,+SP
      CMPB  8,-SP
      CMPB  1,SP+
      CMPB  8,SP-
      CMPB  $3C03,PC
      CMPB  $E1,X
      SBCB  [$E4E5,X]
      SBCB  A,X
      SBCB  B,X
      SBCB  D,X
      SBCB  [D,X]
      SBCB  $E9,Y
      SBCB  $EBEC,Y
      SBCB  [$ECED,Y]
      SBCB  A,Y
      SBCB  B,Y
      SBCB  D,Y
      SBCB  [D,Y]
      SBCB  $F1,SP
      SBCB  $F3F4,SP
      SBCB  [$F4F5,SP]
      SBCB  A,SP
      SBCB  B,SP
      SBCB  D,SP
      SBCB  [D,SP]
      SBCB  $3D34,PC
      SBCB  <$3C3E,PC
      SBCB  $383E,PC
      SBCB  >$3B46,PC
      SBCB  [$3947,PC]
      SBCB  A,PC
      SBCB  B,PC
      SBCB  D,PC
      SBCB  [D,PC]
      SBCB  0,X
      SBCB  1,+X
      SBCB  8,-X
      SBCB  1,X+
      SBCB  8,X-
      SBCB  0,Y
      SBCB  1,+Y
      SBCB  8,-Y
      SBCB  1,Y+
      SBCB  8,Y-
      SBCB  0,SP
      SBCB  1,+SP
      SBCB  8,-SP
      SBCB  1,SP+
      SBCB  8,SP-
      SBCB  $3C72,PC
      SBCB  $E1,X
      SBCB  $E3E4,X
      ADDD  A,X
      ADDD  B,X
      ADDD  D,X
      ADDD  [D,X]
      ADDD  $E9,Y
      ADDD  $EBEC,Y
      ADDD  [$ECED,Y]
      ADDD  A,Y
      ADDD  B,Y
      ADDD  D,Y
      ADDD  [D,Y]
      ADDD  $F1,SP
      ADDD  $F3F4,SP
      ADDD  [$F4F5,SP]
      ADDD  A,SP
      ADDD  B,SP
      ADDD  D,SP
      ADDD  [D,SP]
      ADDD  $3DA3,PC
      ADDD  <$3CAD,PC
      ADDD  $38AD,PC
      ADDD  >$3BB5,PC
      ADDD  [$39B6,PC]
      ADDD  A,PC
      ADDD  B,PC
      ADDD  D,PC
      ADDD  [D,PC]
      ADDD  0,X
      ADDD  1,+X
      ADDD  8,-X
      ADDD  1,X+
      ADDD  8,X-
      ADDD  0,Y
      ADDD  1,+Y
      ADDD  8,-Y
      ADDD  1,Y+
      ADDD  8,Y-
      ADDD  0,SP
      ADDD  1,+SP
      ADDD  8,-SP
      ADDD  1,SP+
      ADDD  8,SP-
      ADDD  $3CE1,PC
      ADDD  $E1,X
      ADDD  $E3E4,X
      ADDD  [$E4E5,X]
      ANDB  B,X
      ANDB  D,X
      ANDB  [D,X]
      ANDB  $E9,Y
      ANDB  $EBEC,Y
      ANDB  [$ECED,Y]
      ANDB  A,Y
      ANDB  B,Y
      ANDB  D,Y
      ANDB  [D,Y]
      ANDB  $F1,SP
      ANDB  $F3F4,SP
      ANDB  [$F4F5,SP]
      ANDB  A,SP
      ANDB  B,SP
      ANDB  D,SP
      ANDB  [D,SP]
      ANDB  $3E14,PC
      ANDB  <$3D1E,PC
      ANDB  $391E,PC
      ANDB  >$3C26,PC
      ANDB  [$3A27,PC]
      ANDB  A,PC
      ANDB  B,PC
      ANDB  D,PC
      ANDB  [D,PC]
      ANDB  0,X
      ANDB  1,+X
      ANDB  8,-X
      ANDB  1,X+
      ANDB  8,X-
      ANDB  0,Y
      ANDB  1,+Y
      ANDB  8,-Y
      ANDB  1,Y+
      ANDB  8,Y-
      ANDB  0,SP
      ANDB  1,+SP
      ANDB  8,-SP
      ANDB  1,SP+
      ANDB  8,SP-
      ANDB  $3D52,PC
      ANDB  $E1,X
      ANDB  $E3E4,X
      ANDB  [$E4E5,X]
      ANDB  A,X
      BITB  D,X
      BITB  [D,X]
      BITB  $E9,Y
      BITB  $EBEC,Y
      BITB  [$ECED,Y]
      BITB  A,Y
      BITB  B,Y
      BITB  D,Y
      BITB  [D,Y]
      BITB  $F1,SP
      BITB  $F3F4,SP
      BITB  [$F4F5,SP]
      BITB  A,SP
      BITB  B,SP
      BITB  D,SP
      BITB  [D,SP]
      BITB  $3E85,PC
      BITB  <$3D8F,PC
      BITB  $398F,PC
      BITB  >$3C97,PC
      BITB  [$3A98,PC]
      BITB  A,PC
      BITB  B,PC
      BITB  D,PC
      BITB  [D,PC]
      BITB  0,X
      BITB  1,+X
      BITB  8,-X
      BITB  1,X+
      BITB  8,X-
      BITB  0,Y
      BITB  1,+Y
      BITB  8,-Y
      BITB  1,Y+
      BITB  8,Y-
      BITB  0,SP
      BITB  1,+SP
      BITB  8,-SP
      BITB  1,SP+
      BITB  8,SP-
      BITB  $3DC3,PC
      BITB  $E1,X
      BITB  $E3E4,X
      BITB  [$E4E5,X]
      BITB  A,X
      BITB  B,X
      LDAB  [D,X]
      LDAB  $E9,Y
      LDAB  $EBEC,Y
      LDAB  [$ECED,Y]
      LDAB  A,Y
      LDAB  B,Y
      LDAB  D,Y
      LDAB  [D,Y]
      LDAB  $F1,SP
      LDAB  $F3F4,SP
      LDAB  [$F4F5,SP]
      LDAB  A,SP
      LDAB  B,SP
      LDAB  D,SP
      LDAB  [D,SP]
      LDAB  $3EF6,PC
      LDAB  <$3E00,PC
      LDAB  $3A00,PC
      LDAB  >$3D08,PC
      LDAB  [$3B09,PC]
      LDAB  A,PC
      LDAB  B,PC
      LDAB  D,PC
      LDAB  [D,PC]
      LDAB  0,X
      LDAB  1,+X
      LDAB  8,-X
      LDAB  1,X+
      LDAB  8,X-
      LDAB  0,Y
      LDAB  1,+Y
      LDAB  8,-Y
      LDAB  1,Y+
      LDAB  8,Y-
      LDAB  0,SP
      LDAB  1,+SP
      LDAB  8,-SP
      LDAB  1,SP+
      LDAB  8,SP-
      LDAB  $3E34,PC
      LDAB  $E1,X
      LDAB  $E3E4,X
      LDAB  [$E4E5,X]
      LDAB  A,X
      LDAB  B,X
      LDAB  D,X
      TST   $E9,Y
      TST   $EBEC,Y
      TST   [$ECED,Y]
      TST   A,Y
      TST   B,Y
      TST   D,Y
      TST   [D,Y]
      TST   $F1,SP
      TST   $F3F4,SP
      TST   [$F4F5,SP]
      TST   A,SP
      TST   B,SP
      TST   D,SP
      TST   [D,SP]
      TST   $3F67,PC
      TST   <$3E71,PC
      TST   $3A71,PC
      TST   >$3D79,PC
      TST   [$3B7A,PC]
      TST   A,PC
      TST   B,PC
      TST   D,PC
      TST   [D,PC]
      TST   0,X
      TST   1,+X
      TST   8,-X
      TST   1,X+
      TST   8,X-
      TST   0,Y
      TST   1,+Y
      TST   8,-Y
      TST   1,Y+
      TST   8,Y-
      TST   0,SP
      TST   1,+SP
      TST   8,-SP
      TST   1,SP+
      TST   8,SP-
      TST   $3EA5,PC
      TST   $E1,X
      TST   $E3E4,X
      TST   [$E4E5,X]
      TST   A,X
      TST   B,X
      TST   D,X
      TST   [D,X]
      EORB  -22,Y
      EORB  $EBEC,Y
      EORB  [$ECED,Y]
      EORB  A,Y
      EORB  B,Y
      EORB  D,Y
      EORB  [D,Y]
      EORB  $F1,SP
      EORB  $F3F4,SP
      EORB  [$F4F5,SP]
      EORB  A,SP
      EORB  B,SP
      EORB  D,SP
      EORB  [D,SP]
      EORB  $3FDA,PC
      EORB  <$3EE4,PC
      EORB  $3AE4,PC
      EORB  >$3DEC,PC
      EORB  [$3BED,PC]
      EORB  A,PC
      EORB  B,PC
      EORB  D,PC
      EORB  [D,PC]
      EORB  0,X
      EORB  1,+X
      EORB  8,-X
      EORB  1,X+
      EORB  8,X-
      EORB  0,Y
      EORB  1,+Y
      EORB  8,-Y
      EORB  1,Y+
      EORB  8,Y-
      EORB  0,SP
      EORB  1,+SP
      EORB  8,-SP
      EORB  1,SP+
      EORB  8,SP-
      EORB  $3F18,PC
      EORB  $E1,X
      EORB  $E3E4,X
      EORB  [$E4E5,X]
      EORB  A,X
      EORB  B,X
      EORB  D,X
      EORB  [D,X]
      ADCB  $EBEC,Y
      ADCB  [$ECED,Y]
      ADCB  A,Y
      ADCB  B,Y
      ADCB  D,Y
      ADCB  [D,Y]
      ADCB  $F1,SP
      ADCB  $F3F4,SP
      ADCB  [$F4F5,SP]
      ADCB  A,SP
      ADCB  B,SP
      ADCB  D,SP
      ADCB  [D,SP]
      ADCB  $404A,PC
      ADCB  <$3F54,PC
      ADCB  $3B54,PC
      ADCB  >$3E5C,PC
      ADCB  [$3C5D,PC]
      ADCB  A,PC
      ADCB  B,PC
      ADCB  D,PC
      ADCB  [D,PC]
      ADCB  0,X
      ADCB  1,+X
      ADCB  8,-X
      ADCB  1,X+
      ADCB  8,X-
      ADCB  0,Y
      ADCB  1,+Y
      ADCB  8,-Y
      ADCB  1,Y+
      ADCB  8,Y-
      ADCB  0,SP
      ADCB  1,+SP
      ADCB  8,-SP
      ADCB  1,SP+
      ADCB  8,SP-
      ADCB  $3F88,PC
      ADCB  $E1,X
      ADCB  $E3E4,X
      ADCB  [$E4E5,X]
      ADCB  A,X
      ADCB  B,X
      ADCB  D,X
      ADCB  [D,X]
      ADCB  $E9,Y
      ORAB  [$ECED,Y]
      ORAB  A,Y
      ORAB  B,Y
      ORAB  D,Y
      ORAB  [D,Y]
      ORAB  $F1,SP
      ORAB  $F3F4,SP
      ORAB  [$F4F5,SP]
      ORAB  A,SP
      ORAB  B,SP
      ORAB  D,SP
      ORAB  [D,SP]
      ORAB  $40B9,PC
      ORAB  <$3FC3,PC
      ORAB  $3BC3,PC
      ORAB  >$3ECB,PC
      ORAB  [$3CCC,PC]
      ORAB  A,PC
      ORAB  B,PC
      ORAB  D,PC
      ORAB  [D,PC]
      ORAB  0,X
      ORAB  1,+X
      ORAB  8,-X
      ORAB  1,X+
      ORAB  8,X-
      ORAB  0,Y
      ORAB  1,+Y
      ORAB  8,-Y
      ORAB  1,Y+
      ORAB  8,Y-
      ORAB  0,SP
      ORAB  1,+SP
      ORAB  8,-SP
      ORAB  1,SP+
      ORAB  8,SP-
      ORAB  $3FF7,PC
      ORAB  $E1,X
      ORAB  $E3E4,X
      ORAB  [$E4E5,X]
      ORAB  A,X
      ORAB  B,X
      ORAB  D,X
      ORAB  [D,X]
      ORAB  $E9,Y
      ORAB  $EBEC,Y
      ADDB  A,Y
      ADDB  B,Y
      ADDB  D,Y
      ADDB  [D,Y]
      ADDB  $F1,SP
      ADDB  $F3F4,SP
      ADDB  [$F4F5,SP]
      ADDB  A,SP
      ADDB  B,SP
      ADDB  D,SP
      ADDB  [D,SP]
      ADDB  $4128,PC
      ADDB  <$4032,PC
      ADDB  $3C32,PC
      ADDB  >$3F3A,PC
      ADDB  [$3D3B,PC]
      ADDB  A,PC
      ADDB  B,PC
      ADDB  D,PC
      ADDB  [D,PC]
      ADDB  0,X
      ADDB  1,+X
      ADDB  8,-X
      ADDB  1,X+
      ADDB  8,X-
      ADDB  0,Y
      ADDB  1,+Y
      ADDB  8,-Y
      ADDB  1,Y+
      ADDB  8,Y-
      ADDB  0,SP
      ADDB  1,+SP
      ADDB  8,-SP
      ADDB  1,SP+
      ADDB  8,SP-
      ADDB  $4066,PC
      ADDB  $E1,X
      ADDB  $E3E4,X
      ADDB  [$E4E5,X]
      ADDB  A,X
      ADDB  B,X
      ADDB  D,X
      ADDB  [D,X]
      ADDB  $E9,Y
      ADDB  $EBEC,Y
      ADDB  [$ECED,Y]
      LDD   B,Y
      LDD   D,Y
      LDD   [D,Y]
      LDD   $F1,SP
      LDD   $F3F4,SP
      LDD   [$F4F5,SP]
      LDD   A,SP
      LDD   B,SP
      LDD   D,SP
      LDD   [D,SP]
      LDD   $4199,PC
      LDD   <$40A3,PC
      LDD   $3CA3,PC
      LDD   >$3FAB,PC
      LDD   [$3DAC,PC]
      LDD   A,PC
      LDD   B,PC
      LDD   D,PC
      LDD   [D,PC]
      LDD   0,X
      LDD   1,+X
      LDD   8,-X
      LDD   1,X+
      LDD   8,X-
      LDD   0,Y
      LDD   1,+Y
      LDD   8,-Y
      LDD   1,Y+
      LDD   8,Y-
      LDD   0,SP
      LDD   1,+SP
      LDD   8,-SP
      LDD   1,SP+
      LDD   8,SP-
      LDD   $40D7,PC
      LDD   $E1,X
      LDD   $E3E4,X
      LDD   [$E4E5,X]
      LDD   A,X
      LDD   B,X
      LDD   D,X
      LDD   [D,X]
      LDD   $E9,Y
      LDD   $EBEC,Y
      LDD   [$ECED,Y]
      LDD   A,Y
      LDY   D,Y
      LDY   [D,Y]
      LDY   $F1,SP
      LDY   $F3F4,SP
      LDY   [$F4F5,SP]
      LDY   A,SP
      LDY   B,SP
      LDY   D,SP
      LDY   [D,SP]
      LDY   $420A,PC
      LDY   <$4114,PC
      LDY   $3D14,PC
      LDY   >$401C,PC
      LDY   [$3E1D,PC]
      LDY   A,PC
      LDY   B,PC
      LDY   D,PC
      LDY   [D,PC]
      LDY   0,X
      LDY   1,+X
      LDY   8,-X
      LDY   1,X+
      LDY   8,X-
      LDY   0,Y
      LDY   1,+Y
      LDY   8,-Y
      LDY   1,Y+
      LDY   8,Y-
      LDY   0,SP
      LDY   1,+SP
      LDY   8,-SP
      LDY   1,SP+
      LDY   8,SP-
      LDY   $4148,PC
      LDY   $E1,X
      LDY   $E3E4,X
      LDY   [$E4E5,X]
      LDY   A,X
      LDY   B,X
      LDY   D,X
      LDY   [D,X]
      LDY   $E9,Y
      LDY   $EBEC,Y
      LDY   [$ECED,Y]
      LDY   A,Y
      LDY   B,Y
      LDX   [D,Y]
      LDX   $F1,SP
      LDX   $F3F4,SP
      LDX   [$F4F5,SP]
      LDX   A,SP
      LDX   B,SP
      LDX   D,SP
      LDX   [D,SP]
      LDX   $427B,PC
      LDX   <$4185,PC
      LDX   $3D85,PC
      LDX   >$408D,PC
      LDX   [$3E8E,PC]
      LDX   A,PC
      LDX   B,PC
      LDX   D,PC
      LDX   [D,PC]
      LDX   0,X
      LDX   1,+X
      LDX   8,-X
      LDX   1,X+
      LDX   8,X-
      LDX   0,Y
      LDX   1,+Y
      LDX   8,-Y
      LDX   1,Y+
      LDX   8,Y-
      LDX   0,SP
      LDX   1,+SP
      LDX   8,-SP
      LDX   1,SP+
      LDX   8,SP-
      LDX   $41B9,PC
      LDX   $E1,X
      LDX   $E3E4,X
      LDX   [$E4E5,X]
      LDX   A,X
      LDX   B,X
      LDX   D,X
      LDX   [D,X]
      LDX   $E9,Y
      LDX   $EBEC,Y
      LDX   [$ECED,Y]
      LDX   A,Y
      LDX   B,Y
      LDX   D,Y
      LDS   $F1,SP
      LDS   $F3F4,SP
      LDS   [$F4F5,SP]
      LDS   A,SP
      LDS   B,SP
      LDS   D,SP
      LDS   [D,SP]
      LDS   $42EC,PC
      LDS   <$41F6,PC
      LDS   $3DF6,PC
      LDS   >$40FE,PC
      LDS   [$3EFF,PC]
      LDS   A,PC
      LDS   B,PC
      LDS   D,PC
      LDS   [D,PC]
      LDS   0,X
      LDS   1,+X
      LDS   8,-X
      LDS   1,X+
      LDS   8,X-
      LDS   0,Y
      LDS   1,+Y
      LDS   8,-Y
      LDS   1,Y+
      LDS   8,Y-
      LDS   0,SP
      LDS   1,+SP
      LDS   8,-SP
      LDS   1,SP+
      LDS   8,SP-
      LDS   $422A,PC
      LDS   $E1,X
      LDS   $E3E4,X
      LDS   [$E4E5,X]
      LDS   A,X
      LDS   B,X
      LDS   D,X
      LDS   [D,X]
      LDS   $E9,Y
      LDS   $EBEC,Y
      LDS   [$ECED,Y]
      LDS   A,Y
      LDS   B,Y
      LDS   D,Y
      LDS   [D,Y]
      SUBB  $F1F2
      SUBB  >$0001
      CMPB  $F2F3
      CMPB  >$0001
      SBCB  $F3F4
      SBCB  >$0001
      ADDD  $F4F5
      ADDD  >$0001
      ANDB  $F5F6
      ANDB  >$0001
      BITB  $F6F7
      BITB  >$0001
      LDAB  $F7F8
      LDAB  >$0001
      TST   $F8F9
      TST   >$0001
      EORB  $F9FA
      EORB  >$0001
      ADCB  $FAFB
      ADCB  >$0001
      ORAB  $FBFC
      ORAB  >$0001
      ADDB  $FCFD
      ADDB  >$0001
      LDD   $FDFE
      LDD   >$0001
      LDY   $FEFF
      LDY   >$0001
      LDX   $FF00
      LDX   >$0001
      LDS   >$0001
      LDS   $0102
