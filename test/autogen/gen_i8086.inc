;;; AUTO GENERATED FILE
;;; generated by: gen_i8086 -i -u -C 8086 -o gen_i8086.inc -l gen_i8086.lst
      ADD     [BX+DI], AL
      ADD     [BP+SI], AL
      ADD     [SI], AL
      ADD     [0807H], AL
      ADD     [BX], AL
      ADD     [BX+SI], AH
      ADD     [BP+SI], AH
      ADD     [SI], AH
      ADD     [2827H], AH
      ADD     [BX], AH
      ADD     [BX+SI+65], AL
      ADD     [BP+SI+67], AL
      ADD     [SI+69], AL
      ADD     [BP+71], AL
      ADD     [BX+72], AL
      ADD     [BX+SI+97], AH
      ADD     [BP+SI+99], AH
      ADD     [SI+101], AH
      ADD     [BP+103], AH
      ADD     [BX+104], AH
      ADD     [BX+SI+8281H], AL
      ADD     [BP+SI+8483H], AL
      ADD     [SI+8685H], AL
      ADD     [BP+8887H], AL
      ADD     [BX+8988H], AL
      ADD     [BX+SI+0A2A1H], AH
      ADD     [BP+SI+0A4A3H], AH
      ADD     [SI+0A6A5H], AH
      ADD     [BP+0A8A7H], AH
      ADD     [BX+0A9A8H], AH
      ADD     AL, AL
      ADD     AH, AL
      ADD     AL, AH
      ADD     AH, AH
      ADD     [BP+SI], AX
      ADD     [SI], AX
      ADD     [0807H], AX
      ADD     [BX], AX
      ADD     [BX+SI], CX
      ADD     [BP+SI], CX
      ADD     [SI], CX
      ADD     [100FH], CX
      ADD     [BX], CX
      ADD     [BX+SI], SP
      ADD     [BP+SI], SP
      ADD     [SI], SP
      ADD     [2827H], SP
      ADD     [BX], SP
      ADD     [BX+SI], SI
      ADD     [BP+SI], SI
      ADD     [SI], SI
      ADD     [3837H], SI
      ADD     [BX], SI
      ADD     [BX+SI+65], AX
      ADD     [BP+SI+67], AX
      ADD     [SI+69], AX
      ADD     [BP+71], AX
      ADD     [BX+72], AX
      ADD     [BX+SI+73], CX
      ADD     [BP+SI+75], CX
      ADD     [SI+77], CX
      ADD     [BP+79], CX
      ADD     [BX+80], CX
      ADD     [BX+SI+97], SP
      ADD     [BP+SI+99], SP
      ADD     [SI+101], SP
      ADD     [BP+103], SP
      ADD     [BX+104], SP
      ADD     [BX+SI+113], SI
      ADD     [BP+SI+115], SI
      ADD     [SI+117], SI
      ADD     [BP+119], SI
      ADD     [BX+120], SI
      ADD     [BX+SI+8281H], AX
      ADD     [BP+SI+8483H], AX
      ADD     [SI+8685H], AX
      ADD     [BP+8887H], AX
      ADD     [BX+8988H], AX
      ADD     [BX+SI+8A89H], CX
      ADD     [BP+SI+8C8BH], CX
      ADD     [SI+8E8DH], CX
      ADD     [BP+908FH], CX
      ADD     [BX+9190H], CX
      ADD     [BX+SI+0A2A1H], SP
      ADD     [BP+SI+0A4A3H], SP
      ADD     [SI+0A6A5H], SP
      ADD     [BP+0A8A7H], SP
      ADD     [BX+0A9A8H], SP
      ADD     [BX+SI+0B2B1H], SI
      ADD     [BP+SI+0B4B3H], SI
      ADD     [SI+0B6B5H], SI
      ADD     [BP+0B8B7H], SI
      ADD     [BX+0B9B8H], SI
      ADD     AX, AX
      ADD     CX, AX
      ADD     SP, AX
      ADD     SI, AX
      ADD     AX, CX
      ADD     CX, CX
      ADD     SP, CX
      ADD     SI, CX
      ADD     AX, SP
      ADD     CX, SP
      ADD     SP, SP
      ADD     SI, SP
      ADD     AX, SI
      ADD     CX, SI
      ADD     SP, SI
      ADD     SI, SI
      ADD     [BX+SI], AX
      ADD     AL, [BP+DI]
      ADD     AL, [SI]
      ADD     AL, [0807H]
      ADD     AL, [BX]
      ADD     CL, [BX+SI]
      ADD     AH, [BX+SI]
      ADD     AH, [BP+SI]
      ADD     AH, [SI]
      ADD     AH, [2827H]
      ADD     AH, [BX]
      ADD     AL, [BX+SI+65]
      ADD     AL, [BP+SI+67]
      ADD     AL, [SI+69]
      ADD     AL, [BP+71]
      ADD     AL, [BX+72]
      ADD     AH, [BX+SI+97]
      ADD     AH, [BP+SI+99]
      ADD     AH, [SI+101]
      ADD     AH, [BP+103]
      ADD     AH, [BX+104]
      ADD     AL, [BX+SI+8281H]
      ADD     AL, [BP+SI+8483H]
      ADD     AL, [SI+8685H]
      ADD     AL, [BP+8887H]
      ADD     AL, [BX+8988H]
      ADD     AH, [BX+SI+0A2A1H]
      ADD     AH, [BP+SI+0A4A3H]
      ADD     AH, [SI+0A6A5H]
      ADD     AH, [BP+0A8A7H]
      ADD     AH, [BX+0A9A8H]
      ADD     AX, [SI]
      ADD     AX, [0807H]
      ADD     AX, [BX]
      ADD     CX, [BX+SI]
      ADD     CX, [BP+SI]
      ADD     CX, [SI]
      ADD     CX, [100FH]
      ADD     CX, [BX]
      ADD     SP, [BX+SI]
      ADD     SP, [BP+SI]
      ADD     SP, [SI]
      ADD     SP, [2827H]
      ADD     SP, [BX]
      ADD     SI, [BX+SI]
      ADD     SI, [BP+SI]
      ADD     SI, [SI]
      ADD     SI, [3837H]
      ADD     SI, [BX]
      ADD     AX, [BX+SI+65]
      ADD     AX, [BP+SI+67]
      ADD     AX, [SI+69]
      ADD     AX, [BP+71]
      ADD     AX, [BX+72]
      ADD     CX, [BX+SI+73]
      ADD     CX, [BP+SI+75]
      ADD     CX, [SI+77]
      ADD     CX, [BP+79]
      ADD     CX, [BX+80]
      ADD     SP, [BX+SI+97]
      ADD     SP, [BP+SI+99]
      ADD     SP, [SI+101]
      ADD     SP, [BP+103]
      ADD     SP, [BX+104]
      ADD     SI, [BX+SI+113]
      ADD     SI, [BP+SI+115]
      ADD     SI, [SI+117]
      ADD     SI, [BP+119]
      ADD     SI, [BX+120]
      ADD     AX, [BX+SI+8281H]
      ADD     AX, [BP+SI+8483H]
      ADD     AX, [SI+8685H]
      ADD     AX, [BP+8887H]
      ADD     AX, [BX+8988H]
      ADD     CX, [BX+SI+8A89H]
      ADD     CX, [BP+SI+8C8BH]
      ADD     CX, [SI+8E8DH]
      ADD     CX, [BP+908FH]
      ADD     CX, [BX+9190H]
      ADD     SP, [BX+SI+0A2A1H]
      ADD     SP, [BP+SI+0A4A3H]
      ADD     SP, [SI+0A6A5H]
      ADD     SP, [BP+0A8A7H]
      ADD     SP, [BX+0A9A8H]
      ADD     SI, [BX+SI+0B2B1H]
      ADD     SI, [BP+SI+0B4B3H]
      ADD     SI, [SI+0B6B5H]
      ADD     SI, [BP+0B8B7H]
      ADD     SI, [BX+0B9B8H]
      ADD     AX, [BX+SI]
      ADD     AX, [BP+SI]
      ADD     AX, 0706H
      PUSH    ES
      POP     ES
      OR      [BX+DI], CL
      OR      [BP+SI], CL
      OR      [SI], CL
      OR      [100FH], CL
      OR      [BX], CL
      OR      [BX+SI], AH
      OR      [BP+SI], AH
      OR      [SI], AH
      OR      [2827H], AH
      OR      [BX], AH
      OR      [BX+SI+65], AL
      OR      [BP+SI+67], AL
      OR      [SI+69], AL
      OR      [BP+71], AL
      OR      [BX+72], AL
      OR      [BX+SI+97], AH
      OR      [BP+SI+99], AH
      OR      [SI+101], AH
      OR      [BP+103], AH
      OR      [BX+104], AH
      OR      [BX+SI+8281H], AL
      OR      [BP+SI+8483H], AL
      OR      [SI+8685H], AL
      OR      [BP+8887H], AL
      OR      [BX+8988H], AL
      OR      [BX+SI+0A2A1H], AH
      OR      [BP+SI+0A4A3H], AH
      OR      [SI+0A6A5H], AH
      OR      [BP+0A8A7H], AH
      OR      [BX+0A9A8H], AH
      OR      AL, AL
      OR      AH, AL
      OR      AL, AH
      OR      AH, AH
      OR      [BP+SI], CX
      OR      [SI], CX
      OR      [100FH], CX
      OR      [BX], CX
      OR      [BX+SI], DX
      OR      [BX+SI], SP
      OR      [BP+SI], SP
      OR      [SI], SP
      OR      [2827H], SP
      OR      [BX], SP
      OR      [BX+SI], SI
      OR      [BP+SI], SI
      OR      [SI], SI
      OR      [3837H], SI
      OR      [BX], SI
      OR      [BX+SI+65], AX
      OR      [BP+SI+67], AX
      OR      [SI+69], AX
      OR      [BP+71], AX
      OR      [BX+72], AX
      OR      [BX+SI+73], CX
      OR      [BP+SI+75], CX
      OR      [SI+77], CX
      OR      [BP+79], CX
      OR      [BX+80], CX
      OR      [BX+SI+97], SP
      OR      [BP+SI+99], SP
      OR      [SI+101], SP
      OR      [BP+103], SP
      OR      [BX+104], SP
      OR      [BX+SI+113], SI
      OR      [BP+SI+115], SI
      OR      [SI+117], SI
      OR      [BP+119], SI
      OR      [BX+120], SI
      OR      [BX+SI+8281H], AX
      OR      [BP+SI+8483H], AX
      OR      [SI+8685H], AX
      OR      [BP+8887H], AX
      OR      [BX+8988H], AX
      OR      [BX+SI+8A89H], CX
      OR      [BP+SI+8C8BH], CX
      OR      [SI+8E8DH], CX
      OR      [BP+908FH], CX
      OR      [BX+9190H], CX
      OR      [BX+SI+0A2A1H], SP
      OR      [BP+SI+0A4A3H], SP
      OR      [SI+0A6A5H], SP
      OR      [BP+0A8A7H], SP
      OR      [BX+0A9A8H], SP
      OR      [BX+SI+0B2B1H], SI
      OR      [BP+SI+0B4B3H], SI
      OR      [SI+0B6B5H], SI
      OR      [BP+0B8B7H], SI
      OR      [BX+0B9B8H], SI
      OR      AX, AX
      OR      CX, AX
      OR      SP, AX
      OR      SI, AX
      OR      AX, CX
      OR      CX, CX
      OR      SP, CX
      OR      SI, CX
      OR      AX, SP
      OR      CX, SP
      OR      SP, SP
      OR      SI, SP
      OR      AX, SI
      OR      CX, SI
      OR      SP, SI
      OR      SI, SI
      OR      [BX+SI], AX
      OR      [BP+SI], AX
      OR      [SI], AX
      OR      [0807H], AX
      OR      [BX], AX
      OR      CL, [BP+DI]
      OR      CL, [SI]
      OR      CL, [100FH]
      OR      CL, [BX]
      OR      DL, [BX+SI]
      OR      AH, [BX+SI]
      OR      AH, [BP+SI]
      OR      AH, [SI]
      OR      AH, [2827H]
      OR      AH, [BX]
      OR      AL, [BX+SI+65]
      OR      AL, [BP+SI+67]
      OR      AL, [SI+69]
      OR      AL, [BP+71]
      OR      AL, [BX+72]
      OR      AH, [BX+SI+97]
      OR      AH, [BP+SI+99]
      OR      AH, [SI+101]
      OR      AH, [BP+103]
      OR      AH, [BX+104]
      OR      AL, [BX+SI+8281H]
      OR      AL, [BP+SI+8483H]
      OR      AL, [SI+8685H]
      OR      AL, [BP+8887H]
      OR      AL, [BX+8988H]
      OR      AH, [BX+SI+0A2A1H]
      OR      AH, [BP+SI+0A4A3H]
      OR      AH, [SI+0A6A5H]
      OR      AH, [BP+0A8A7H]
      OR      AH, [BX+0A9A8H]
      OR      CX, [SI]
      OR      CX, [100FH]
      OR      CX, [BX]
      OR      DX, [BX+SI]
      OR      DX, [BP+SI]
      OR      SP, [BX+SI]
      OR      SP, [BP+SI]
      OR      SP, [SI]
      OR      SP, [2827H]
      OR      SP, [BX]
      OR      SI, [BX+SI]
      OR      SI, [BP+SI]
      OR      SI, [SI]
      OR      SI, [3837H]
      OR      SI, [BX]
      OR      AX, [BX+SI+65]
      OR      AX, [BP+SI+67]
      OR      AX, [SI+69]
      OR      AX, [BP+71]
      OR      AX, [BX+72]
      OR      CX, [BX+SI+73]
      OR      CX, [BP+SI+75]
      OR      CX, [SI+77]
      OR      CX, [BP+79]
      OR      CX, [BX+80]
      OR      SP, [BX+SI+97]
      OR      SP, [BP+SI+99]
      OR      SP, [SI+101]
      OR      SP, [BP+103]
      OR      SP, [BX+104]
      OR      SI, [BX+SI+113]
      OR      SI, [BP+SI+115]
      OR      SI, [SI+117]
      OR      SI, [BP+119]
      OR      SI, [BX+120]
      OR      AX, [BX+SI+8281H]
      OR      AX, [BP+SI+8483H]
      OR      AX, [SI+8685H]
      OR      AX, [BP+8887H]
      OR      AX, [BX+8988H]
      OR      CX, [BX+SI+8A89H]
      OR      CX, [BP+SI+8C8BH]
      OR      CX, [SI+8E8DH]
      OR      CX, [BP+908FH]
      OR      CX, [BX+9190H]
      OR      SP, [BX+SI+0A2A1H]
      OR      SP, [BP+SI+0A4A3H]
      OR      SP, [SI+0A6A5H]
      OR      SP, [BP+0A8A7H]
      OR      SP, [BX+0A9A8H]
      OR      SI, [BX+SI+0B2B1H]
      OR      SI, [BP+SI+0B4B3H]
      OR      SI, [SI+0B6B5H]
      OR      SI, [BP+0B8B7H]
      OR      SI, [BX+0B9B8H]
      OR      AX, [BX+SI]
      OR      AX, [BP+SI]
      OR      AX, [SI]
      OR      AX, [0807H]
      OR      AX, [BX]
      OR      AX, 0F0EH
      PUSH    CS
      ADC     [BX+DI], DL
      ADC     [BP+SI], DL
      ADC     [SI], DL
      ADC     [1817H], DL
      ADC     [BX], DL
      ADC     [BX+SI], AH
      ADC     [BP+SI], AH
      ADC     [SI], AH
      ADC     [2827H], AH
      ADC     [BX], AH
      ADC     [BX+SI+65], AL
      ADC     [BP+SI+67], AL
      ADC     [SI+69], AL
      ADC     [BP+71], AL
      ADC     [BX+72], AL
      ADC     [BX+SI+97], AH
      ADC     [BP+SI+99], AH
      ADC     [SI+101], AH
      ADC     [BP+103], AH
      ADC     [BX+104], AH
      ADC     [BX+SI+8281H], AL
      ADC     [BP+SI+8483H], AL
      ADC     [SI+8685H], AL
      ADC     [BP+8887H], AL
      ADC     [BX+8988H], AL
      ADC     [BX+SI+0A2A1H], AH
      ADC     [BP+SI+0A4A3H], AH
      ADC     [SI+0A6A5H], AH
      ADC     [BP+0A8A7H], AH
      ADC     [BX+0A9A8H], AH
      ADC     AL, AL
      ADC     AH, AL
      ADC     AL, AH
      ADC     AH, AH
      ADC     [BP+SI], DX
      ADC     [SI], DX
      ADC     [1817H], DX
      ADC     [BX], DX
      ADC     [BX+SI], BX
      ADC     [BX+SI], SP
      ADC     [BP+SI], SP
      ADC     [SI], SP
      ADC     [2827H], SP
      ADC     [BX], SP
      ADC     [BX+SI], SI
      ADC     [BP+SI], SI
      ADC     [SI], SI
      ADC     [3837H], SI
      ADC     [BX], SI
      ADC     [BX+SI+65], AX
      ADC     [BP+SI+67], AX
      ADC     [SI+69], AX
      ADC     [BP+71], AX
      ADC     [BX+72], AX
      ADC     [BX+SI+73], CX
      ADC     [BP+SI+75], CX
      ADC     [SI+77], CX
      ADC     [BP+79], CX
      ADC     [BX+80], CX
      ADC     [BX+SI+97], SP
      ADC     [BP+SI+99], SP
      ADC     [SI+101], SP
      ADC     [BP+103], SP
      ADC     [BX+104], SP
      ADC     [BX+SI+113], SI
      ADC     [BP+SI+115], SI
      ADC     [SI+117], SI
      ADC     [BP+119], SI
      ADC     [BX+120], SI
      ADC     [BX+SI+8281H], AX
      ADC     [BP+SI+8483H], AX
      ADC     [SI+8685H], AX
      ADC     [BP+8887H], AX
      ADC     [BX+8988H], AX
      ADC     [BX+SI+8A89H], CX
      ADC     [BP+SI+8C8BH], CX
      ADC     [SI+8E8DH], CX
      ADC     [BP+908FH], CX
      ADC     [BX+9190H], CX
      ADC     [BX+SI+0A2A1H], SP
      ADC     [BP+SI+0A4A3H], SP
      ADC     [SI+0A6A5H], SP
      ADC     [BP+0A8A7H], SP
      ADC     [BX+0A9A8H], SP
      ADC     [BX+SI+0B2B1H], SI
      ADC     [BP+SI+0B4B3H], SI
      ADC     [SI+0B6B5H], SI
      ADC     [BP+0B8B7H], SI
      ADC     [BX+0B9B8H], SI
      ADC     AX, AX
      ADC     CX, AX
      ADC     SP, AX
      ADC     SI, AX
      ADC     AX, CX
      ADC     CX, CX
      ADC     SP, CX
      ADC     SI, CX
      ADC     AX, SP
      ADC     CX, SP
      ADC     SP, SP
      ADC     SI, SP
      ADC     AX, SI
      ADC     CX, SI
      ADC     SP, SI
      ADC     SI, SI
      ADC     [BX+SI], AX
      ADC     [BP+SI], AX
      ADC     [SI], AX
      ADC     [0807H], AX
      ADC     [BX], AX
      ADC     DL, [BP+DI]
      ADC     DL, [SI]
      ADC     DL, [1817H]
      ADC     DL, [BX]
      ADC     BL, [BX+SI]
      ADC     AH, [BX+SI]
      ADC     AH, [BP+SI]
      ADC     AH, [SI]
      ADC     AH, [2827H]
      ADC     AH, [BX]
      ADC     AL, [BX+SI+65]
      ADC     AL, [BP+SI+67]
      ADC     AL, [SI+69]
      ADC     AL, [BP+71]
      ADC     AL, [BX+72]
      ADC     AH, [BX+SI+97]
      ADC     AH, [BP+SI+99]
      ADC     AH, [SI+101]
      ADC     AH, [BP+103]
      ADC     AH, [BX+104]
      ADC     AL, [BX+SI+8281H]
      ADC     AL, [BP+SI+8483H]
      ADC     AL, [SI+8685H]
      ADC     AL, [BP+8887H]
      ADC     AL, [BX+8988H]
      ADC     AH, [BX+SI+0A2A1H]
      ADC     AH, [BP+SI+0A4A3H]
      ADC     AH, [SI+0A6A5H]
      ADC     AH, [BP+0A8A7H]
      ADC     AH, [BX+0A9A8H]
      ADC     DX, [SI]
      ADC     DX, [1817H]
      ADC     DX, [BX]
      ADC     BX, [BX+SI]
      ADC     BX, [BP+SI]
      ADC     SP, [BX+SI]
      ADC     SP, [BP+SI]
      ADC     SP, [SI]
      ADC     SP, [2827H]
      ADC     SP, [BX]
      ADC     SI, [BX+SI]
      ADC     SI, [BP+SI]
      ADC     SI, [SI]
      ADC     SI, [3837H]
      ADC     SI, [BX]
      ADC     AX, [BX+SI+65]
      ADC     AX, [BP+SI+67]
      ADC     AX, [SI+69]
      ADC     AX, [BP+71]
      ADC     AX, [BX+72]
      ADC     CX, [BX+SI+73]
      ADC     CX, [BP+SI+75]
      ADC     CX, [SI+77]
      ADC     CX, [BP+79]
      ADC     CX, [BX+80]
      ADC     SP, [BX+SI+97]
      ADC     SP, [BP+SI+99]
      ADC     SP, [SI+101]
      ADC     SP, [BP+103]
      ADC     SP, [BX+104]
      ADC     SI, [BX+SI+113]
      ADC     SI, [BP+SI+115]
      ADC     SI, [SI+117]
      ADC     SI, [BP+119]
      ADC     SI, [BX+120]
      ADC     AX, [BX+SI+8281H]
      ADC     AX, [BP+SI+8483H]
      ADC     AX, [SI+8685H]
      ADC     AX, [BP+8887H]
      ADC     AX, [BX+8988H]
      ADC     CX, [BX+SI+8A89H]
      ADC     CX, [BP+SI+8C8BH]
      ADC     CX, [SI+8E8DH]
      ADC     CX, [BP+908FH]
      ADC     CX, [BX+9190H]
      ADC     SP, [BX+SI+0A2A1H]
      ADC     SP, [BP+SI+0A4A3H]
      ADC     SP, [SI+0A6A5H]
      ADC     SP, [BP+0A8A7H]
      ADC     SP, [BX+0A9A8H]
      ADC     SI, [BX+SI+0B2B1H]
      ADC     SI, [BP+SI+0B4B3H]
      ADC     SI, [SI+0B6B5H]
      ADC     SI, [BP+0B8B7H]
      ADC     SI, [BX+0B9B8H]
      ADC     AX, [BX+SI]
      ADC     AX, [BP+SI]
      ADC     AX, [SI]
      ADC     AX, [0807H]
      ADC     AX, [BX]
      ADC     AX, 1716H
      PUSH    SS
      POP     SS
      SBB     [BX+DI], BL
      SBB     [BP+SI], BL
      SBB     [SI], BL
      SBB     [201FH], BL
      SBB     [BX], BL
      SBB     [BX+SI], AH
      SBB     [BP+SI], AH
      SBB     [SI], AH
      SBB     [2827H], AH
      SBB     [BX], AH
      SBB     [BX+SI+65], AL
      SBB     [BP+SI+67], AL
      SBB     [SI+69], AL
      SBB     [BP+71], AL
      SBB     [BX+72], AL
      SBB     [BX+SI+97], AH
      SBB     [BP+SI+99], AH
      SBB     [SI+101], AH
      SBB     [BP+103], AH
      SBB     [BX+104], AH
      SBB     [BX+SI+8281H], AL
      SBB     [BP+SI+8483H], AL
      SBB     [SI+8685H], AL
      SBB     [BP+8887H], AL
      SBB     [BX+8988H], AL
      SBB     [BX+SI+0A2A1H], AH
      SBB     [BP+SI+0A4A3H], AH
      SBB     [SI+0A6A5H], AH
      SBB     [BP+0A8A7H], AH
      SBB     [BX+0A9A8H], AH
      SBB     AL, AL
      SBB     AH, AL
      SBB     AL, AH
      SBB     AH, AH
      SBB     [BP+SI], BX
      SBB     [SI], BX
      SBB     [201FH], BX
      SBB     [BX], BX
      SBB     [BX+SI], SP
      SBB     [BP+SI], SP
      SBB     [SI], SP
      SBB     [2827H], SP
      SBB     [BX], SP
      SBB     [BX+SI], SI
      SBB     [BP+SI], SI
      SBB     [SI], SI
      SBB     [3837H], SI
      SBB     [BX], SI
      SBB     [BX+SI+65], AX
      SBB     [BP+SI+67], AX
      SBB     [SI+69], AX
      SBB     [BP+71], AX
      SBB     [BX+72], AX
      SBB     [BX+SI+73], CX
      SBB     [BP+SI+75], CX
      SBB     [SI+77], CX
      SBB     [BP+79], CX
      SBB     [BX+80], CX
      SBB     [BX+SI+97], SP
      SBB     [BP+SI+99], SP
      SBB     [SI+101], SP
      SBB     [BP+103], SP
      SBB     [BX+104], SP
      SBB     [BX+SI+113], SI
      SBB     [BP+SI+115], SI
      SBB     [SI+117], SI
      SBB     [BP+119], SI
      SBB     [BX+120], SI
      SBB     [BX+SI+8281H], AX
      SBB     [BP+SI+8483H], AX
      SBB     [SI+8685H], AX
      SBB     [BP+8887H], AX
      SBB     [BX+8988H], AX
      SBB     [BX+SI+8A89H], CX
      SBB     [BP+SI+8C8BH], CX
      SBB     [SI+8E8DH], CX
      SBB     [BP+908FH], CX
      SBB     [BX+9190H], CX
      SBB     [BX+SI+0A2A1H], SP
      SBB     [BP+SI+0A4A3H], SP
      SBB     [SI+0A6A5H], SP
      SBB     [BP+0A8A7H], SP
      SBB     [BX+0A9A8H], SP
      SBB     [BX+SI+0B2B1H], SI
      SBB     [BP+SI+0B4B3H], SI
      SBB     [SI+0B6B5H], SI
      SBB     [BP+0B8B7H], SI
      SBB     [BX+0B9B8H], SI
      SBB     AX, AX
      SBB     CX, AX
      SBB     SP, AX
      SBB     SI, AX
      SBB     AX, CX
      SBB     CX, CX
      SBB     SP, CX
      SBB     SI, CX
      SBB     AX, SP
      SBB     CX, SP
      SBB     SP, SP
      SBB     SI, SP
      SBB     AX, SI
      SBB     CX, SI
      SBB     SP, SI
      SBB     SI, SI
      SBB     [BX+SI], AX
      SBB     [BP+SI], AX
      SBB     [SI], AX
      SBB     [0807H], AX
      SBB     [BX], AX
      SBB     [BX+SI], CX
      SBB     BL, [BP+DI]
      SBB     BL, [SI]
      SBB     BL, [201FH]
      SBB     BL, [BX]
      SBB     AH, [BX+SI]
      SBB     AH, [BP+SI]
      SBB     AH, [SI]
      SBB     AH, [2827H]
      SBB     AH, [BX]
      SBB     AL, [BX+SI+65]
      SBB     AL, [BP+SI+67]
      SBB     AL, [SI+69]
      SBB     AL, [BP+71]
      SBB     AL, [BX+72]
      SBB     AH, [BX+SI+97]
      SBB     AH, [BP+SI+99]
      SBB     AH, [SI+101]
      SBB     AH, [BP+103]
      SBB     AH, [BX+104]
      SBB     AL, [BX+SI+8281H]
      SBB     AL, [BP+SI+8483H]
      SBB     AL, [SI+8685H]
      SBB     AL, [BP+8887H]
      SBB     AL, [BX+8988H]
      SBB     AH, [BX+SI+0A2A1H]
      SBB     AH, [BP+SI+0A4A3H]
      SBB     AH, [SI+0A6A5H]
      SBB     AH, [BP+0A8A7H]
      SBB     AH, [BX+0A9A8H]
      SBB     AL, [BX+SI]
      SBB     BX, [SI]
      SBB     BX, [201FH]
      SBB     BX, [BX]
      SBB     SP, [BX+SI]
      SBB     SP, [BP+SI]
      SBB     SP, [SI]
      SBB     SP, [2827H]
      SBB     SP, [BX]
      SBB     SI, [BX+SI]
      SBB     SI, [BP+SI]
      SBB     SI, [SI]
      SBB     SI, [3837H]
      SBB     SI, [BX]
      SBB     AX, [BX+SI+65]
      SBB     AX, [BP+SI+67]
      SBB     AX, [SI+69]
      SBB     AX, [BP+71]
      SBB     AX, [BX+72]
      SBB     CX, [BX+SI+73]
      SBB     CX, [BP+SI+75]
      SBB     CX, [SI+77]
      SBB     CX, [BP+79]
      SBB     CX, [BX+80]
      SBB     SP, [BX+SI+97]
      SBB     SP, [BP+SI+99]
      SBB     SP, [SI+101]
      SBB     SP, [BP+103]
      SBB     SP, [BX+104]
      SBB     SI, [BX+SI+113]
      SBB     SI, [BP+SI+115]
      SBB     SI, [SI+117]
      SBB     SI, [BP+119]
      SBB     SI, [BX+120]
      SBB     AX, [BX+SI+8281H]
      SBB     AX, [BP+SI+8483H]
      SBB     AX, [SI+8685H]
      SBB     AX, [BP+8887H]
      SBB     AX, [BX+8988H]
      SBB     CX, [BX+SI+8A89H]
      SBB     CX, [BP+SI+8C8BH]
      SBB     CX, [SI+8E8DH]
      SBB     CX, [BP+908FH]
      SBB     CX, [BX+9190H]
      SBB     SP, [BX+SI+0A2A1H]
      SBB     SP, [BP+SI+0A4A3H]
      SBB     SP, [SI+0A6A5H]
      SBB     SP, [BP+0A8A7H]
      SBB     SP, [BX+0A9A8H]
      SBB     SI, [BX+SI+0B2B1H]
      SBB     SI, [BP+SI+0B4B3H]
      SBB     SI, [SI+0B6B5H]
      SBB     SI, [BP+0B8B7H]
      SBB     SI, [BX+0B9B8H]
      SBB     AX, [BX+SI]
      SBB     AX, [BP+SI]
      SBB     AX, [SI]
      SBB     AX, [0807H]
      SBB     AX, [BX]
      SBB     CX, [BX+SI]
      SBB     CX, [BP+SI]
      SBB     AX, 1F1EH
      PUSH    DS
      POP     DS
      AND     [BX+DI], AH
      AND     [BP+SI], AH
      AND     [SI], AH
      AND     [2827H], AH
      AND     [BX], AH
      AND     [BX+SI+65], AL
      AND     [BP+SI+67], AL
      AND     [SI+69], AL
      AND     [BP+71], AL
      AND     [BX+72], AL
      AND     [BX+SI+97], AH
      AND     [BP+SI+99], AH
      AND     [SI+101], AH
      AND     [BP+103], AH
      AND     [BX+104], AH
      AND     [BX+SI+8281H], AL
      AND     [BP+SI+8483H], AL
      AND     [SI+8685H], AL
      AND     [BP+8887H], AL
      AND     [BX+8988H], AL
      AND     [BX+SI+0A2A1H], AH
      AND     [BP+SI+0A4A3H], AH
      AND     [SI+0A6A5H], AH
      AND     [BP+0A8A7H], AH
      AND     [BX+0A9A8H], AH
      AND     AL, AL
      AND     AH, AL
      AND     AL, AH
      AND     AH, AH
      AND     [BX+SI], AL
      AND     [BP+SI], AL
      AND     [SI], AL
      AND     [0807H], AL
      AND     [BX], AL
      AND     [BP+SI], SP
      AND     [SI], SP
      AND     [2827H], SP
      AND     [BX], SP
      AND     [BX+SI], BP
      AND     [BX+SI], SI
      AND     [BP+SI], SI
      AND     [SI], SI
      AND     [3837H], SI
      AND     [BX], SI
      AND     [BX+SI+65], AX
      AND     [BP+SI+67], AX
      AND     [SI+69], AX
      AND     [BP+71], AX
      AND     [BX+72], AX
      AND     [BX+SI+73], CX
      AND     [BP+SI+75], CX
      AND     [SI+77], CX
      AND     [BP+79], CX
      AND     [BX+80], CX
      AND     [BX+SI+97], SP
      AND     [BP+SI+99], SP
      AND     [SI+101], SP
      AND     [BP+103], SP
      AND     [BX+104], SP
      AND     [BX+SI+113], SI
      AND     [BP+SI+115], SI
      AND     [SI+117], SI
      AND     [BP+119], SI
      AND     [BX+120], SI
      AND     [BX+SI+8281H], AX
      AND     [BP+SI+8483H], AX
      AND     [SI+8685H], AX
      AND     [BP+8887H], AX
      AND     [BX+8988H], AX
      AND     [BX+SI+8A89H], CX
      AND     [BP+SI+8C8BH], CX
      AND     [SI+8E8DH], CX
      AND     [BP+908FH], CX
      AND     [BX+9190H], CX
      AND     [BX+SI+0A2A1H], SP
      AND     [BP+SI+0A4A3H], SP
      AND     [SI+0A6A5H], SP
      AND     [BP+0A8A7H], SP
      AND     [BX+0A9A8H], SP
      AND     [BX+SI+0B2B1H], SI
      AND     [BP+SI+0B4B3H], SI
      AND     [SI+0B6B5H], SI
      AND     [BP+0B8B7H], SI
      AND     [BX+0B9B8H], SI
      AND     AX, AX
      AND     CX, AX
      AND     SP, AX
      AND     SI, AX
      AND     AX, CX
      AND     CX, CX
      AND     SP, CX
      AND     SI, CX
      AND     AX, SP
      AND     CX, SP
      AND     SP, SP
      AND     SI, SP
      AND     AX, SI
      AND     CX, SI
      AND     SP, SI
      AND     SI, SI
      AND     [BX+SI], AX
      AND     [BP+SI], AX
      AND     [SI], AX
      AND     [0807H], AX
      AND     [BX], AX
      AND     [BX+SI], CX
      AND     [BP+SI], CX
      AND     [SI], CX
      AND     [100FH], CX
      AND     [BX], CX
      AND     AH, [BP+DI]
      AND     AH, [SI]
      AND     AH, [2827H]
      AND     AH, [BX]
      AND     CH, [BX+SI]
      AND     AL, [BX+SI+65]
      AND     AL, [BP+SI+67]
      AND     AL, [SI+69]
      AND     AL, [BP+71]
      AND     AL, [BX+72]
      AND     AH, [BX+SI+97]
      AND     AH, [BP+SI+99]
      AND     AH, [SI+101]
      AND     AH, [BP+103]
      AND     AH, [BX+104]
      AND     AL, [BX+SI+8281H]
      AND     AL, [BP+SI+8483H]
      AND     AL, [SI+8685H]
      AND     AL, [BP+8887H]
      AND     AL, [BX+8988H]
      AND     AH, [BX+SI+0A2A1H]
      AND     AH, [BP+SI+0A4A3H]
      AND     AH, [SI+0A6A5H]
      AND     AH, [BP+0A8A7H]
      AND     AH, [BX+0A9A8H]
      AND     AL, [BX+SI]
      AND     AL, [BP+SI]
      AND     AL, [SI]
      AND     AL, [0807H]
      AND     AL, [BX]
      AND     SP, [SI]
      AND     SP, [2827H]
      AND     SP, [BX]
      AND     BP, [BX+SI]
      AND     BP, [BP+SI]
      AND     SI, [BX+SI]
      AND     SI, [BP+SI]
      AND     SI, [SI]
      AND     SI, [3837H]
      AND     SI, [BX]
      AND     AX, [BX+SI+65]
      AND     AX, [BP+SI+67]
      AND     AX, [SI+69]
      AND     AX, [BP+71]
      AND     AX, [BX+72]
      AND     CX, [BX+SI+73]
      AND     CX, [BP+SI+75]
      AND     CX, [SI+77]
      AND     CX, [BP+79]
      AND     CX, [BX+80]
      AND     SP, [BX+SI+97]
      AND     SP, [BP+SI+99]
      AND     SP, [SI+101]
      AND     SP, [BP+103]
      AND     SP, [BX+104]
      AND     SI, [BX+SI+113]
      AND     SI, [BP+SI+115]
      AND     SI, [SI+117]
      AND     SI, [BP+119]
      AND     SI, [BX+120]
      AND     AX, [BX+SI+8281H]
      AND     AX, [BP+SI+8483H]
      AND     AX, [SI+8685H]
      AND     AX, [BP+8887H]
      AND     AX, [BX+8988H]
      AND     CX, [BX+SI+8A89H]
      AND     CX, [BP+SI+8C8BH]
      AND     CX, [SI+8E8DH]
      AND     CX, [BP+908FH]
      AND     CX, [BX+9190H]
      AND     SP, [BX+SI+0A2A1H]
      AND     SP, [BP+SI+0A4A3H]
      AND     SP, [SI+0A6A5H]
      AND     SP, [BP+0A8A7H]
      AND     SP, [BX+0A9A8H]
      AND     SI, [BX+SI+0B2B1H]
      AND     SI, [BP+SI+0B4B3H]
      AND     SI, [SI+0B6B5H]
      AND     SI, [BP+0B8B7H]
      AND     SI, [BX+0B9B8H]
      AND     AX, [BX+SI]
      AND     AX, [BP+SI]
      AND     AX, [SI]
      AND     AX, [0807H]
      AND     AX, [BX]
      AND     CX, [BX+SI]
      AND     CX, [BP+SI]
      AND     CX, [SI]
      AND     CX, [100FH]
      AND     CX, [BX]
      AND     AX, 2726H
      SEGES
      DAA
      SUB     [BX+DI], CH
      SUB     [BP+SI], CH
      SUB     [SI], CH
      SUB     [302FH], CH
      SUB     [BX], CH
      SUB     [BX+SI+65], AL
      SUB     [BP+SI+67], AL
      SUB     [SI+69], AL
      SUB     [BP+71], AL
      SUB     [BX+72], AL
      SUB     [BX+SI+97], AH
      SUB     [BP+SI+99], AH
      SUB     [SI+101], AH
      SUB     [BP+103], AH
      SUB     [BX+104], AH
      SUB     [BX+SI+8281H], AL
      SUB     [BP+SI+8483H], AL
      SUB     [SI+8685H], AL
      SUB     [BP+8887H], AL
      SUB     [BX+8988H], AL
      SUB     [BX+SI+0A2A1H], AH
      SUB     [BP+SI+0A4A3H], AH
      SUB     [SI+0A6A5H], AH
      SUB     [BP+0A8A7H], AH
      SUB     [BX+0A9A8H], AH
      SUB     AL, AL
      SUB     AH, AL
      SUB     AL, AH
      SUB     AH, AH
      SUB     [BX+SI], AL
      SUB     [BP+SI], AL
      SUB     [SI], AL
      SUB     [0807H], AL
      SUB     [BX], AL
      SUB     [BP+SI], BP
      SUB     [SI], BP
      SUB     [302FH], BP
      SUB     [BX], BP
      SUB     [BX+SI], SI
      SUB     [BP+SI], SI
      SUB     [SI], SI
      SUB     [3837H], SI
      SUB     [BX], SI
      SUB     [BX+SI+65], AX
      SUB     [BP+SI+67], AX
      SUB     [SI+69], AX
      SUB     [BP+71], AX
      SUB     [BX+72], AX
      SUB     [BX+SI+73], CX
      SUB     [BP+SI+75], CX
      SUB     [SI+77], CX
      SUB     [BP+79], CX
      SUB     [BX+80], CX
      SUB     [BX+SI+97], SP
      SUB     [BP+SI+99], SP
      SUB     [SI+101], SP
      SUB     [BP+103], SP
      SUB     [BX+104], SP
      SUB     [BX+SI+113], SI
      SUB     [BP+SI+115], SI
      SUB     [SI+117], SI
      SUB     [BP+119], SI
      SUB     [BX+120], SI
      SUB     [BX+SI+8281H], AX
      SUB     [BP+SI+8483H], AX
      SUB     [SI+8685H], AX
      SUB     [BP+8887H], AX
      SUB     [BX+8988H], AX
      SUB     [BX+SI+8A89H], CX
      SUB     [BP+SI+8C8BH], CX
      SUB     [SI+8E8DH], CX
      SUB     [BP+908FH], CX
      SUB     [BX+9190H], CX
      SUB     [BX+SI+0A2A1H], SP
      SUB     [BP+SI+0A4A3H], SP
      SUB     [SI+0A6A5H], SP
      SUB     [BP+0A8A7H], SP
      SUB     [BX+0A9A8H], SP
      SUB     [BX+SI+0B2B1H], SI
      SUB     [BP+SI+0B4B3H], SI
      SUB     [SI+0B6B5H], SI
      SUB     [BP+0B8B7H], SI
      SUB     [BX+0B9B8H], SI
      SUB     AX, AX
      SUB     CX, AX
      SUB     SP, AX
      SUB     SI, AX
      SUB     AX, CX
      SUB     CX, CX
      SUB     SP, CX
      SUB     SI, CX
      SUB     AX, SP
      SUB     CX, SP
      SUB     SP, SP
      SUB     SI, SP
      SUB     AX, SI
      SUB     CX, SI
      SUB     SP, SI
      SUB     SI, SI
      SUB     [BX+SI], AX
      SUB     [BP+SI], AX
      SUB     [SI], AX
      SUB     [0807H], AX
      SUB     [BX], AX
      SUB     [BX+SI], CX
      SUB     [BP+SI], CX
      SUB     [SI], CX
      SUB     [100FH], CX
      SUB     [BX], CX
      SUB     [BX+SI], SP
      SUB     CH, [BP+DI]
      SUB     CH, [SI]
      SUB     CH, [302FH]
      SUB     CH, [BX]
      SUB     DH, [BX+SI]
      SUB     AL, [BX+SI+65]
      SUB     AL, [BP+SI+67]
      SUB     AL, [SI+69]
      SUB     AL, [BP+71]
      SUB     AL, [BX+72]
      SUB     AH, [BX+SI+97]
      SUB     AH, [BP+SI+99]
      SUB     AH, [SI+101]
      SUB     AH, [BP+103]
      SUB     AH, [BX+104]
      SUB     AL, [BX+SI+8281H]
      SUB     AL, [BP+SI+8483H]
      SUB     AL, [SI+8685H]
      SUB     AL, [BP+8887H]
      SUB     AL, [BX+8988H]
      SUB     AH, [BX+SI+0A2A1H]
      SUB     AH, [BP+SI+0A4A3H]
      SUB     AH, [SI+0A6A5H]
      SUB     AH, [BP+0A8A7H]
      SUB     AH, [BX+0A9A8H]
      SUB     AL, [BX+SI]
      SUB     AL, [BP+SI]
      SUB     AL, [SI]
      SUB     AL, [0807H]
      SUB     AL, [BX]
      SUB     BP, [SI]
      SUB     BP, [302FH]
      SUB     BP, [BX]
      SUB     SI, [BX+SI]
      SUB     SI, [BP+SI]
      SUB     SI, [SI]
      SUB     SI, [3837H]
      SUB     SI, [BX]
      SUB     AX, [BX+SI+65]
      SUB     AX, [BP+SI+67]
      SUB     AX, [SI+69]
      SUB     AX, [BP+71]
      SUB     AX, [BX+72]
      SUB     CX, [BX+SI+73]
      SUB     CX, [BP+SI+75]
      SUB     CX, [SI+77]
      SUB     CX, [BP+79]
      SUB     CX, [BX+80]
      SUB     SP, [BX+SI+97]
      SUB     SP, [BP+SI+99]
      SUB     SP, [SI+101]
      SUB     SP, [BP+103]
      SUB     SP, [BX+104]
      SUB     SI, [BX+SI+113]
      SUB     SI, [BP+SI+115]
      SUB     SI, [SI+117]
      SUB     SI, [BP+119]
      SUB     SI, [BX+120]
      SUB     AX, [BX+SI+8281H]
      SUB     AX, [BP+SI+8483H]
      SUB     AX, [SI+8685H]
      SUB     AX, [BP+8887H]
      SUB     AX, [BX+8988H]
      SUB     CX, [BX+SI+8A89H]
      SUB     CX, [BP+SI+8C8BH]
      SUB     CX, [SI+8E8DH]
      SUB     CX, [BP+908FH]
      SUB     CX, [BX+9190H]
      SUB     SP, [BX+SI+0A2A1H]
      SUB     SP, [BP+SI+0A4A3H]
      SUB     SP, [SI+0A6A5H]
      SUB     SP, [BP+0A8A7H]
      SUB     SP, [BX+0A9A8H]
      SUB     SI, [BX+SI+0B2B1H]
      SUB     SI, [BP+SI+0B4B3H]
      SUB     SI, [SI+0B6B5H]
      SUB     SI, [BP+0B8B7H]
      SUB     SI, [BX+0B9B8H]
      SUB     AX, [BX+SI]
      SUB     AX, [BP+SI]
      SUB     AX, [SI]
      SUB     AX, [0807H]
      SUB     AX, [BX]
      SUB     CX, [BX+SI]
      SUB     CX, [BP+SI]
      SUB     CX, [SI]
      SUB     CX, [100FH]
      SUB     CX, [BX]
      SUB     SP, [BX+SI]
      SUB     SP, [BP+SI]
      SUB     AX, 2F2EH
      SEGCS
      DAS
      XOR     [BX+DI], DH
      XOR     [BP+SI], DH
      XOR     [SI], DH
      XOR     [3837H], DH
      XOR     [BX], DH
      XOR     [BX+SI+65], AL
      XOR     [BP+SI+67], AL
      XOR     [SI+69], AL
      XOR     [BP+71], AL
      XOR     [BX+72], AL
      XOR     [BX+SI+97], AH
      XOR     [BP+SI+99], AH
      XOR     [SI+101], AH
      XOR     [BP+103], AH
      XOR     [BX+104], AH
      XOR     [BX+SI+8281H], AL
      XOR     [BP+SI+8483H], AL
      XOR     [SI+8685H], AL
      XOR     [BP+8887H], AL
      XOR     [BX+8988H], AL
      XOR     [BX+SI+0A2A1H], AH
      XOR     [BP+SI+0A4A3H], AH
      XOR     [SI+0A6A5H], AH
      XOR     [BP+0A8A7H], AH
      XOR     [BX+0A9A8H], AH
      XOR     AL, AL
      XOR     AH, AL
      XOR     AL, AH
      XOR     AH, AH
      XOR     [BX+SI], AL
      XOR     [BP+SI], AL
      XOR     [SI], AL
      XOR     [0807H], AL
      XOR     [BX], AL
      XOR     [BP+SI], SI
      XOR     [SI], SI
      XOR     [3837H], SI
      XOR     [BX], SI
      XOR     [BX+SI], DI
      XOR     [BX+SI+65], AX
      XOR     [BP+SI+67], AX
      XOR     [SI+69], AX
      XOR     [BP+71], AX
      XOR     [BX+72], AX
      XOR     [BX+SI+73], CX
      XOR     [BP+SI+75], CX
      XOR     [SI+77], CX
      XOR     [BP+79], CX
      XOR     [BX+80], CX
      XOR     [BX+SI+97], SP
      XOR     [BP+SI+99], SP
      XOR     [SI+101], SP
      XOR     [BP+103], SP
      XOR     [BX+104], SP
      XOR     [BX+SI+113], SI
      XOR     [BP+SI+115], SI
      XOR     [SI+117], SI
      XOR     [BP+119], SI
      XOR     [BX+120], SI
      XOR     [BX+SI+8281H], AX
      XOR     [BP+SI+8483H], AX
      XOR     [SI+8685H], AX
      XOR     [BP+8887H], AX
      XOR     [BX+8988H], AX
      XOR     [BX+SI+8A89H], CX
      XOR     [BP+SI+8C8BH], CX
      XOR     [SI+8E8DH], CX
      XOR     [BP+908FH], CX
      XOR     [BX+9190H], CX
      XOR     [BX+SI+0A2A1H], SP
      XOR     [BP+SI+0A4A3H], SP
      XOR     [SI+0A6A5H], SP
      XOR     [BP+0A8A7H], SP
      XOR     [BX+0A9A8H], SP
      XOR     [BX+SI+0B2B1H], SI
      XOR     [BP+SI+0B4B3H], SI
      XOR     [SI+0B6B5H], SI
      XOR     [BP+0B8B7H], SI
      XOR     [BX+0B9B8H], SI
      XOR     AX, AX
      XOR     CX, AX
      XOR     SP, AX
      XOR     SI, AX
      XOR     AX, CX
      XOR     CX, CX
      XOR     SP, CX
      XOR     SI, CX
      XOR     AX, SP
      XOR     CX, SP
      XOR     SP, SP
      XOR     SI, SP
      XOR     AX, SI
      XOR     CX, SI
      XOR     SP, SI
      XOR     SI, SI
      XOR     [BX+SI], AX
      XOR     [BP+SI], AX
      XOR     [SI], AX
      XOR     [0807H], AX
      XOR     [BX], AX
      XOR     [BX+SI], CX
      XOR     [BP+SI], CX
      XOR     [SI], CX
      XOR     [100FH], CX
      XOR     [BX], CX
      XOR     [BX+SI], SP
      XOR     [BP+SI], SP
      XOR     [SI], SP
      XOR     [2827H], SP
      XOR     [BX], SP
      XOR     DH, [BP+DI]
      XOR     DH, [SI]
      XOR     DH, [3837H]
      XOR     DH, [BX]
      XOR     BH, [BX+SI]
      XOR     AL, [BX+SI+65]
      XOR     AL, [BP+SI+67]
      XOR     AL, [SI+69]
      XOR     AL, [BP+71]
      XOR     AL, [BX+72]
      XOR     AH, [BX+SI+97]
      XOR     AH, [BP+SI+99]
      XOR     AH, [SI+101]
      XOR     AH, [BP+103]
      XOR     AH, [BX+104]
      XOR     AL, [BX+SI+8281H]
      XOR     AL, [BP+SI+8483H]
      XOR     AL, [SI+8685H]
      XOR     AL, [BP+8887H]
      XOR     AL, [BX+8988H]
      XOR     AH, [BX+SI+0A2A1H]
      XOR     AH, [BP+SI+0A4A3H]
      XOR     AH, [SI+0A6A5H]
      XOR     AH, [BP+0A8A7H]
      XOR     AH, [BX+0A9A8H]
      XOR     AL, [BX+SI]
      XOR     AL, [BP+SI]
      XOR     AL, [SI]
      XOR     AL, [0807H]
      XOR     AL, [BX]
      XOR     SI, [SI]
      XOR     SI, [3837H]
      XOR     SI, [BX]
      XOR     DI, [BX+SI]
      XOR     DI, [BP+SI]
      XOR     AX, [BX+SI+65]
      XOR     AX, [BP+SI+67]
      XOR     AX, [SI+69]
      XOR     AX, [BP+71]
      XOR     AX, [BX+72]
      XOR     CX, [BX+SI+73]
      XOR     CX, [BP+SI+75]
      XOR     CX, [SI+77]
      XOR     CX, [BP+79]
      XOR     CX, [BX+80]
      XOR     SP, [BX+SI+97]
      XOR     SP, [BP+SI+99]
      XOR     SP, [SI+101]
      XOR     SP, [BP+103]
      XOR     SP, [BX+104]
      XOR     SI, [BX+SI+113]
      XOR     SI, [BP+SI+115]
      XOR     SI, [SI+117]
      XOR     SI, [BP+119]
      XOR     SI, [BX+120]
      XOR     AX, [BX+SI+8281H]
      XOR     AX, [BP+SI+8483H]
      XOR     AX, [SI+8685H]
      XOR     AX, [BP+8887H]
      XOR     AX, [BX+8988H]
      XOR     CX, [BX+SI+8A89H]
      XOR     CX, [BP+SI+8C8BH]
      XOR     CX, [SI+8E8DH]
      XOR     CX, [BP+908FH]
      XOR     CX, [BX+9190H]
      XOR     SP, [BX+SI+0A2A1H]
      XOR     SP, [BP+SI+0A4A3H]
      XOR     SP, [SI+0A6A5H]
      XOR     SP, [BP+0A8A7H]
      XOR     SP, [BX+0A9A8H]
      XOR     SI, [BX+SI+0B2B1H]
      XOR     SI, [BP+SI+0B4B3H]
      XOR     SI, [SI+0B6B5H]
      XOR     SI, [BP+0B8B7H]
      XOR     SI, [BX+0B9B8H]
      XOR     AX, [BX+SI]
      XOR     AX, [BP+SI]
      XOR     AX, [SI]
      XOR     AX, [0807H]
      XOR     AX, [BX]
      XOR     CX, [BX+SI]
      XOR     CX, [BP+SI]
      XOR     CX, [SI]
      XOR     CX, [100FH]
      XOR     CX, [BX]
      XOR     SP, [BX+SI]
      XOR     SP, [BP+SI]
      XOR     SP, [SI]
      XOR     SP, [2827H]
      XOR     SP, [BX]
      XOR     AX, 3736H
      SEGSS
      AAA
      CMP     [BX+DI], BH
      CMP     [BP+SI], BH
      CMP     [SI], BH
      CMP     [403FH], BH
      CMP     [BX], BH
      CMP     [BX+SI+65], AL
      CMP     [BP+SI+67], AL
      CMP     [SI+69], AL
      CMP     [BP+71], AL
      CMP     [BX+72], AL
      CMP     [BX+SI+97], AH
      CMP     [BP+SI+99], AH
      CMP     [SI+101], AH
      CMP     [BP+103], AH
      CMP     [BX+104], AH
      CMP     [BX+SI+8281H], AL
      CMP     [BP+SI+8483H], AL
      CMP     [SI+8685H], AL
      CMP     [BP+8887H], AL
      CMP     [BX+8988H], AL
      CMP     [BX+SI+0A2A1H], AH
      CMP     [BP+SI+0A4A3H], AH
      CMP     [SI+0A6A5H], AH
      CMP     [BP+0A8A7H], AH
      CMP     [BX+0A9A8H], AH
      CMP     AL, AL
      CMP     AH, AL
      CMP     AL, AH
      CMP     AH, AH
      CMP     [BX+SI], AL
      CMP     [BP+SI], AL
      CMP     [SI], AL
      CMP     [0807H], AL
      CMP     [BX], AL
      CMP     [BP+SI], DI
      CMP     [SI], DI
      CMP     [403FH], DI
      CMP     [BX], DI
      CMP     [BX+SI+65], AX
      CMP     [BP+SI+67], AX
      CMP     [SI+69], AX
      CMP     [BP+71], AX
      CMP     [BX+72], AX
      CMP     [BX+SI+73], CX
      CMP     [BP+SI+75], CX
      CMP     [SI+77], CX
      CMP     [BP+79], CX
      CMP     [BX+80], CX
      CMP     [BX+SI+97], SP
      CMP     [BP+SI+99], SP
      CMP     [SI+101], SP
      CMP     [BP+103], SP
      CMP     [BX+104], SP
      CMP     [BX+SI+113], SI
      CMP     [BP+SI+115], SI
      CMP     [SI+117], SI
      CMP     [BP+119], SI
      CMP     [BX+120], SI
      CMP     [BX+SI+8281H], AX
      CMP     [BP+SI+8483H], AX
      CMP     [SI+8685H], AX
      CMP     [BP+8887H], AX
      CMP     [BX+8988H], AX
      CMP     [BX+SI+8A89H], CX
      CMP     [BP+SI+8C8BH], CX
      CMP     [SI+8E8DH], CX
      CMP     [BP+908FH], CX
      CMP     [BX+9190H], CX
      CMP     [BX+SI+0A2A1H], SP
      CMP     [BP+SI+0A4A3H], SP
      CMP     [SI+0A6A5H], SP
      CMP     [BP+0A8A7H], SP
      CMP     [BX+0A9A8H], SP
      CMP     [BX+SI+0B2B1H], SI
      CMP     [BP+SI+0B4B3H], SI
      CMP     [SI+0B6B5H], SI
      CMP     [BP+0B8B7H], SI
      CMP     [BX+0B9B8H], SI
      CMP     AX, AX
      CMP     CX, AX
      CMP     SP, AX
      CMP     SI, AX
      CMP     AX, CX
      CMP     CX, CX
      CMP     SP, CX
      CMP     SI, CX
      CMP     AX, SP
      CMP     CX, SP
      CMP     SP, SP
      CMP     SI, SP
      CMP     AX, SI
      CMP     CX, SI
      CMP     SP, SI
      CMP     SI, SI
      CMP     [BX+SI], AX
      CMP     [BP+SI], AX
      CMP     [SI], AX
      CMP     [0807H], AX
      CMP     [BX], AX
      CMP     [BX+SI], CX
      CMP     [BP+SI], CX
      CMP     [SI], CX
      CMP     [100FH], CX
      CMP     [BX], CX
      CMP     [BX+SI], SP
      CMP     [BP+SI], SP
      CMP     [SI], SP
      CMP     [2827H], SP
      CMP     [BX], SP
      CMP     [BX+SI], SI
      CMP     BH, [BP+DI]
      CMP     BH, [SI]
      CMP     BH, [403FH]
      CMP     BH, [BX]
      CMP     AL, [BX+SI+65]
      CMP     AL, [BP+SI+67]
      CMP     AL, [SI+69]
      CMP     AL, [BP+71]
      CMP     AL, [BX+72]
      CMP     AH, [BX+SI+97]
      CMP     AH, [BP+SI+99]
      CMP     AH, [SI+101]
      CMP     AH, [BP+103]
      CMP     AH, [BX+104]
      CMP     AL, [BX+SI+8281H]
      CMP     AL, [BP+SI+8483H]
      CMP     AL, [SI+8685H]
      CMP     AL, [BP+8887H]
      CMP     AL, [BX+8988H]
      CMP     AH, [BX+SI+0A2A1H]
      CMP     AH, [BP+SI+0A4A3H]
      CMP     AH, [SI+0A6A5H]
      CMP     AH, [BP+0A8A7H]
      CMP     AH, [BX+0A9A8H]
      CMP     AL, [BX+SI]
      CMP     AL, [BP+SI]
      CMP     AL, [SI]
      CMP     AL, [0807H]
      CMP     AL, [BX]
      CMP     AH, [BX+SI]
      CMP     DI, [SI]
      CMP     DI, [403FH]
      CMP     DI, [BX]
      CMP     AX, [BX+SI+65]
      CMP     AX, [BP+SI+67]
      CMP     AX, [SI+69]
      CMP     AX, [BP+71]
      CMP     AX, [BX+72]
      CMP     CX, [BX+SI+73]
      CMP     CX, [BP+SI+75]
      CMP     CX, [SI+77]
      CMP     CX, [BP+79]
      CMP     CX, [BX+80]
      CMP     SP, [BX+SI+97]
      CMP     SP, [BP+SI+99]
      CMP     SP, [SI+101]
      CMP     SP, [BP+103]
      CMP     SP, [BX+104]
      CMP     SI, [BX+SI+113]
      CMP     SI, [BP+SI+115]
      CMP     SI, [SI+117]
      CMP     SI, [BP+119]
      CMP     SI, [BX+120]
      CMP     AX, [BX+SI+8281H]
      CMP     AX, [BP+SI+8483H]
      CMP     AX, [SI+8685H]
      CMP     AX, [BP+8887H]
      CMP     AX, [BX+8988H]
      CMP     CX, [BX+SI+8A89H]
      CMP     CX, [BP+SI+8C8BH]
      CMP     CX, [SI+8E8DH]
      CMP     CX, [BP+908FH]
      CMP     CX, [BX+9190H]
      CMP     SP, [BX+SI+0A2A1H]
      CMP     SP, [BP+SI+0A4A3H]
      CMP     SP, [SI+0A6A5H]
      CMP     SP, [BP+0A8A7H]
      CMP     SP, [BX+0A9A8H]
      CMP     SI, [BX+SI+0B2B1H]
      CMP     SI, [BP+SI+0B4B3H]
      CMP     SI, [SI+0B6B5H]
      CMP     SI, [BP+0B8B7H]
      CMP     SI, [BX+0B9B8H]
      CMP     AX, [BX+SI]
      CMP     AX, [BP+SI]
      CMP     AX, [SI]
      CMP     AX, [0807H]
      CMP     AX, [BX]
      CMP     CX, [BX+SI]
      CMP     CX, [BP+SI]
      CMP     CX, [SI]
      CMP     CX, [100FH]
      CMP     CX, [BX]
      CMP     SP, [BX+SI]
      CMP     SP, [BP+SI]
      CMP     SP, [SI]
      CMP     SP, [2827H]
      CMP     SP, [BX]
      CMP     SI, [BX+SI]
      CMP     SI, [BP+SI]
      CMP     AX, 3F3EH
      SEGDS
      AAS
      INC     AX
      INC     CX
      INC     SP
      INC     SI
      DEC     AX
      DEC     CX
      DEC     SP
      DEC     SI
      PUSH    AX
      PUSH    CX
      PUSH    SP
      PUSH    SI
      POP     AX
      POP     CX
      POP     SP
      POP     SI
      JO      $+115
      JNO     $+116
      JB      $+117
      JAE     $+118
      JE      $+119
      JNE     $+120
      JBE     $+121
      JA      $+122
      JS      $+123
      JNS     $+124
      JPE     $+125
      JPO     $+126
      JL      $+127
      JGE     $+128
      JLE     $+129
      JG      $-126
      ADD     BYTE PTR [BX+DI+8382H], 84H
      ADD     BYTE PTR [BP+SI+8483H], 85H
      ADD     BYTE PTR [SI+8685H], 87H
      ADD     BYTE PTR [BP+8887H], 89H
      ADD     BYTE PTR [BX+8988H], 8AH
      OR      BYTE PTR [BX+SI+8A89H], 8BH
      OR      BYTE PTR [BP+SI+8C8BH], 8DH
      OR      BYTE PTR [SI+8E8DH], 8FH
      OR      BYTE PTR [BP+908FH], 91H
      OR      BYTE PTR [BX+9190H], 92H
      ADC     BYTE PTR [BX+SI+9291H], 93H
      ADC     BYTE PTR [BP+SI+9493H], 95H
      ADC     BYTE PTR [SI+9695H], 97H
      ADC     BYTE PTR [BP+9897H], 99H
      ADC     BYTE PTR [BX+9998H], 9AH
      SBB     BYTE PTR [BX+SI+9A99H], 9BH
      SBB     BYTE PTR [BP+SI+9C9BH], 9DH
      SBB     BYTE PTR [SI+9E9DH], 9FH
      SBB     BYTE PTR [BP+0A09FH], 0A1H
      SBB     BYTE PTR [BX+0A1A0H], 0A2H
      AND     BYTE PTR [BX+SI+0A2A1H], 0A3H
      AND     BYTE PTR [BP+SI+0A4A3H], 0A5H
      AND     BYTE PTR [SI+0A6A5H], 0A7H
      AND     BYTE PTR [BP+0A8A7H], 0A9H
      AND     BYTE PTR [BX+0A9A8H], 0AAH
      SUB     BYTE PTR [BX+SI+0AAA9H], 0ABH
      SUB     BYTE PTR [BP+SI+0ACABH], 0ADH
      SUB     BYTE PTR [SI+0AEADH], 0AFH
      SUB     BYTE PTR [BP+0B0AFH], 0B1H
      SUB     BYTE PTR [BX+0B1B0H], 0B2H
      XOR     BYTE PTR [BX+SI+0B2B1H], 0B3H
      XOR     BYTE PTR [BP+SI+0B4B3H], 0B5H
      XOR     BYTE PTR [SI+0B6B5H], 0B7H
      XOR     BYTE PTR [BP+0B8B7H], 0B9H
      XOR     BYTE PTR [BX+0B9B8H], 0BAH
      CMP     BYTE PTR [BX+SI+0BAB9H], 0BBH
      CMP     BYTE PTR [BP+SI+0BCBBH], 0BDH
      CMP     BYTE PTR [SI+0BEBDH], 0BFH
      CMP     BYTE PTR [BP+0C0BFH], 0C1H
      CMP     BYTE PTR [BX+0C1C0H], 0C2H
      ADD     AL, 0C1H
      ADD     AH, 0C5H
      OR      AL, 0C9H
      OR      AH, 0CDH
      ADC     AL, 0D1H
      ADC     AH, 0D5H
      SBB     AL, 0D9H
      SBB     AH, 0DDH
      AND     AL, 0E1H
      AND     AH, 0E5H
      SUB     AL, 0E9H
      SUB     AH, 0EDH
      XOR     AL, 0F1H
      XOR     AH, 0F5H
      CMP     AL, 0F9H
      CMP     AH, 0FDH
      ADD     BYTE PTR [BX+SI], 1
      ADD     BYTE PTR [BP+SI], 3
      ADD     BYTE PTR [SI], 5
      ADD     BYTE PTR [0807H], 9
      ADD     BYTE PTR [BX], 8
      OR      BYTE PTR [BX+SI], 9
      OR      BYTE PTR [BP+SI], 11
      OR      BYTE PTR [SI], 13
      OR      BYTE PTR [100FH], 17
      OR      BYTE PTR [BX], 16
      ADC     BYTE PTR [BX+SI], 17
      ADC     BYTE PTR [BP+SI], 19
      ADC     BYTE PTR [SI], 21
      ADC     BYTE PTR [1817H], 25
      ADC     BYTE PTR [BX], 24
      SBB     BYTE PTR [BX+SI], 25
      SBB     BYTE PTR [BP+SI], 27
      SBB     BYTE PTR [SI], 29
      SBB     BYTE PTR [201FH], 21H
      SBB     BYTE PTR [BX], 32
      AND     BYTE PTR [BX+SI], 21H
      AND     BYTE PTR [BP+SI], 23H
      AND     BYTE PTR [SI], 25H
      AND     BYTE PTR [2827H], 29H
      AND     BYTE PTR [BX], 28H
      SUB     BYTE PTR [BX+SI], 29H
      SUB     BYTE PTR [BP+SI], 2BH
      SUB     BYTE PTR [SI], 2DH
      SUB     BYTE PTR [302FH], 31H
      SUB     BYTE PTR [BX], 30H
      XOR     BYTE PTR [BX+SI], 31H
      XOR     BYTE PTR [BP+SI], 33H
      XOR     BYTE PTR [SI], 35H
      XOR     BYTE PTR [3837H], 39H
      XOR     BYTE PTR [BX], 38H
      CMP     BYTE PTR [BX+SI], 39H
      CMP     BYTE PTR [BP+SI], 3BH
      CMP     BYTE PTR [SI], 3DH
      CMP     BYTE PTR [403FH], 41H
      CMP     BYTE PTR [BX], 40H
      ADD     BYTE PTR [BX+SI+65], 42H
      ADD     BYTE PTR [BP+SI+67], 44H
      ADD     BYTE PTR [SI+69], 46H
      ADD     BYTE PTR [BP+71], 48H
      ADD     BYTE PTR [BX+72], 49H
      OR      BYTE PTR [BX+SI+73], 4AH
      OR      BYTE PTR [BP+SI+75], 4CH
      OR      BYTE PTR [SI+77], 4EH
      OR      BYTE PTR [BP+79], 50H
      OR      BYTE PTR [BX+80], 51H
      ADC     BYTE PTR [BX+SI+81], 52H
      ADC     BYTE PTR [BP+SI+83], 54H
      ADC     BYTE PTR [SI+85], 56H
      ADC     BYTE PTR [BP+87], 58H
      ADC     BYTE PTR [BX+88], 59H
      SBB     BYTE PTR [BX+SI+89], 5AH
      SBB     BYTE PTR [BP+SI+91], 5CH
      SBB     BYTE PTR [SI+93], 5EH
      SBB     BYTE PTR [BP+95], 60H
      SBB     BYTE PTR [BX+96], 61H
      AND     BYTE PTR [BX+SI+97], 62H
      AND     BYTE PTR [BP+SI+99], 64H
      AND     BYTE PTR [SI+101], 66H
      AND     BYTE PTR [BP+103], 68H
      AND     BYTE PTR [BX+104], 69H
      SUB     BYTE PTR [BX+SI+105], 6AH
      SUB     BYTE PTR [BP+SI+107], 6CH
      SUB     BYTE PTR [SI+109], 6EH
      SUB     BYTE PTR [BP+111], 70H
      SUB     BYTE PTR [BX+112], 71H
      XOR     BYTE PTR [BX+SI+113], 72H
      XOR     BYTE PTR [BP+SI+115], 74H
      XOR     BYTE PTR [SI+117], 76H
      XOR     BYTE PTR [BP+119], 78H
      XOR     BYTE PTR [BX+120], 79H
      CMP     BYTE PTR [BX+SI+121], 7AH
      CMP     BYTE PTR [BP+SI+123], 7CH
      CMP     BYTE PTR [SI+125], 7EH
      CMP     BYTE PTR [BP+127], 80H
      CMP     BYTE PTR [BX-128], 81H
      ADD     WORD PTR [BP+SI+8483H], 8685H
      ADD     WORD PTR [SI+8685H], 8887H
      ADD     WORD PTR [BP+8887H], 8A89H
      ADD     WORD PTR [BX+8988H], 8B8AH
      OR      WORD PTR [BX+SI+8A89H], 8C8BH
      OR      WORD PTR [BP+SI+8C8BH], 8E8DH
      OR      WORD PTR [SI+8E8DH], 908FH
      OR      WORD PTR [BP+908FH], 9291H
      OR      WORD PTR [BX+9190H], 9392H
      ADC     WORD PTR [BX+SI+9291H], 9493H
      ADC     WORD PTR [BP+SI+9493H], 9695H
      ADC     WORD PTR [SI+9695H], 9897H
      ADC     WORD PTR [BP+9897H], 9A99H
      ADC     WORD PTR [BX+9998H], 9B9AH
      SBB     WORD PTR [BX+SI+9A99H], 9C9BH
      SBB     WORD PTR [BP+SI+9C9BH], 9E9DH
      SBB     WORD PTR [SI+9E9DH], 0A09FH
      SBB     WORD PTR [BP+0A09FH], 0A2A1H
      SBB     WORD PTR [BX+0A1A0H], 0A3A2H
      AND     WORD PTR [BX+SI+0A2A1H], 0A4A3H
      AND     WORD PTR [BP+SI+0A4A3H], 0A6A5H
      AND     WORD PTR [SI+0A6A5H], 0A8A7H
      AND     WORD PTR [BP+0A8A7H], 0AAA9H
      AND     WORD PTR [BX+0A9A8H], 0ABAAH
      SUB     WORD PTR [BX+SI+0AAA9H], 0ACABH
      SUB     WORD PTR [BP+SI+0ACABH], 0AEADH
      SUB     WORD PTR [SI+0AEADH], 0B0AFH
      SUB     WORD PTR [BP+0B0AFH], 0B2B1H
      SUB     WORD PTR [BX+0B1B0H], 0B3B2H
      XOR     WORD PTR [BX+SI+0B2B1H], 0B4B3H
      XOR     WORD PTR [BP+SI+0B4B3H], 0B6B5H
      XOR     WORD PTR [SI+0B6B5H], 0B8B7H
      XOR     WORD PTR [BP+0B8B7H], 0BAB9H
      XOR     WORD PTR [BX+0B9B8H], 0BBBAH
      CMP     WORD PTR [BX+SI+0BAB9H], 0BCBBH
      CMP     WORD PTR [BP+SI+0BCBBH], 0BEBDH
      CMP     WORD PTR [SI+0BEBDH], 0C0BFH
      CMP     WORD PTR [BP+0C0BFH], 0C2C1H
      CMP     WORD PTR [BX+0C1C0H], 0C3C2H
      ADD     AX, 0C2C1H
      ADD     CX, 0C3C2H
      ADD     SP, 0C6C5H
      ADD     SI, 0C8C7H
      OR      AX, 0CAC9H
      OR      CX, 0CBCAH
      OR      SP, 0CECDH
      OR      SI, 0D0CFH
      ADC     AX, 0D2D1H
      ADC     CX, 0D3D2H
      ADC     SP, 0D6D5H
      ADC     SI, 0D8D7H
      SBB     AX, 0DAD9H
      SBB     CX, 0DBDAH
      SBB     SP, 0DEDDH
      SBB     SI, 0E0DFH
      AND     AX, 0E2E1H
      AND     CX, 0E3E2H
      AND     SP, 0E6E5H
      AND     SI, 0E8E7H
      SUB     AX, 0EAE9H
      SUB     CX, 0EBEAH
      SUB     SP, 0EEEDH
      SUB     SI, 0F0EFH
      XOR     AX, 0F2F1H
      XOR     CX, 0F3F2H
      XOR     SP, 0F6F5H
      XOR     SI, 0F8F7H
      CMP     AX, 0FAF9H
      CMP     CX, 0FBFAH
      CMP     SP, 0FEFDH
      CMP     SI, 00FFH
      ADD     WORD PTR [BX+SI], 0201H
      ADD     WORD PTR [BP+SI], 0403H
      ADD     WORD PTR [SI], 0605H
      ADD     WORD PTR [0807H], 0A09H
      ADD     WORD PTR [BX], 0908H
      OR      WORD PTR [BX+SI], 0A09H
      OR      WORD PTR [BP+SI], 0C0BH
      OR      WORD PTR [SI], 0E0DH
      OR      WORD PTR [100FH], 1211H
      OR      WORD PTR [BX], 1110H
      ADC     WORD PTR [BX+SI], 1211H
      ADC     WORD PTR [BP+SI], 1413H
      ADC     WORD PTR [SI], 1615H
      ADC     WORD PTR [1817H], 1A19H
      ADC     WORD PTR [BX], 1918H
      SBB     WORD PTR [BX+SI], 1A19H
      SBB     WORD PTR [BP+SI], 1C1BH
      SBB     WORD PTR [SI], 1E1DH
      SBB     WORD PTR [201FH], 2221H
      SBB     WORD PTR [BX], 2120H
      AND     WORD PTR [BX+SI], 2221H
      AND     WORD PTR [BP+SI], 2423H
      AND     WORD PTR [SI], 2625H
      AND     WORD PTR [2827H], 2A29H
      AND     WORD PTR [BX], 2928H
      SUB     WORD PTR [BX+SI], 2A29H
      SUB     WORD PTR [BP+SI], 2C2BH
      SUB     WORD PTR [SI], 2E2DH
      SUB     WORD PTR [302FH], 3231H
      SUB     WORD PTR [BX], 3130H
      XOR     WORD PTR [BX+SI], 3231H
      XOR     WORD PTR [BP+SI], 3433H
      XOR     WORD PTR [SI], 3635H
      XOR     WORD PTR [3837H], 3A39H
      XOR     WORD PTR [BX], 3938H
      CMP     WORD PTR [BX+SI], 3A39H
      CMP     WORD PTR [BP+SI], 3C3BH
      CMP     WORD PTR [SI], 3E3DH
      CMP     WORD PTR [403FH], 4241H
      CMP     WORD PTR [BX], 4140H
      ADD     WORD PTR [BX+SI+65], 4342H
      ADD     WORD PTR [BP+SI+67], 4544H
      ADD     WORD PTR [SI+69], 4746H
      ADD     WORD PTR [BP+71], 4948H
      ADD     WORD PTR [BX+72], 4A49H
      OR      WORD PTR [BX+SI+73], 4B4AH
      OR      WORD PTR [BP+SI+75], 4D4CH
      OR      WORD PTR [SI+77], 4F4EH
      OR      WORD PTR [BP+79], 5150H
      OR      WORD PTR [BX+80], 5251H
      ADC     WORD PTR [BX+SI+81], 5352H
      ADC     WORD PTR [BP+SI+83], 5554H
      ADC     WORD PTR [SI+85], 5756H
      ADC     WORD PTR [BP+87], 5958H
      ADC     WORD PTR [BX+88], 5A59H
      SBB     WORD PTR [BX+SI+89], 5B5AH
      SBB     WORD PTR [BP+SI+91], 5D5CH
      SBB     WORD PTR [SI+93], 5F5EH
      SBB     WORD PTR [BP+95], 6160H
      SBB     WORD PTR [BX+96], 6261H
      AND     WORD PTR [BX+SI+97], 6362H
      AND     WORD PTR [BP+SI+99], 6564H
      AND     WORD PTR [SI+101], 6766H
      AND     WORD PTR [BP+103], 6968H
      AND     WORD PTR [BX+104], 6A69H
      SUB     WORD PTR [BX+SI+105], 6B6AH
      SUB     WORD PTR [BP+SI+107], 6D6CH
      SUB     WORD PTR [SI+109], 6F6EH
      SUB     WORD PTR [BP+111], 7170H
      SUB     WORD PTR [BX+112], 7271H
      XOR     WORD PTR [BX+SI+113], 7372H
      XOR     WORD PTR [BP+SI+115], 7574H
      XOR     WORD PTR [SI+117], 7776H
      XOR     WORD PTR [BP+119], 7978H
      XOR     WORD PTR [BX+120], 7A79H
      CMP     WORD PTR [BX+SI+121], 7B7AH
      CMP     WORD PTR [BP+SI+123], 7D7CH
      CMP     WORD PTR [SI+125], 7F7EH
      CMP     WORD PTR [BP+127], 8180H
      CMP     WORD PTR [BX-128], 8281H
      ADD     WORD PTR [BX+SI+8281H], 8483H
      TEST    [DI+8786H], AL
      TEST    [BP+8887H], AL
      TEST    [BX+8988H], AL
      TEST    [BX+SI+8A89H], CL
      TEST    [BP+SI+8C8BH], CL
      TEST    [BX+SI+0A2A1H], AH
      TEST    [BP+SI+0A4A3H], AH
      TEST    [SI+0A6A5H], AH
      TEST    [BP+0A8A7H], AH
      TEST    [BX+0A9A8H], AH
      TEST    AL, AL
      TEST    AH, AL
      TEST    AL, AH
      TEST    AH, AH
      TEST    [BX+SI], AL
      TEST    [BP+SI], AL
      TEST    [SI], AL
      TEST    [0807H], AL
      TEST    [BX], AL
      TEST    [BX+SI], AH
      TEST    [BP+SI], AH
      TEST    [SI], AH
      TEST    [2827H], AH
      TEST    [BX], AH
      TEST    [BX+SI+65], AL
      TEST    [BP+SI+67], AL
      TEST    [SI+69], AL
      TEST    [BP+71], AL
      TEST    [BX+72], AL
      TEST    [BX+SI+97], AH
      TEST    [BP+SI+99], AH
      TEST    [SI+101], AH
      TEST    [BP+103], AH
      TEST    [BX+104], AH
      TEST    [BP+8887H], AX
      TEST    [BX+8988H], AX
      TEST    [BX+SI+8A89H], CX
      TEST    [BP+SI+8C8BH], CX
      TEST    [SI+8E8DH], CX
      TEST    [BP+908FH], CX
      TEST    [BX+9190H], CX
      TEST    [BX+SI+0A2A1H], SP
      TEST    [BP+SI+0A4A3H], SP
      TEST    [SI+0A6A5H], SP
      TEST    [BP+0A8A7H], SP
      TEST    [BX+0A9A8H], SP
      TEST    [BX+SI+0B2B1H], SI
      TEST    [BP+SI+0B4B3H], SI
      TEST    [SI+0B6B5H], SI
      TEST    [BP+0B8B7H], SI
      TEST    [BX+0B9B8H], SI
      TEST    AX, AX
      TEST    CX, AX
      TEST    SP, AX
      TEST    SI, AX
      TEST    AX, CX
      TEST    CX, CX
      TEST    SP, CX
      TEST    SI, CX
      TEST    AX, SP
      TEST    CX, SP
      TEST    SP, SP
      TEST    SI, SP
      TEST    AX, SI
      TEST    CX, SI
      TEST    SP, SI
      TEST    SI, SI
      TEST    [BX+SI], AX
      TEST    [BP+SI], AX
      TEST    [SI], AX
      TEST    [0807H], AX
      TEST    [BX], AX
      TEST    [BX+SI], CX
      TEST    [BP+SI], CX
      TEST    [SI], CX
      TEST    [100FH], CX
      TEST    [BX], CX
      TEST    [BX+SI], SP
      TEST    [BP+SI], SP
      TEST    [SI], SP
      TEST    [2827H], SP
      TEST    [BX], SP
      TEST    [BX+SI], SI
      TEST    [BP+SI], SI
      TEST    [SI], SI
      TEST    [3837H], SI
      TEST    [BX], SI
      TEST    [BX+SI+65], AX
      TEST    [BP+SI+67], AX
      TEST    [SI+69], AX
      TEST    [BP+71], AX
      TEST    [BX+72], AX
      TEST    [BX+SI+73], CX
      TEST    [BP+SI+75], CX
      TEST    [SI+77], CX
      TEST    [BP+79], CX
      TEST    [BX+80], CX
      TEST    [BX+SI+97], SP
      TEST    [BP+SI+99], SP
      TEST    [SI+101], SP
      TEST    [BP+103], SP
      TEST    [BX+104], SP
      TEST    [BX+SI+113], SI
      TEST    [BP+SI+115], SI
      TEST    [SI+117], SI
      TEST    [BP+119], SI
      TEST    [BX+120], SI
      TEST    [BX+SI+8281H], AX
      TEST    [BP+SI+8483H], AX
      TEST    [SI+8685H], AX
      XCHG    [BX+8988H], AL
      XCHG    [BX+SI+8A89H], CL
      XCHG    [BP+SI+8C8BH], CL
      XCHG    [SI+8E8DH], CL
      XCHG    [BP+908FH], CL
      XCHG    [BX+SI+0A2A1H], AH
      XCHG    [BP+SI+0A4A3H], AH
      XCHG    [SI+0A6A5H], AH
      XCHG    [BP+0A8A7H], AH
      XCHG    [BX+0A9A8H], AH
      XCHG    AL, AL
      XCHG    AH, AL
      XCHG    AL, AH
      XCHG    AH, AH
      XCHG    [BX+SI], AL
      XCHG    [BP+SI], AL
      XCHG    [SI], AL
      XCHG    [0807H], AL
      XCHG    [BX], AL
      XCHG    [BX+SI], AH
      XCHG    [BP+SI], AH
      XCHG    [SI], AH
      XCHG    [2827H], AH
      XCHG    [BX], AH
      XCHG    [BX+SI+65], AL
      XCHG    [BP+SI+67], AL
      XCHG    [SI+69], AL
      XCHG    [BP+71], AL
      XCHG    [BX+72], AL
      XCHG    [BX+SI+97], AH
      XCHG    [BP+SI+99], AH
      XCHG    [SI+101], AH
      XCHG    [BP+103], AH
      XCHG    [BX+104], AH
      XCHG    [BX+SI+8A89H], CX
      XCHG    [BP+SI+8C8BH], CX
      XCHG    [SI+8E8DH], CX
      XCHG    [BP+908FH], CX
      XCHG    [BX+9190H], CX
      XCHG    [BX+SI+0A2A1H], SP
      XCHG    [BP+SI+0A4A3H], SP
      XCHG    [SI+0A6A5H], SP
      XCHG    [BP+0A8A7H], SP
      XCHG    [BX+0A9A8H], SP
      XCHG    [BX+SI+0B2B1H], SI
      XCHG    [BP+SI+0B4B3H], SI
      XCHG    [SI+0B6B5H], SI
      XCHG    [BP+0B8B7H], SI
      XCHG    [BX+0B9B8H], SI
      XCHG    AX, AX
      XCHG    CX, AX
      XCHG    SP, AX
      XCHG    SI, AX
      XCHG    AX, CX
      XCHG    CX, CX
      XCHG    SP, CX
      XCHG    SI, CX
      XCHG    AX, SP
      XCHG    CX, SP
      XCHG    SP, SP
      XCHG    SI, SP
      XCHG    AX, SI
      XCHG    CX, SI
      XCHG    SP, SI
      XCHG    SI, SI
      XCHG    [BX+SI], AX
      XCHG    [BP+SI], AX
      XCHG    [SI], AX
      XCHG    [0807H], AX
      XCHG    [BX], AX
      XCHG    [BX+SI], CX
      XCHG    [BP+SI], CX
      XCHG    [SI], CX
      XCHG    [100FH], CX
      XCHG    [BX], CX
      XCHG    [BX+SI], SP
      XCHG    [BP+SI], SP
      XCHG    [SI], SP
      XCHG    [2827H], SP
      XCHG    [BX], SP
      XCHG    [BX+SI], SI
      XCHG    [BP+SI], SI
      XCHG    [SI], SI
      XCHG    [3837H], SI
      XCHG    [BX], SI
      XCHG    [BX+SI+65], AX
      XCHG    [BP+SI+67], AX
      XCHG    [SI+69], AX
      XCHG    [BP+71], AX
      XCHG    [BX+72], AX
      XCHG    [BX+SI+73], CX
      XCHG    [BP+SI+75], CX
      XCHG    [SI+77], CX
      XCHG    [BP+79], CX
      XCHG    [BX+80], CX
      XCHG    [BX+SI+97], SP
      XCHG    [BP+SI+99], SP
      XCHG    [SI+101], SP
      XCHG    [BP+103], SP
      XCHG    [BX+104], SP
      XCHG    [BX+SI+113], SI
      XCHG    [BP+SI+115], SI
      XCHG    [SI+117], SI
      XCHG    [BP+119], SI
      XCHG    [BX+120], SI
      XCHG    [BX+SI+8281H], AX
      XCHG    [BP+SI+8483H], AX
      XCHG    [SI+8685H], AX
      XCHG    [BP+8887H], AX
      XCHG    [BX+8988H], AX
      MOV     [BX+DI+8B8AH], CL
      MOV     [BP+SI+8C8BH], CL
      MOV     [SI+8E8DH], CL
      MOV     [BP+908FH], CL
      MOV     [BX+9190H], CL
      MOV     [BX+SI+0A2A1H], AH
      MOV     [BP+SI+0A4A3H], AH
      MOV     [SI+0A6A5H], AH
      MOV     [BP+0A8A7H], AH
      MOV     [BX+0A9A8H], AH
      MOV     AL, AL
      MOV     AH, AL
      MOV     AL, AH
      MOV     AH, AH
      MOV     [BX+SI], AL
      MOV     [BP+SI], AL
      MOV     [SI], AL
      MOV     [0807H], AL
      MOV     [BX], AL
      MOV     [BX+SI], AH
      MOV     [BP+SI], AH
      MOV     [SI], AH
      MOV     [2827H], AH
      MOV     [BX], AH
      MOV     [BX+SI+65], AL
      MOV     [BP+SI+67], AL
      MOV     [SI+69], AL
      MOV     [BP+71], AL
      MOV     [BX+72], AL
      MOV     [BX+SI+97], AH
      MOV     [BP+SI+99], AH
      MOV     [SI+101], AH
      MOV     [BP+103], AH
      MOV     [BX+104], AH
      MOV     [BP+SI+8C8BH], CX
      MOV     [SI+8E8DH], CX
      MOV     [BP+908FH], CX
      MOV     [BX+9190H], CX
      MOV     [BX+SI+9291H], DX
      MOV     [BX+SI+0A2A1H], SP
      MOV     [BP+SI+0A4A3H], SP
      MOV     [SI+0A6A5H], SP
      MOV     [BP+0A8A7H], SP
      MOV     [BX+0A9A8H], SP
      MOV     [BX+SI+0B2B1H], SI
      MOV     [BP+SI+0B4B3H], SI
      MOV     [SI+0B6B5H], SI
      MOV     [BP+0B8B7H], SI
      MOV     [BX+0B9B8H], SI
      MOV     AX, AX
      MOV     CX, AX
      MOV     SP, AX
      MOV     SI, AX
      MOV     AX, CX
      MOV     CX, CX
      MOV     SP, CX
      MOV     SI, CX
      MOV     AX, SP
      MOV     CX, SP
      MOV     SP, SP
      MOV     SI, SP
      MOV     AX, SI
      MOV     CX, SI
      MOV     SP, SI
      MOV     SI, SI
      MOV     [BX+SI], AX
      MOV     [BP+SI], AX
      MOV     [SI], AX
      MOV     [0807H], AX
      MOV     [BX], AX
      MOV     [BX+SI], CX
      MOV     [BP+SI], CX
      MOV     [SI], CX
      MOV     [100FH], CX
      MOV     [BX], CX
      MOV     [BX+SI], SP
      MOV     [BP+SI], SP
      MOV     [SI], SP
      MOV     [2827H], SP
      MOV     [BX], SP
      MOV     [BX+SI], SI
      MOV     [BP+SI], SI
      MOV     [SI], SI
      MOV     [3837H], SI
      MOV     [BX], SI
      MOV     [BX+SI+65], AX
      MOV     [BP+SI+67], AX
      MOV     [SI+69], AX
      MOV     [BP+71], AX
      MOV     [BX+72], AX
      MOV     [BX+SI+73], CX
      MOV     [BP+SI+75], CX
      MOV     [SI+77], CX
      MOV     [BP+79], CX
      MOV     [BX+80], CX
      MOV     [BX+SI+97], SP
      MOV     [BP+SI+99], SP
      MOV     [SI+101], SP
      MOV     [BP+103], SP
      MOV     [BX+104], SP
      MOV     [BX+SI+113], SI
      MOV     [BP+SI+115], SI
      MOV     [SI+117], SI
      MOV     [BP+119], SI
      MOV     [BX+120], SI
      MOV     [BX+SI+8281H], AX
      MOV     [BP+SI+8483H], AX
      MOV     [SI+8685H], AX
      MOV     [BP+8887H], AX
      MOV     [BX+8988H], AX
      MOV     CL, [BP+DI+8D8CH]
      MOV     CL, [SI+8E8DH]
      MOV     CL, [BP+908FH]
      MOV     CL, [BX+9190H]
      MOV     DL, [BX+SI+9291H]
      MOV     AH, [BX+SI+0A2A1H]
      MOV     AH, [BP+SI+0A4A3H]
      MOV     AH, [SI+0A6A5H]
      MOV     AH, [BP+0A8A7H]
      MOV     AH, [BX+0A9A8H]
      MOV     AL, [BX+SI]
      MOV     AL, [BP+SI]
      MOV     AL, [SI]
      MOV     AL, [0807H]
      MOV     AL, [BX]
      MOV     AH, [BX+SI]
      MOV     AH, [BP+SI]
      MOV     AH, [SI]
      MOV     AH, [2827H]
      MOV     AH, [BX]
      MOV     AL, [BX+SI+65]
      MOV     AL, [BP+SI+67]
      MOV     AL, [SI+69]
      MOV     AL, [BP+71]
      MOV     AL, [BX+72]
      MOV     AH, [BX+SI+97]
      MOV     AH, [BP+SI+99]
      MOV     AH, [SI+101]
      MOV     AH, [BP+103]
      MOV     AH, [BX+104]
      MOV     CX, [SI+8E8DH]
      MOV     CX, [BP+908FH]
      MOV     CX, [BX+9190H]
      MOV     DX, [BX+SI+9291H]
      MOV     DX, [BP+SI+9493H]
      MOV     SP, [BX+SI+0A2A1H]
      MOV     SP, [BP+SI+0A4A3H]
      MOV     SP, [SI+0A6A5H]
      MOV     SP, [BP+0A8A7H]
      MOV     SP, [BX+0A9A8H]
      MOV     SI, [BX+SI+0B2B1H]
      MOV     SI, [BP+SI+0B4B3H]
      MOV     SI, [SI+0B6B5H]
      MOV     SI, [BP+0B8B7H]
      MOV     SI, [BX+0B9B8H]
      MOV     AX, [BX+SI]
      MOV     AX, [BP+SI]
      MOV     AX, [SI]
      MOV     AX, [0807H]
      MOV     AX, [BX]
      MOV     CX, [BX+SI]
      MOV     CX, [BP+SI]
      MOV     CX, [SI]
      MOV     CX, [100FH]
      MOV     CX, [BX]
      MOV     SP, [BX+SI]
      MOV     SP, [BP+SI]
      MOV     SP, [SI]
      MOV     SP, [2827H]
      MOV     SP, [BX]
      MOV     SI, [BX+SI]
      MOV     SI, [BP+SI]
      MOV     SI, [SI]
      MOV     SI, [3837H]
      MOV     SI, [BX]
      MOV     AX, [BX+SI+65]
      MOV     AX, [BP+SI+67]
      MOV     AX, [SI+69]
      MOV     AX, [BP+71]
      MOV     AX, [BX+72]
      MOV     CX, [BX+SI+73]
      MOV     CX, [BP+SI+75]
      MOV     CX, [SI+77]
      MOV     CX, [BP+79]
      MOV     CX, [BX+80]
      MOV     SP, [BX+SI+97]
      MOV     SP, [BP+SI+99]
      MOV     SP, [SI+101]
      MOV     SP, [BP+103]
      MOV     SP, [BX+104]
      MOV     SI, [BX+SI+113]
      MOV     SI, [BP+SI+115]
      MOV     SI, [SI+117]
      MOV     SI, [BP+119]
      MOV     SI, [BX+120]
      MOV     AX, [BX+SI+8281H]
      MOV     AX, [BP+SI+8483H]
      MOV     AX, [SI+8685H]
      MOV     AX, [BP+8887H]
      MOV     AX, [BX+8988H]
      MOV     [DI+8F8EH], CS
      MOV     [BP+908FH], CS
      MOV     [BX+9190H], CS
      MOV     [BX+SI+9291H], SS
      MOV     [BP+SI+9493H], SS
      MOV     [SI+9695H], SS
      MOV     [BP+9897H], SS
      MOV     [BX+9998H], SS
      MOV     [BX+SI+9A99H], DS
      MOV     [BP+SI+9C9BH], DS
      MOV     [SI+9E9DH], DS
      MOV     [BP+0A09FH], DS
      MOV     [BX+0A1A0H], DS
      MOV     [BX+SI+0A2A1H], ES
      MOV     [BP+SI+0A4A3H], ES
      MOV     [SI+0A6A5H], ES
      MOV     [BP+0A8A7H], ES
      MOV     [BX+0A9A8H], ES
      MOV     [BX+SI+0AAA9H], CS
      MOV     [BP+SI+0ACABH], CS
      MOV     AX, ES
      MOV     CX, ES
      MOV     SP, ES
      MOV     SI, ES
      MOV     AX, CS
      MOV     CX, CS
      MOV     SP, CS
      MOV     SI, CS
      MOV     AX, SS
      MOV     CX, SS
      MOV     SP, SS
      MOV     SI, SS
      MOV     AX, DS
      MOV     CX, DS
      MOV     SP, DS
      MOV     SI, DS
      MOV     [BX+SI], ES
      MOV     [BP+SI], ES
      MOV     [SI], ES
      MOV     [0807H], ES
      MOV     [BX], ES
      MOV     [BX+SI], CS
      MOV     [BP+SI], CS
      MOV     [SI], CS
      MOV     [100FH], CS
      MOV     [BX], CS
      MOV     [BX+SI], SS
      MOV     [BP+SI], SS
      MOV     [SI], SS
      MOV     [1817H], SS
      MOV     [BX], SS
      MOV     [BX+SI], DS
      MOV     [BP+SI], DS
      MOV     [SI], DS
      MOV     [201FH], DS
      MOV     [BX], DS
      MOV     [BX+SI+65], ES
      MOV     [BP+SI+67], ES
      MOV     [SI+69], ES
      MOV     [BP+71], ES
      MOV     [BX+72], ES
      MOV     [BX+SI+73], CS
      MOV     [BP+SI+75], CS
      MOV     [SI+77], CS
      MOV     [BP+79], CS
      MOV     [BX+80], CS
      MOV     [BX+SI+81], SS
      MOV     [BP+SI+83], SS
      MOV     [SI+85], SS
      MOV     [BP+87], SS
      MOV     [BX+88], SS
      MOV     [BX+SI+89], DS
      MOV     [BP+SI+91], DS
      MOV     [SI+93], DS
      MOV     [BP+95], DS
      MOV     [BX+96], DS
      LEA     CX, [BP+908FH]
      LEA     CX, [BX+9190H]
      LEA     DX, [BX+SI+9291H]
      LEA     DX, [BP+SI+9493H]
      LEA     DX, [SI+9695H]
      LEA     SP, [BX+SI+0A2A1H]
      LEA     SP, [BP+SI+0A4A3H]
      LEA     SP, [SI+0A6A5H]
      LEA     SP, [BP+0A8A7H]
      LEA     SP, [BX+0A9A8H]
      LEA     SI, [BX+SI+0B2B1H]
      LEA     SI, [BP+SI+0B4B3H]
      LEA     SI, [SI+0B6B5H]
      LEA     SI, [BP+0B8B7H]
      LEA     SI, [BX+0B9B8H]
      LEA     AX, [BX+SI]
      LEA     AX, [BP+SI]
      LEA     AX, [SI]
      LEA     AX, [0807H]
      LEA     AX, [BX]
      LEA     CX, [BX+SI]
      LEA     CX, [BP+SI]
      LEA     CX, [SI]
      LEA     CX, [100FH]
      LEA     CX, [BX]
      LEA     SP, [BX+SI]
      LEA     SP, [BP+SI]
      LEA     SP, [SI]
      LEA     SP, [2827H]
      LEA     SP, [BX]
      LEA     SI, [BX+SI]
      LEA     SI, [BP+SI]
      LEA     SI, [SI]
      LEA     SI, [3837H]
      LEA     SI, [BX]
      LEA     AX, [BX+SI+65]
      LEA     AX, [BP+SI+67]
      LEA     AX, [SI+69]
      LEA     AX, [BP+71]
      LEA     AX, [BX+72]
      LEA     CX, [BX+SI+73]
      LEA     CX, [BP+SI+75]
      LEA     CX, [SI+77]
      LEA     CX, [BP+79]
      LEA     CX, [BX+80]
      LEA     SP, [BX+SI+97]
      LEA     SP, [BP+SI+99]
      LEA     SP, [SI+101]
      LEA     SP, [BP+103]
      LEA     SP, [BX+104]
      LEA     SI, [BX+SI+113]
      LEA     SI, [BP+SI+115]
      LEA     SI, [SI+117]
      LEA     SI, [BP+119]
      LEA     SI, [BX+120]
      LEA     AX, [BX+SI+8281H]
      LEA     AX, [BP+SI+8483H]
      LEA     AX, [SI+8685H]
      LEA     AX, [BP+8887H]
      LEA     AX, [BX+8988H]
      MOV     CS, [BX+9190H]
      MOV     SS, [BX+SI+9291H]
      MOV     SS, [BP+SI+9493H]
      MOV     SS, [SI+9695H]
      MOV     SS, [BP+9897H]
      MOV     SS, [BX+9998H]
      MOV     DS, [BX+SI+9A99H]
      MOV     DS, [BP+SI+9C9BH]
      MOV     DS, [SI+9E9DH]
      MOV     DS, [BP+0A09FH]
      MOV     DS, [BX+0A1A0H]
      MOV     ES, [BX+SI+0A2A1H]
      MOV     ES, [BP+SI+0A4A3H]
      MOV     ES, [SI+0A6A5H]
      MOV     ES, [BP+0A8A7H]
      MOV     ES, [BX+0A9A8H]
      MOV     CS, [BX+SI+0AAA9H]
      MOV     CS, [BP+SI+0ACABH]
      MOV     CS, [SI+0AEADH]
      MOV     CS, [BP+0B0AFH]
      MOV     ES, AX
      MOV     ES, CX
      MOV     ES, SP
      MOV     ES, SI
      MOV     CS, AX
      MOV     CS, CX
      MOV     CS, SP
      MOV     CS, SI
      MOV     SS, AX
      MOV     SS, CX
      MOV     SS, SP
      MOV     SS, SI
      MOV     DS, AX
      MOV     DS, CX
      MOV     DS, SP
      MOV     DS, SI
      MOV     ES, [BX+SI]
      MOV     ES, [BP+SI]
      MOV     ES, [SI]
      MOV     ES, [0807H]
      MOV     ES, [BX]
      MOV     CS, [BX+SI]
      MOV     CS, [BP+SI]
      MOV     CS, [SI]
      MOV     CS, [100FH]
      MOV     CS, [BX]
      MOV     SS, [BX+SI]
      MOV     SS, [BP+SI]
      MOV     SS, [SI]
      MOV     SS, [1817H]
      MOV     SS, [BX]
      MOV     DS, [BX+SI]
      MOV     DS, [BP+SI]
      MOV     DS, [SI]
      MOV     DS, [201FH]
      MOV     DS, [BX]
      MOV     ES, [BX+SI+65]
      MOV     ES, [BP+SI+67]
      MOV     ES, [SI+69]
      MOV     ES, [BP+71]
      MOV     ES, [BX+72]
      MOV     CS, [BX+SI+73]
      MOV     CS, [BP+SI+75]
      MOV     CS, [SI+77]
      MOV     CS, [BP+79]
      MOV     CS, [BX+80]
      MOV     SS, [BX+SI+81]
      MOV     SS, [BP+SI+83]
      MOV     SS, [SI+85]
      MOV     SS, [BP+87]
      MOV     SS, [BX+88]
      MOV     DS, [BX+SI+89]
      MOV     DS, [BP+SI+91]
      MOV     DS, [SI+93]
      MOV     DS, [BP+95]
      MOV     DS, [BX+96]
      POP     AX
      POP     CX
      POP     SP
      POP     SI
      POP     [BX+SI]
      POP     [BP+SI]
      POP     [SI]
      POP     [0807H]
      POP     [BX]
      POP     [BX+SI+65]
      POP     [BP+SI+67]
      POP     [SI+69]
      POP     [BP+71]
      POP     [BX+72]
      POP     [BX+SI+8281H]
      POP     [BP+SI+8483H]
      POP     [SI+8685H]
      POP     [BP+8887H]
      POP     [BX+8988H]
      NOP
      XCHG    AX, CX
      XCHG    AX, SP
      XCHG    AX, SI
      CBW
      CWD
      CALLF   9E9DH:9C9BH
      WAIT
      PUSHF
      POPF
      SAHF
      LAHF
      MOV     AL, [0A2A1H]
      MOV     AX, [0A3A2H]
      MOV     [0A4A3H], AL
      MOV     [0A5A4H], AX
      MOVSB
      MOVSW
      CMPSB
      CMPSW
      TEST    AX, 0ABAAH
      STOSB
      STOSW
      LODSB
      LODSW
      SCASB
      SCASW
      MOV     AX, 0BAB9H
      MOV     CX, 0BBBAH
      MOV     SP, 0BEBDH
      MOV     SI, 0C0BFH
      RET     50371
      RET
      LES     AX, [BX+SI]
      LES     AX, [BP+SI]
      LES     AX, [SI]
      LES     AX, [0807H]
      LES     AX, [BX]
      LES     CX, [BX+SI]
      LES     CX, [BP+SI]
      LES     CX, [SI]
      LES     CX, [100FH]
      LES     CX, [BX]
      LES     SP, [BX+SI]
      LES     SP, [BP+SI]
      LES     SP, [SI]
      LES     SP, [2827H]
      LES     SP, [BX]
      LES     SI, [BX+SI]
      LES     SI, [BP+SI]
      LES     SI, [SI]
      LES     SI, [3837H]
      LES     SI, [BX]
      LES     AX, [BX+SI+65]
      LES     AX, [BP+SI+67]
      LES     AX, [SI+69]
      LES     AX, [BP+71]
      LES     AX, [BX+72]
      LES     CX, [BX+SI+73]
      LES     CX, [BP+SI+75]
      LES     CX, [SI+77]
      LES     CX, [BP+79]
      LES     CX, [BX+80]
      LES     SP, [BX+SI+97]
      LES     SP, [BP+SI+99]
      LES     SP, [SI+101]
      LES     SP, [BP+103]
      LES     SP, [BX+104]
      LES     SI, [BX+SI+113]
      LES     SI, [BP+SI+115]
      LES     SI, [SI+117]
      LES     SI, [BP+119]
      LES     SI, [BX+120]
      LES     AX, [BX+SI+8281H]
      LES     AX, [BP+SI+8483H]
      LES     AX, [SI+8685H]
      LES     AX, [BP+8887H]
      LES     AX, [BX+8988H]
      LES     CX, [BX+SI+8A89H]
      LES     CX, [BP+SI+8C8BH]
      LES     CX, [SI+8E8DH]
      LES     CX, [BP+908FH]
      LES     CX, [BX+9190H]
      LES     SP, [BX+SI+0A2A1H]
      LES     SP, [BP+SI+0A4A3H]
      LES     SP, [SI+0A6A5H]
      LES     SP, [BP+0A8A7H]
      LES     SP, [BX+0A9A8H]
      LES     SI, [BX+SI+0B2B1H]
      LES     SI, [BP+SI+0B4B3H]
      LES     SI, [SI+0B6B5H]
      LES     SI, [BP+0B8B7H]
      LES     SI, [BX+0B9B8H]
      LDS     AX, [BX+SI]
      LDS     AX, [BP+SI]
      LDS     AX, [SI]
      LDS     AX, [0807H]
      LDS     AX, [BX]
      LDS     CX, [BX+SI]
      LDS     CX, [BP+SI]
      LDS     CX, [SI]
      LDS     CX, [100FH]
      LDS     CX, [BX]
      LDS     SP, [BX+SI]
      LDS     SP, [BP+SI]
      LDS     SP, [SI]
      LDS     SP, [2827H]
      LDS     SP, [BX]
      LDS     SI, [BX+SI]
      LDS     SI, [BP+SI]
      LDS     SI, [SI]
      LDS     SI, [3837H]
      LDS     SI, [BX]
      LDS     AX, [BX+SI+65]
      LDS     AX, [BP+SI+67]
      LDS     AX, [SI+69]
      LDS     AX, [BP+71]
      LDS     AX, [BX+72]
      LDS     CX, [BX+SI+73]
      LDS     CX, [BP+SI+75]
      LDS     CX, [SI+77]
      LDS     CX, [BP+79]
      LDS     CX, [BX+80]
      LDS     SP, [BX+SI+97]
      LDS     SP, [BP+SI+99]
      LDS     SP, [SI+101]
      LDS     SP, [BP+103]
      LDS     SP, [BX+104]
      LDS     SI, [BX+SI+113]
      LDS     SI, [BP+SI+115]
      LDS     SI, [SI+117]
      LDS     SI, [BP+119]
      LDS     SI, [BX+120]
      LDS     AX, [BX+SI+8281H]
      LDS     AX, [BP+SI+8483H]
      LDS     AX, [SI+8685H]
      LDS     AX, [BP+8887H]
      LDS     AX, [BX+8988H]
      LDS     CX, [BX+SI+8A89H]
      LDS     CX, [BP+SI+8C8BH]
      LDS     CX, [SI+8E8DH]
      LDS     CX, [BP+908FH]
      LDS     CX, [BX+9190H]
      LDS     SP, [BX+SI+0A2A1H]
      LDS     SP, [BP+SI+0A4A3H]
      LDS     SP, [SI+0A6A5H]
      LDS     SP, [BP+0A8A7H]
      LDS     SP, [BX+0A9A8H]
      LDS     SI, [BX+SI+0B2B1H]
      LDS     SI, [BP+SI+0B4B3H]
      LDS     SI, [SI+0B6B5H]
      LDS     SI, [BP+0B8B7H]
      LDS     SI, [BX+0B9B8H]
      MOV     BH, 0C8H
      MOV     BYTE PTR [BX+SI], 1
      MOV     BYTE PTR [BP+SI], 3
      MOV     BYTE PTR [SI], 5
      MOV     BYTE PTR [0807H], 9
      MOV     BYTE PTR [BX], 8
      MOV     BYTE PTR [BX+SI+65], 42H
      MOV     BYTE PTR [BP+SI+67], 44H
      MOV     BYTE PTR [SI+69], 46H
      MOV     BYTE PTR [BP+71], 48H
      MOV     BYTE PTR [BX+72], 49H
      MOV     BYTE PTR [BX+SI+8281H], 83H
      MOV     BYTE PTR [BP+SI+8483H], 85H
      MOV     BYTE PTR [SI+8685H], 87H
      MOV     BYTE PTR [BP+8887H], 89H
      MOV     BYTE PTR [BX+8988H], 8AH
      MOV     AL, 0C1H
      MOV     WORD PTR [BX+SI], 0201H
      MOV     WORD PTR [BP+SI], 0403H
      MOV     WORD PTR [SI], 0605H
      MOV     WORD PTR [0807H], 0A09H
      MOV     WORD PTR [BX], 0908H
      MOV     WORD PTR [BX+SI+65], 4342H
      MOV     WORD PTR [BP+SI+67], 4544H
      MOV     WORD PTR [SI+69], 4746H
      MOV     WORD PTR [BP+71], 4948H
      MOV     WORD PTR [BX+72], 4A49H
      MOV     WORD PTR [BX+SI+8281H], 8483H
      MOV     WORD PTR [BP+SI+8483H], 8685H
      MOV     WORD PTR [SI+8685H], 8887H
      MOV     WORD PTR [BP+8887H], 8A89H
      MOV     WORD PTR [BX+8988H], 8B8AH
      MOV     AX, 0C2C1H
      MOV     CX, 0C3C2H
      MOV     SP, 0C6C5H
      MOV     SI, 0C8C7H
      RETF    52427
      RETF
      INT     3
      INT     0CEH
      INTO
      IRET
      RCL     CL, 1
      RCL     AH, 1
      RCR     AL, 1
      RCR     AH, 1
      SHL     AL, 1
      SHL     AH, 1
      SHR     AL, 1
      SHR     AH, 1
      SAR     AL, 1
      SAR     AH, 1
      ROL     BYTE PTR [BX+SI], 1
      ROL     BYTE PTR [BP+SI], 1
      ROL     BYTE PTR [SI], 1
      ROL     BYTE PTR [0807H], 1
      ROL     BYTE PTR [BX], 1
      ROR     BYTE PTR [BX+SI], 1
      ROR     BYTE PTR [BP+SI], 1
      ROR     BYTE PTR [SI], 1
      ROR     BYTE PTR [100FH], 1
      ROR     BYTE PTR [BX], 1
      RCL     BYTE PTR [BX+SI], 1
      RCL     BYTE PTR [BP+SI], 1
      RCL     BYTE PTR [SI], 1
      RCL     BYTE PTR [1817H], 1
      RCL     BYTE PTR [BX], 1
      RCR     BYTE PTR [BX+SI], 1
      RCR     BYTE PTR [BP+SI], 1
      RCR     BYTE PTR [SI], 1
      RCR     BYTE PTR [201FH], 1
      RCR     BYTE PTR [BX], 1
      SHL     BYTE PTR [BX+SI], 1
      SHL     BYTE PTR [BP+SI], 1
      SHL     BYTE PTR [SI], 1
      SHL     BYTE PTR [2827H], 1
      SHL     BYTE PTR [BX], 1
      SHR     BYTE PTR [BX+SI], 1
      SHR     BYTE PTR [BP+SI], 1
      SHR     BYTE PTR [SI], 1
      SHR     BYTE PTR [302FH], 1
      SHR     BYTE PTR [BX], 1
      SAR     BYTE PTR [BX+SI], 1
      SAR     BYTE PTR [BP+SI], 1
      SAR     BYTE PTR [SI], 1
      SAR     BYTE PTR [403FH], 1
      SAR     BYTE PTR [BX], 1
      ROL     BYTE PTR [BX+SI+65], 1
      ROL     BYTE PTR [BP+SI+67], 1
      ROL     BYTE PTR [SI+69], 1
      ROL     BYTE PTR [BP+71], 1
      ROL     BYTE PTR [BX+72], 1
      ROR     BYTE PTR [BX+SI+73], 1
      ROR     BYTE PTR [BP+SI+75], 1
      ROR     BYTE PTR [SI+77], 1
      ROR     BYTE PTR [BP+79], 1
      ROR     BYTE PTR [BX+80], 1
      RCL     BYTE PTR [BX+SI+81], 1
      RCL     BYTE PTR [BP+SI+83], 1
      RCL     BYTE PTR [SI+85], 1
      RCL     BYTE PTR [BP+87], 1
      RCL     BYTE PTR [BX+88], 1
      RCR     BYTE PTR [BX+SI+89], 1
      RCR     BYTE PTR [BP+SI+91], 1
      RCR     BYTE PTR [SI+93], 1
      RCR     BYTE PTR [BP+95], 1
      RCR     BYTE PTR [BX+96], 1
      SHL     BYTE PTR [BX+SI+97], 1
      SHL     BYTE PTR [BP+SI+99], 1
      SHL     BYTE PTR [SI+101], 1
      SHL     BYTE PTR [BP+103], 1
      SHL     BYTE PTR [BX+104], 1
      SHR     BYTE PTR [BX+SI+105], 1
      SHR     BYTE PTR [BP+SI+107], 1
      SHR     BYTE PTR [SI+109], 1
      SHR     BYTE PTR [BP+111], 1
      SHR     BYTE PTR [BX+112], 1
      SAR     BYTE PTR [BX+SI+121], 1
      SAR     BYTE PTR [BP+SI+123], 1
      SAR     BYTE PTR [SI+125], 1
      SAR     BYTE PTR [BP+127], 1
      SAR     BYTE PTR [BX-128], 1
      ROL     BYTE PTR [BX+SI+8281H], 1
      ROL     BYTE PTR [BP+SI+8483H], 1
      ROL     BYTE PTR [SI+8685H], 1
      ROL     BYTE PTR [BP+8887H], 1
      ROL     BYTE PTR [BX+8988H], 1
      ROR     BYTE PTR [BX+SI+8A89H], 1
      ROR     BYTE PTR [BP+SI+8C8BH], 1
      ROR     BYTE PTR [SI+8E8DH], 1
      ROR     BYTE PTR [BP+908FH], 1
      ROR     BYTE PTR [BX+9190H], 1
      RCL     BYTE PTR [BX+SI+9291H], 1
      RCL     BYTE PTR [BP+SI+9493H], 1
      RCL     BYTE PTR [SI+9695H], 1
      RCL     BYTE PTR [BP+9897H], 1
      RCL     BYTE PTR [BX+9998H], 1
      RCR     BYTE PTR [BX+SI+9A99H], 1
      RCR     BYTE PTR [BP+SI+9C9BH], 1
      RCR     BYTE PTR [SI+9E9DH], 1
      RCR     BYTE PTR [BP+0A09FH], 1
      RCR     BYTE PTR [BX+0A1A0H], 1
      SHL     BYTE PTR [BX+SI+0A2A1H], 1
      SHL     BYTE PTR [BP+SI+0A4A3H], 1
      SHL     BYTE PTR [SI+0A6A5H], 1
      SHL     BYTE PTR [BP+0A8A7H], 1
      SHL     BYTE PTR [BX+0A9A8H], 1
      SHR     BYTE PTR [BX+SI+0AAA9H], 1
      SHR     BYTE PTR [BP+SI+0ACABH], 1
      SHR     BYTE PTR [SI+0AEADH], 1
      SHR     BYTE PTR [BP+0B0AFH], 1
      SHR     BYTE PTR [BX+0B1B0H], 1
      SAR     BYTE PTR [BX+SI+0BAB9H], 1
      SAR     BYTE PTR [BP+SI+0BCBBH], 1
      SAR     BYTE PTR [SI+0BEBDH], 1
      SAR     BYTE PTR [BP+0C0BFH], 1
      SAR     BYTE PTR [BX+0C1C0H], 1
      ROL     AL, 1
      ROL     AH, 1
      ROR     AL, 1
      ROR     AH, 1
      RCL     DX, 1
      RCL     SP, 1
      RCL     SI, 1
      RCR     AX, 1
      RCR     CX, 1
      RCR     SP, 1
      RCR     SI, 1
      SHL     AX, 1
      SHL     CX, 1
      SHL     SP, 1
      SHL     SI, 1
      SHR     AX, 1
      SHR     CX, 1
      SHR     SP, 1
      SHR     SI, 1
      SAR     AX, 1
      SAR     CX, 1
      SAR     SP, 1
      SAR     SI, 1
      ROL     WORD PTR [BX+SI], 1
      ROL     WORD PTR [BP+SI], 1
      ROL     WORD PTR [SI], 1
      ROL     WORD PTR [0807H], 1
      ROL     WORD PTR [BX], 1
      ROR     WORD PTR [BX+SI], 1
      ROR     WORD PTR [BP+SI], 1
      ROR     WORD PTR [SI], 1
      ROR     WORD PTR [100FH], 1
      ROR     WORD PTR [BX], 1
      RCL     WORD PTR [BX+SI], 1
      RCL     WORD PTR [BP+SI], 1
      RCL     WORD PTR [SI], 1
      RCL     WORD PTR [1817H], 1
      RCL     WORD PTR [BX], 1
      RCR     WORD PTR [BX+SI], 1
      RCR     WORD PTR [BP+SI], 1
      RCR     WORD PTR [SI], 1
      RCR     WORD PTR [201FH], 1
      RCR     WORD PTR [BX], 1
      SHL     WORD PTR [BX+SI], 1
      SHL     WORD PTR [BP+SI], 1
      SHL     WORD PTR [SI], 1
      SHL     WORD PTR [2827H], 1
      SHL     WORD PTR [BX], 1
      SHR     WORD PTR [BX+SI], 1
      SHR     WORD PTR [BP+SI], 1
      SHR     WORD PTR [SI], 1
      SHR     WORD PTR [302FH], 1
      SHR     WORD PTR [BX], 1
      SAR     WORD PTR [BX+SI], 1
      SAR     WORD PTR [BP+SI], 1
      SAR     WORD PTR [SI], 1
      SAR     WORD PTR [403FH], 1
      SAR     WORD PTR [BX], 1
      ROL     WORD PTR [BX+SI+65], 1
      ROL     WORD PTR [BP+SI+67], 1
      ROL     WORD PTR [SI+69], 1
      ROL     WORD PTR [BP+71], 1
      ROL     WORD PTR [BX+72], 1
      ROR     WORD PTR [BX+SI+73], 1
      ROR     WORD PTR [BP+SI+75], 1
      ROR     WORD PTR [SI+77], 1
      ROR     WORD PTR [BP+79], 1
      ROR     WORD PTR [BX+80], 1
      RCL     WORD PTR [BX+SI+81], 1
      RCL     WORD PTR [BP+SI+83], 1
      RCL     WORD PTR [SI+85], 1
      RCL     WORD PTR [BP+87], 1
      RCL     WORD PTR [BX+88], 1
      RCR     WORD PTR [BX+SI+89], 1
      RCR     WORD PTR [BP+SI+91], 1
      RCR     WORD PTR [SI+93], 1
      RCR     WORD PTR [BP+95], 1
      RCR     WORD PTR [BX+96], 1
      SHL     WORD PTR [BX+SI+97], 1
      SHL     WORD PTR [BP+SI+99], 1
      SHL     WORD PTR [SI+101], 1
      SHL     WORD PTR [BP+103], 1
      SHL     WORD PTR [BX+104], 1
      SHR     WORD PTR [BX+SI+105], 1
      SHR     WORD PTR [BP+SI+107], 1
      SHR     WORD PTR [SI+109], 1
      SHR     WORD PTR [BP+111], 1
      SHR     WORD PTR [BX+112], 1
      SAR     WORD PTR [BX+SI+121], 1
      SAR     WORD PTR [BP+SI+123], 1
      SAR     WORD PTR [SI+125], 1
      SAR     WORD PTR [BP+127], 1
      SAR     WORD PTR [BX-128], 1
      ROL     WORD PTR [BX+SI+8281H], 1
      ROL     WORD PTR [BP+SI+8483H], 1
      ROL     WORD PTR [SI+8685H], 1
      ROL     WORD PTR [BP+8887H], 1
      ROL     WORD PTR [BX+8988H], 1
      ROR     WORD PTR [BX+SI+8A89H], 1
      ROR     WORD PTR [BP+SI+8C8BH], 1
      ROR     WORD PTR [SI+8E8DH], 1
      ROR     WORD PTR [BP+908FH], 1
      ROR     WORD PTR [BX+9190H], 1
      RCL     WORD PTR [BX+SI+9291H], 1
      RCL     WORD PTR [BP+SI+9493H], 1
      RCL     WORD PTR [SI+9695H], 1
      RCL     WORD PTR [BP+9897H], 1
      RCL     WORD PTR [BX+9998H], 1
      RCR     WORD PTR [BX+SI+9A99H], 1
      RCR     WORD PTR [BP+SI+9C9BH], 1
      RCR     WORD PTR [SI+9E9DH], 1
      RCR     WORD PTR [BP+0A09FH], 1
      RCR     WORD PTR [BX+0A1A0H], 1
      SHL     WORD PTR [BX+SI+0A2A1H], 1
      SHL     WORD PTR [BP+SI+0A4A3H], 1
      SHL     WORD PTR [SI+0A6A5H], 1
      SHL     WORD PTR [BP+0A8A7H], 1
      SHL     WORD PTR [BX+0A9A8H], 1
      SHR     WORD PTR [BX+SI+0AAA9H], 1
      SHR     WORD PTR [BP+SI+0ACABH], 1
      SHR     WORD PTR [SI+0AEADH], 1
      SHR     WORD PTR [BP+0B0AFH], 1
      SHR     WORD PTR [BX+0B1B0H], 1
      SAR     WORD PTR [BX+SI+0BAB9H], 1
      SAR     WORD PTR [BP+SI+0BCBBH], 1
      SAR     WORD PTR [SI+0BEBDH], 1
      SAR     WORD PTR [BP+0C0BFH], 1
      SAR     WORD PTR [BX+0C1C0H], 1
      ROL     AX, 1
      ROL     CX, 1
      ROL     SP, 1
      ROL     SI, 1
      ROR     AX, 1
      ROR     CX, 1
      ROR     SP, 1
      ROR     SI, 1
      RCL     AX, 1
      RCL     BL, CL
      RCL     AH, CL
      RCR     AL, CL
      RCR     AH, CL
      SHL     AL, CL
      SHL     AH, CL
      SHR     AL, CL
      SHR     AH, CL
      SAR     AL, CL
      SAR     AH, CL
      ROL     BYTE PTR [BX+SI], CL
      ROL     BYTE PTR [BP+SI], CL
      ROL     BYTE PTR [SI], CL
      ROL     BYTE PTR [0807H], CL
      ROL     BYTE PTR [BX], CL
      ROR     BYTE PTR [BX+SI], CL
      ROR     BYTE PTR [BP+SI], CL
      ROR     BYTE PTR [SI], CL
      ROR     BYTE PTR [100FH], CL
      ROR     BYTE PTR [BX], CL
      RCL     BYTE PTR [BX+SI], CL
      RCL     BYTE PTR [BP+SI], CL
      RCL     BYTE PTR [SI], CL
      RCL     BYTE PTR [1817H], CL
      RCL     BYTE PTR [BX], CL
      RCR     BYTE PTR [BX+SI], CL
      RCR     BYTE PTR [BP+SI], CL
      RCR     BYTE PTR [SI], CL
      RCR     BYTE PTR [201FH], CL
      RCR     BYTE PTR [BX], CL
      SHL     BYTE PTR [BX+SI], CL
      SHL     BYTE PTR [BP+SI], CL
      SHL     BYTE PTR [SI], CL
      SHL     BYTE PTR [2827H], CL
      SHL     BYTE PTR [BX], CL
      SHR     BYTE PTR [BX+SI], CL
      SHR     BYTE PTR [BP+SI], CL
      SHR     BYTE PTR [SI], CL
      SHR     BYTE PTR [302FH], CL
      SHR     BYTE PTR [BX], CL
      SAR     BYTE PTR [BX+SI], CL
      SAR     BYTE PTR [BP+SI], CL
      SAR     BYTE PTR [SI], CL
      SAR     BYTE PTR [403FH], CL
      SAR     BYTE PTR [BX], CL
      ROL     BYTE PTR [BX+SI+65], CL
      ROL     BYTE PTR [BP+SI+67], CL
      ROL     BYTE PTR [SI+69], CL
      ROL     BYTE PTR [BP+71], CL
      ROL     BYTE PTR [BX+72], CL
      ROR     BYTE PTR [BX+SI+73], CL
      ROR     BYTE PTR [BP+SI+75], CL
      ROR     BYTE PTR [SI+77], CL
      ROR     BYTE PTR [BP+79], CL
      ROR     BYTE PTR [BX+80], CL
      RCL     BYTE PTR [BX+SI+81], CL
      RCL     BYTE PTR [BP+SI+83], CL
      RCL     BYTE PTR [SI+85], CL
      RCL     BYTE PTR [BP+87], CL
      RCL     BYTE PTR [BX+88], CL
      RCR     BYTE PTR [BX+SI+89], CL
      RCR     BYTE PTR [BP+SI+91], CL
      RCR     BYTE PTR [SI+93], CL
      RCR     BYTE PTR [BP+95], CL
      RCR     BYTE PTR [BX+96], CL
      SHL     BYTE PTR [BX+SI+97], CL
      SHL     BYTE PTR [BP+SI+99], CL
      SHL     BYTE PTR [SI+101], CL
      SHL     BYTE PTR [BP+103], CL
      SHL     BYTE PTR [BX+104], CL
      SHR     BYTE PTR [BX+SI+105], CL
      SHR     BYTE PTR [BP+SI+107], CL
      SHR     BYTE PTR [SI+109], CL
      SHR     BYTE PTR [BP+111], CL
      SHR     BYTE PTR [BX+112], CL
      SAR     BYTE PTR [BX+SI+121], CL
      SAR     BYTE PTR [BP+SI+123], CL
      SAR     BYTE PTR [SI+125], CL
      SAR     BYTE PTR [BP+127], CL
      SAR     BYTE PTR [BX-128], CL
      ROL     BYTE PTR [BX+SI+8281H], CL
      ROL     BYTE PTR [BP+SI+8483H], CL
      ROL     BYTE PTR [SI+8685H], CL
      ROL     BYTE PTR [BP+8887H], CL
      ROL     BYTE PTR [BX+8988H], CL
      ROR     BYTE PTR [BX+SI+8A89H], CL
      ROR     BYTE PTR [BP+SI+8C8BH], CL
      ROR     BYTE PTR [SI+8E8DH], CL
      ROR     BYTE PTR [BP+908FH], CL
      ROR     BYTE PTR [BX+9190H], CL
      RCL     BYTE PTR [BX+SI+9291H], CL
      RCL     BYTE PTR [BP+SI+9493H], CL
      RCL     BYTE PTR [SI+9695H], CL
      RCL     BYTE PTR [BP+9897H], CL
      RCL     BYTE PTR [BX+9998H], CL
      RCR     BYTE PTR [BX+SI+9A99H], CL
      RCR     BYTE PTR [BP+SI+9C9BH], CL
      RCR     BYTE PTR [SI+9E9DH], CL
      RCR     BYTE PTR [BP+0A09FH], CL
      RCR     BYTE PTR [BX+0A1A0H], CL
      SHL     BYTE PTR [BX+SI+0A2A1H], CL
      SHL     BYTE PTR [BP+SI+0A4A3H], CL
      SHL     BYTE PTR [SI+0A6A5H], CL
      SHL     BYTE PTR [BP+0A8A7H], CL
      SHL     BYTE PTR [BX+0A9A8H], CL
      SHR     BYTE PTR [BX+SI+0AAA9H], CL
      SHR     BYTE PTR [BP+SI+0ACABH], CL
      SHR     BYTE PTR [SI+0AEADH], CL
      SHR     BYTE PTR [BP+0B0AFH], CL
      SHR     BYTE PTR [BX+0B1B0H], CL
      SAR     BYTE PTR [BX+SI+0BAB9H], CL
      SAR     BYTE PTR [BP+SI+0BCBBH], CL
      SAR     BYTE PTR [SI+0BEBDH], CL
      SAR     BYTE PTR [BP+0C0BFH], CL
      SAR     BYTE PTR [BX+0C1C0H], CL
      ROL     AL, CL
      ROL     AH, CL
      ROR     AL, CL
      ROR     AH, CL
      RCL     SP, CL
      RCL     SI, CL
      RCR     AX, CL
      RCR     CX, CL
      RCR     SP, CL
      RCR     SI, CL
      SHL     AX, CL
      SHL     CX, CL
      SHL     SP, CL
      SHL     SI, CL
      SHR     AX, CL
      SHR     CX, CL
      SHR     SP, CL
      SHR     SI, CL
      SAR     AX, CL
      SAR     CX, CL
      SAR     SP, CL
      SAR     SI, CL
      ROL     WORD PTR [BX+SI], CL
      ROL     WORD PTR [BP+SI], CL
      ROL     WORD PTR [SI], CL
      ROL     WORD PTR [0807H], CL
      ROL     WORD PTR [BX], CL
      ROR     WORD PTR [BX+SI], CL
      ROR     WORD PTR [BP+SI], CL
      ROR     WORD PTR [SI], CL
      ROR     WORD PTR [100FH], CL
      ROR     WORD PTR [BX], CL
      RCL     WORD PTR [BX+SI], CL
      RCL     WORD PTR [BP+SI], CL
      RCL     WORD PTR [SI], CL
      RCL     WORD PTR [1817H], CL
      RCL     WORD PTR [BX], CL
      RCR     WORD PTR [BX+SI], CL
      RCR     WORD PTR [BP+SI], CL
      RCR     WORD PTR [SI], CL
      RCR     WORD PTR [201FH], CL
      RCR     WORD PTR [BX], CL
      SHL     WORD PTR [BX+SI], CL
      SHL     WORD PTR [BP+SI], CL
      SHL     WORD PTR [SI], CL
      SHL     WORD PTR [2827H], CL
      SHL     WORD PTR [BX], CL
      SHR     WORD PTR [BX+SI], CL
      SHR     WORD PTR [BP+SI], CL
      SHR     WORD PTR [SI], CL
      SHR     WORD PTR [302FH], CL
      SHR     WORD PTR [BX], CL
      SAR     WORD PTR [BX+SI], CL
      SAR     WORD PTR [BP+SI], CL
      SAR     WORD PTR [SI], CL
      SAR     WORD PTR [403FH], CL
      SAR     WORD PTR [BX], CL
      ROL     WORD PTR [BX+SI+65], CL
      ROL     WORD PTR [BP+SI+67], CL
      ROL     WORD PTR [SI+69], CL
      ROL     WORD PTR [BP+71], CL
      ROL     WORD PTR [BX+72], CL
      ROR     WORD PTR [BX+SI+73], CL
      ROR     WORD PTR [BP+SI+75], CL
      ROR     WORD PTR [SI+77], CL
      ROR     WORD PTR [BP+79], CL
      ROR     WORD PTR [BX+80], CL
      RCL     WORD PTR [BX+SI+81], CL
      RCL     WORD PTR [BP+SI+83], CL
      RCL     WORD PTR [SI+85], CL
      RCL     WORD PTR [BP+87], CL
      RCL     WORD PTR [BX+88], CL
      RCR     WORD PTR [BX+SI+89], CL
      RCR     WORD PTR [BP+SI+91], CL
      RCR     WORD PTR [SI+93], CL
      RCR     WORD PTR [BP+95], CL
      RCR     WORD PTR [BX+96], CL
      SHL     WORD PTR [BX+SI+97], CL
      SHL     WORD PTR [BP+SI+99], CL
      SHL     WORD PTR [SI+101], CL
      SHL     WORD PTR [BP+103], CL
      SHL     WORD PTR [BX+104], CL
      SHR     WORD PTR [BX+SI+105], CL
      SHR     WORD PTR [BP+SI+107], CL
      SHR     WORD PTR [SI+109], CL
      SHR     WORD PTR [BP+111], CL
      SHR     WORD PTR [BX+112], CL
      SAR     WORD PTR [BX+SI+121], CL
      SAR     WORD PTR [BP+SI+123], CL
      SAR     WORD PTR [SI+125], CL
      SAR     WORD PTR [BP+127], CL
      SAR     WORD PTR [BX-128], CL
      ROL     WORD PTR [BX+SI+8281H], CL
      ROL     WORD PTR [BP+SI+8483H], CL
      ROL     WORD PTR [SI+8685H], CL
      ROL     WORD PTR [BP+8887H], CL
      ROL     WORD PTR [BX+8988H], CL
      ROR     WORD PTR [BX+SI+8A89H], CL
      ROR     WORD PTR [BP+SI+8C8BH], CL
      ROR     WORD PTR [SI+8E8DH], CL
      ROR     WORD PTR [BP+908FH], CL
      ROR     WORD PTR [BX+9190H], CL
      RCL     WORD PTR [BX+SI+9291H], CL
      RCL     WORD PTR [BP+SI+9493H], CL
      RCL     WORD PTR [SI+9695H], CL
      RCL     WORD PTR [BP+9897H], CL
      RCL     WORD PTR [BX+9998H], CL
      RCR     WORD PTR [BX+SI+9A99H], CL
      RCR     WORD PTR [BP+SI+9C9BH], CL
      RCR     WORD PTR [SI+9E9DH], CL
      RCR     WORD PTR [BP+0A09FH], CL
      RCR     WORD PTR [BX+0A1A0H], CL
      SHL     WORD PTR [BX+SI+0A2A1H], CL
      SHL     WORD PTR [BP+SI+0A4A3H], CL
      SHL     WORD PTR [SI+0A6A5H], CL
      SHL     WORD PTR [BP+0A8A7H], CL
      SHL     WORD PTR [BX+0A9A8H], CL
      SHR     WORD PTR [BX+SI+0AAA9H], CL
      SHR     WORD PTR [BP+SI+0ACABH], CL
      SHR     WORD PTR [SI+0AEADH], CL
      SHR     WORD PTR [BP+0B0AFH], CL
      SHR     WORD PTR [BX+0B1B0H], CL
      SAR     WORD PTR [BX+SI+0BAB9H], CL
      SAR     WORD PTR [BP+SI+0BCBBH], CL
      SAR     WORD PTR [SI+0BEBDH], CL
      SAR     WORD PTR [BP+0C0BFH], CL
      SAR     WORD PTR [BX+0C1C0H], CL
      ROL     AX, CL
      ROL     CX, CL
      ROL     SP, CL
      ROL     SI, CL
      ROR     AX, CL
      ROR     CX, CL
      ROR     SP, CL
      ROR     SI, CL
      RCL     AX, CL
      RCL     CX, CL
      AAM
      AAD
      XLAT
      FCOMP   ST(1)
      FSUB    ST, ST(0)
      FSUBR   ST, ST(0)
      FDIV    ST, ST(0)
      FDIVR   ST, ST(0)
      FADD    DWORD PTR [BX+SI]
      FADD    DWORD PTR [BP+SI]
      FADD    DWORD PTR [SI]
      FADD    DWORD PTR [0807H]
      FADD    DWORD PTR [BX]
      FMUL    DWORD PTR [BX+SI]
      FMUL    DWORD PTR [BP+SI]
      FMUL    DWORD PTR [SI]
      FMUL    DWORD PTR [100FH]
      FMUL    DWORD PTR [BX]
      FCOM    DWORD PTR [BX+SI]
      FCOM    DWORD PTR [BP+SI]
      FCOM    DWORD PTR [SI]
      FCOM    DWORD PTR [1817H]
      FCOM    DWORD PTR [BX]
      FCOMP   DWORD PTR [BX+SI]
      FCOMP   DWORD PTR [BP+SI]
      FCOMP   DWORD PTR [SI]
      FCOMP   DWORD PTR [201FH]
      FCOMP   DWORD PTR [BX]
      FSUB    DWORD PTR [BX+SI]
      FSUB    DWORD PTR [BP+SI]
      FSUB    DWORD PTR [SI]
      FSUB    DWORD PTR [2827H]
      FSUB    DWORD PTR [BX]
      FSUBR   DWORD PTR [BX+SI]
      FSUBR   DWORD PTR [BP+SI]
      FSUBR   DWORD PTR [SI]
      FSUBR   DWORD PTR [302FH]
      FSUBR   DWORD PTR [BX]
      FDIV    DWORD PTR [BX+SI]
      FDIV    DWORD PTR [BP+SI]
      FDIV    DWORD PTR [SI]
      FDIV    DWORD PTR [3837H]
      FDIV    DWORD PTR [BX]
      FDIVR   DWORD PTR [BX+SI]
      FDIVR   DWORD PTR [BP+SI]
      FDIVR   DWORD PTR [SI]
      FDIVR   DWORD PTR [403FH]
      FDIVR   DWORD PTR [BX]
      FADD    DWORD PTR [BX+SI+65]
      FADD    DWORD PTR [BP+SI+67]
      FADD    DWORD PTR [SI+69]
      FADD    DWORD PTR [BP+71]
      FADD    DWORD PTR [BX+72]
      FMUL    DWORD PTR [BX+SI+73]
      FMUL    DWORD PTR [BP+SI+75]
      FMUL    DWORD PTR [SI+77]
      FMUL    DWORD PTR [BP+79]
      FMUL    DWORD PTR [BX+80]
      FCOM    DWORD PTR [BX+SI+81]
      FCOM    DWORD PTR [BP+SI+83]
      FCOM    DWORD PTR [SI+85]
      FCOM    DWORD PTR [BP+87]
      FCOM    DWORD PTR [BX+88]
      FCOMP   DWORD PTR [BX+SI+89]
      FCOMP   DWORD PTR [BP+SI+91]
      FCOMP   DWORD PTR [SI+93]
      FCOMP   DWORD PTR [BP+95]
      FCOMP   DWORD PTR [BX+96]
      FSUB    DWORD PTR [BX+SI+97]
      FSUB    DWORD PTR [BP+SI+99]
      FSUB    DWORD PTR [SI+101]
      FSUB    DWORD PTR [BP+103]
      FSUB    DWORD PTR [BX+104]
      FSUBR   DWORD PTR [BX+SI+105]
      FSUBR   DWORD PTR [BP+SI+107]
      FSUBR   DWORD PTR [SI+109]
      FSUBR   DWORD PTR [BP+111]
      FSUBR   DWORD PTR [BX+112]
      FDIV    DWORD PTR [BX+SI+113]
      FDIV    DWORD PTR [BP+SI+115]
      FDIV    DWORD PTR [SI+117]
      FDIV    DWORD PTR [BP+119]
      FDIV    DWORD PTR [BX+120]
      FDIVR   DWORD PTR [BX+SI+121]
      FDIVR   DWORD PTR [BP+SI+123]
      FDIVR   DWORD PTR [SI+125]
      FDIVR   DWORD PTR [BP+127]
      FDIVR   DWORD PTR [BX-128]
      FADD    DWORD PTR [BX+SI+8281H]
      FADD    DWORD PTR [BP+SI+8483H]
      FADD    DWORD PTR [SI+8685H]
      FADD    DWORD PTR [BP+8887H]
      FADD    DWORD PTR [BX+8988H]
      FMUL    DWORD PTR [BX+SI+8A89H]
      FMUL    DWORD PTR [BP+SI+8C8BH]
      FMUL    DWORD PTR [SI+8E8DH]
      FMUL    DWORD PTR [BP+908FH]
      FMUL    DWORD PTR [BX+9190H]
      FCOM    DWORD PTR [BX+SI+9291H]
      FCOM    DWORD PTR [BP+SI+9493H]
      FCOM    DWORD PTR [SI+9695H]
      FCOM    DWORD PTR [BP+9897H]
      FCOM    DWORD PTR [BX+9998H]
      FCOMP   DWORD PTR [BX+SI+9A99H]
      FCOMP   DWORD PTR [BP+SI+9C9BH]
      FCOMP   DWORD PTR [SI+9E9DH]
      FCOMP   DWORD PTR [BP+0A09FH]
      FCOMP   DWORD PTR [BX+0A1A0H]
      FSUB    DWORD PTR [BX+SI+0A2A1H]
      FSUB    DWORD PTR [BP+SI+0A4A3H]
      FSUB    DWORD PTR [SI+0A6A5H]
      FSUB    DWORD PTR [BP+0A8A7H]
      FSUB    DWORD PTR [BX+0A9A8H]
      FSUBR   DWORD PTR [BX+SI+0AAA9H]
      FSUBR   DWORD PTR [BP+SI+0ACABH]
      FSUBR   DWORD PTR [SI+0AEADH]
      FSUBR   DWORD PTR [BP+0B0AFH]
      FSUBR   DWORD PTR [BX+0B1B0H]
      FDIV    DWORD PTR [BX+SI+0B2B1H]
      FDIV    DWORD PTR [BP+SI+0B4B3H]
      FDIV    DWORD PTR [SI+0B6B5H]
      FDIV    DWORD PTR [BP+0B8B7H]
      FDIV    DWORD PTR [BX+0B9B8H]
      FDIVR   DWORD PTR [BX+SI+0BAB9H]
      FDIVR   DWORD PTR [BP+SI+0BCBBH]
      FDIVR   DWORD PTR [SI+0BEBDH]
      FDIVR   DWORD PTR [BP+0C0BFH]
      FDIVR   DWORD PTR [BX+0C1C0H]
      FADD    ST, ST(0)
      FMUL    ST, ST(0)
      FCOM    ST(0)
      FCHS
      FABS
      FTST
      FXAM
      FLD1
      FLDL2T
      FLDL2E
      FLDPI
      FLDLG2
      FLDLN2
      FLDZ
      F2XM1
      FYL2X
      FPTAN
      FPATAN
      FXTRACT
      FDECSTP
      FINCSTP
      FPREM
      FYL2XP1
      FSQRT
      FRNDINT
      FSCALE
      FLD     DWORD PTR [BX+SI]
      FLD     DWORD PTR [BP+SI]
      FLD     DWORD PTR [SI]
      FLD     DWORD PTR [0807H]
      FLD     DWORD PTR [BX]
      FST     DWORD PTR [BX+SI]
      FST     DWORD PTR [BP+SI]
      FST     DWORD PTR [SI]
      FST     DWORD PTR [1817H]
      FST     DWORD PTR [BX]
      FSTP    DWORD PTR [BX+SI]
      FSTP    DWORD PTR [BP+SI]
      FSTP    DWORD PTR [SI]
      FSTP    DWORD PTR [201FH]
      FSTP    DWORD PTR [BX]
      FLDENV  [BX+SI]
      FLDENV  [BP+SI]
      FLDENV  [SI]
      FLDENV  [2827H]
      FLDENV  [BX]
      FLDCW   [BX+SI]
      FLDCW   [BP+SI]
      FLDCW   [SI]
      FLDCW   [302FH]
      FLDCW   [BX]
      FNSTENV [BX+SI]
      FNSTENV [BP+SI]
      FNSTENV [SI]
      FNSTENV [3837H]
      FNSTENV [BX]
      FNSTCW  [BX+SI]
      FNSTCW  [BP+SI]
      FNSTCW  [SI]
      FNSTCW  [403FH]
      FNSTCW  [BX]
      FLD     DWORD PTR [BX+SI+65]
      FLD     DWORD PTR [BP+SI+67]
      FLD     DWORD PTR [SI+69]
      FLD     DWORD PTR [BP+71]
      FLD     DWORD PTR [BX+72]
      FST     DWORD PTR [BX+SI+81]
      FST     DWORD PTR [BP+SI+83]
      FST     DWORD PTR [SI+85]
      FST     DWORD PTR [BP+87]
      FST     DWORD PTR [BX+88]
      FSTP    DWORD PTR [BX+SI+89]
      FSTP    DWORD PTR [BP+SI+91]
      FSTP    DWORD PTR [SI+93]
      FSTP    DWORD PTR [BP+95]
      FSTP    DWORD PTR [BX+96]
      FLDENV  [BX+SI+97]
      FLDENV  [BP+SI+99]
      FLDENV  [SI+101]
      FLDENV  [BP+103]
      FLDENV  [BX+104]
      FLDCW   [BX+SI+105]
      FLDCW   [BP+SI+107]
      FLDCW   [SI+109]
      FLDCW   [BP+111]
      FLDCW   [BX+112]
      FNSTENV [BX+SI+113]
      FNSTENV [BP+SI+115]
      FNSTENV [SI+117]
      FNSTENV [BP+119]
      FNSTENV [BX+120]
      FNSTCW  [BX+SI+121]
      FNSTCW  [BP+SI+123]
      FNSTCW  [SI+125]
      FNSTCW  [BP+127]
      FNSTCW  [BX-128]
      FLD     DWORD PTR [BX+SI+8281H]
      FLD     DWORD PTR [BP+SI+8483H]
      FLD     DWORD PTR [SI+8685H]
      FLD     DWORD PTR [BP+8887H]
      FLD     DWORD PTR [BX+8988H]
      FST     DWORD PTR [BX+SI+9291H]
      FST     DWORD PTR [BP+SI+9493H]
      FST     DWORD PTR [SI+9695H]
      FST     DWORD PTR [BP+9897H]
      FST     DWORD PTR [BX+9998H]
      FSTP    DWORD PTR [BX+SI+9A99H]
      FSTP    DWORD PTR [BP+SI+9C9BH]
      FSTP    DWORD PTR [SI+9E9DH]
      FSTP    DWORD PTR [BP+0A09FH]
      FSTP    DWORD PTR [BX+0A1A0H]
      FLDENV  [BX+SI+0A2A1H]
      FLDENV  [BP+SI+0A4A3H]
      FLDENV  [SI+0A6A5H]
      FLDENV  [BP+0A8A7H]
      FLDENV  [BX+0A9A8H]
      FLDCW   [BX+SI+0AAA9H]
      FLDCW   [BP+SI+0ACABH]
      FLDCW   [SI+0AEADH]
      FLDCW   [BP+0B0AFH]
      FLDCW   [BX+0B1B0H]
      FNSTENV [BX+SI+0B2B1H]
      FNSTENV [BP+SI+0B4B3H]
      FNSTENV [SI+0B6B5H]
      FNSTENV [BP+0B8B7H]
      FNSTENV [BX+0B9B8H]
      FNSTCW  [BX+SI+0BAB9H]
      FNSTCW  [BP+SI+0BCBBH]
      FNSTCW  [SI+0BEBDH]
      FNSTCW  [BP+0C0BFH]
      FNSTCW  [BX+0C1C0H]
      FLD     ST(0)
      FXCH    ST(0)
      FNOP
      FIADD   DWORD PTR [BX+SI]
      FIADD   DWORD PTR [BP+SI]
      FIADD   DWORD PTR [SI]
      FIADD   DWORD PTR [0807H]
      FIADD   DWORD PTR [BX]
      FIMUL   DWORD PTR [BX+SI]
      FIMUL   DWORD PTR [BP+SI]
      FIMUL   DWORD PTR [SI]
      FIMUL   DWORD PTR [100FH]
      FIMUL   DWORD PTR [BX]
      FICOM   DWORD PTR [BX+SI]
      FICOM   DWORD PTR [BP+SI]
      FICOM   DWORD PTR [SI]
      FICOM   DWORD PTR [1817H]
      FICOM   DWORD PTR [BX]
      FICOMP  DWORD PTR [BX+SI]
      FICOMP  DWORD PTR [BP+SI]
      FICOMP  DWORD PTR [SI]
      FICOMP  DWORD PTR [201FH]
      FICOMP  DWORD PTR [BX]
      FISUB   DWORD PTR [BX+SI]
      FISUB   DWORD PTR [BP+SI]
      FISUB   DWORD PTR [SI]
      FISUB   DWORD PTR [2827H]
      FISUB   DWORD PTR [BX]
      FISUBR  DWORD PTR [BX+SI]
      FISUBR  DWORD PTR [BP+SI]
      FISUBR  DWORD PTR [SI]
      FISUBR  DWORD PTR [302FH]
      FISUBR  DWORD PTR [BX]
      FIDIV   DWORD PTR [BX+SI]
      FIDIV   DWORD PTR [BP+SI]
      FIDIV   DWORD PTR [SI]
      FIDIV   DWORD PTR [3837H]
      FIDIV   DWORD PTR [BX]
      FIDIVR  DWORD PTR [BX+SI]
      FIDIVR  DWORD PTR [BP+SI]
      FIDIVR  DWORD PTR [SI]
      FIDIVR  DWORD PTR [403FH]
      FIDIVR  DWORD PTR [BX]
      FIADD   DWORD PTR [BX+SI+65]
      FIADD   DWORD PTR [BP+SI+67]
      FIADD   DWORD PTR [SI+69]
      FIADD   DWORD PTR [BP+71]
      FIADD   DWORD PTR [BX+72]
      FIMUL   DWORD PTR [BX+SI+73]
      FIMUL   DWORD PTR [BP+SI+75]
      FIMUL   DWORD PTR [SI+77]
      FIMUL   DWORD PTR [BP+79]
      FIMUL   DWORD PTR [BX+80]
      FICOM   DWORD PTR [BX+SI+81]
      FICOM   DWORD PTR [BP+SI+83]
      FICOM   DWORD PTR [SI+85]
      FICOM   DWORD PTR [BP+87]
      FICOM   DWORD PTR [BX+88]
      FICOMP  DWORD PTR [BX+SI+89]
      FICOMP  DWORD PTR [BP+SI+91]
      FICOMP  DWORD PTR [SI+93]
      FICOMP  DWORD PTR [BP+95]
      FICOMP  DWORD PTR [BX+96]
      FISUB   DWORD PTR [BX+SI+97]
      FISUB   DWORD PTR [BP+SI+99]
      FISUB   DWORD PTR [SI+101]
      FISUB   DWORD PTR [BP+103]
      FISUB   DWORD PTR [BX+104]
      FISUBR  DWORD PTR [BX+SI+105]
      FISUBR  DWORD PTR [BP+SI+107]
      FISUBR  DWORD PTR [SI+109]
      FISUBR  DWORD PTR [BP+111]
      FISUBR  DWORD PTR [BX+112]
      FIDIV   DWORD PTR [BX+SI+113]
      FIDIV   DWORD PTR [BP+SI+115]
      FIDIV   DWORD PTR [SI+117]
      FIDIV   DWORD PTR [BP+119]
      FIDIV   DWORD PTR [BX+120]
      FIDIVR  DWORD PTR [BX+SI+121]
      FIDIVR  DWORD PTR [BP+SI+123]
      FIDIVR  DWORD PTR [SI+125]
      FIDIVR  DWORD PTR [BP+127]
      FIDIVR  DWORD PTR [BX-128]
      FIADD   DWORD PTR [BX+SI+8281H]
      FIADD   DWORD PTR [BP+SI+8483H]
      FIADD   DWORD PTR [SI+8685H]
      FIADD   DWORD PTR [BP+8887H]
      FIADD   DWORD PTR [BX+8988H]
      FIMUL   DWORD PTR [BX+SI+8A89H]
      FIMUL   DWORD PTR [BP+SI+8C8BH]
      FIMUL   DWORD PTR [SI+8E8DH]
      FIMUL   DWORD PTR [BP+908FH]
      FIMUL   DWORD PTR [BX+9190H]
      FICOM   DWORD PTR [BX+SI+9291H]
      FICOM   DWORD PTR [BP+SI+9493H]
      FICOM   DWORD PTR [SI+9695H]
      FICOM   DWORD PTR [BP+9897H]
      FICOM   DWORD PTR [BX+9998H]
      FICOMP  DWORD PTR [BX+SI+9A99H]
      FICOMP  DWORD PTR [BP+SI+9C9BH]
      FICOMP  DWORD PTR [SI+9E9DH]
      FICOMP  DWORD PTR [BP+0A09FH]
      FICOMP  DWORD PTR [BX+0A1A0H]
      FISUB   DWORD PTR [BX+SI+0A2A1H]
      FISUB   DWORD PTR [BP+SI+0A4A3H]
      FISUB   DWORD PTR [SI+0A6A5H]
      FISUB   DWORD PTR [BP+0A8A7H]
      FISUB   DWORD PTR [BX+0A9A8H]
      FISUBR  DWORD PTR [BX+SI+0AAA9H]
      FISUBR  DWORD PTR [BP+SI+0ACABH]
      FISUBR  DWORD PTR [SI+0AEADH]
      FISUBR  DWORD PTR [BP+0B0AFH]
      FISUBR  DWORD PTR [BX+0B1B0H]
      FIDIV   DWORD PTR [BX+SI+0B2B1H]
      FIDIV   DWORD PTR [BP+SI+0B4B3H]
      FIDIV   DWORD PTR [SI+0B6B5H]
      FIDIV   DWORD PTR [BP+0B8B7H]
      FIDIV   DWORD PTR [BX+0B9B8H]
      FIDIVR  DWORD PTR [BX+SI+0BAB9H]
      FIDIVR  DWORD PTR [BP+SI+0BCBBH]
      FIDIVR  DWORD PTR [SI+0BEBDH]
      FIDIVR  DWORD PTR [BP+0C0BFH]
      FIDIVR  DWORD PTR [BX+0C1C0H]
      FNENI
      FNDISI
      FNCLEX
      FNINIT
      FILD    DWORD PTR [BX+SI]
      FILD    DWORD PTR [BP+SI]
      FILD    DWORD PTR [SI]
      FILD    DWORD PTR [0807H]
      FILD    DWORD PTR [BX]
      FIST    DWORD PTR [BX+SI]
      FIST    DWORD PTR [BP+SI]
      FIST    DWORD PTR [SI]
      FIST    DWORD PTR [1817H]
      FIST    DWORD PTR [BX]
      FISTP   DWORD PTR [BX+SI]
      FISTP   DWORD PTR [BP+SI]
      FISTP   DWORD PTR [SI]
      FISTP   DWORD PTR [201FH]
      FISTP   DWORD PTR [BX]
      FLD     TBYTE PTR [BX+SI]
      FLD     TBYTE PTR [BP+SI]
      FLD     TBYTE PTR [SI]
      FLD     TBYTE PTR [302FH]
      FLD     TBYTE PTR [BX]
      FSTP    TBYTE PTR [BX+SI]
      FSTP    TBYTE PTR [BP+SI]
      FSTP    TBYTE PTR [SI]
      FSTP    TBYTE PTR [403FH]
      FSTP    TBYTE PTR [BX]
      FILD    DWORD PTR [BX+SI+65]
      FILD    DWORD PTR [BP+SI+67]
      FILD    DWORD PTR [SI+69]
      FILD    DWORD PTR [BP+71]
      FILD    DWORD PTR [BX+72]
      FIST    DWORD PTR [BX+SI+81]
      FIST    DWORD PTR [BP+SI+83]
      FIST    DWORD PTR [SI+85]
      FIST    DWORD PTR [BP+87]
      FIST    DWORD PTR [BX+88]
      FISTP   DWORD PTR [BX+SI+89]
      FISTP   DWORD PTR [BP+SI+91]
      FISTP   DWORD PTR [SI+93]
      FISTP   DWORD PTR [BP+95]
      FISTP   DWORD PTR [BX+96]
      FLD     TBYTE PTR [BX+SI+105]
      FLD     TBYTE PTR [BP+SI+107]
      FLD     TBYTE PTR [SI+109]
      FLD     TBYTE PTR [BP+111]
      FLD     TBYTE PTR [BX+112]
      FSTP    TBYTE PTR [BX+SI+121]
      FSTP    TBYTE PTR [BP+SI+123]
      FSTP    TBYTE PTR [SI+125]
      FSTP    TBYTE PTR [BP+127]
      FSTP    TBYTE PTR [BX-128]
      FILD    DWORD PTR [BX+SI+8281H]
      FILD    DWORD PTR [BP+SI+8483H]
      FILD    DWORD PTR [SI+8685H]
      FILD    DWORD PTR [BP+8887H]
      FILD    DWORD PTR [BX+8988H]
      FIST    DWORD PTR [BX+SI+9291H]
      FIST    DWORD PTR [BP+SI+9493H]
      FIST    DWORD PTR [SI+9695H]
      FIST    DWORD PTR [BP+9897H]
      FIST    DWORD PTR [BX+9998H]
      FISTP   DWORD PTR [BX+SI+9A99H]
      FISTP   DWORD PTR [BP+SI+9C9BH]
      FISTP   DWORD PTR [SI+9E9DH]
      FISTP   DWORD PTR [BP+0A09FH]
      FISTP   DWORD PTR [BX+0A1A0H]
      FLD     TBYTE PTR [BX+SI+0AAA9H]
      FLD     TBYTE PTR [BP+SI+0ACABH]
      FLD     TBYTE PTR [SI+0AEADH]
      FLD     TBYTE PTR [BP+0B0AFH]
      FLD     TBYTE PTR [BX+0B1B0H]
      FSTP    TBYTE PTR [BX+SI+0BAB9H]
      FSTP    TBYTE PTR [BP+SI+0BCBBH]
      FSTP    TBYTE PTR [SI+0BEBDH]
      FSTP    TBYTE PTR [BP+0C0BFH]
      FSTP    TBYTE PTR [BX+0C1C0H]
      FSUBR   ST(0), ST
      FSUB    ST(0), ST
      FDIVR   ST(0), ST
      FDIV    ST(0), ST
      FADD    QWORD PTR [BX+SI]
      FADD    QWORD PTR [BP+SI]
      FADD    QWORD PTR [SI]
      FADD    QWORD PTR [0807H]
      FADD    QWORD PTR [BX]
      FMUL    QWORD PTR [BX+SI]
      FMUL    QWORD PTR [BP+SI]
      FMUL    QWORD PTR [SI]
      FMUL    QWORD PTR [100FH]
      FMUL    QWORD PTR [BX]
      FCOM    QWORD PTR [BX+SI]
      FCOM    QWORD PTR [BP+SI]
      FCOM    QWORD PTR [SI]
      FCOM    QWORD PTR [1817H]
      FCOM    QWORD PTR [BX]
      FCOMP   QWORD PTR [BX+SI]
      FCOMP   QWORD PTR [BP+SI]
      FCOMP   QWORD PTR [SI]
      FCOMP   QWORD PTR [201FH]
      FCOMP   QWORD PTR [BX]
      FSUB    QWORD PTR [BX+SI]
      FSUB    QWORD PTR [BP+SI]
      FSUB    QWORD PTR [SI]
      FSUB    QWORD PTR [2827H]
      FSUB    QWORD PTR [BX]
      FSUBR   QWORD PTR [BX+SI]
      FSUBR   QWORD PTR [BP+SI]
      FSUBR   QWORD PTR [SI]
      FSUBR   QWORD PTR [302FH]
      FSUBR   QWORD PTR [BX]
      FDIV    QWORD PTR [BX+SI]
      FDIV    QWORD PTR [BP+SI]
      FDIV    QWORD PTR [SI]
      FDIV    QWORD PTR [3837H]
      FDIV    QWORD PTR [BX]
      FDIVR   QWORD PTR [BX+SI]
      FDIVR   QWORD PTR [BP+SI]
      FDIVR   QWORD PTR [SI]
      FDIVR   QWORD PTR [403FH]
      FDIVR   QWORD PTR [BX]
      FADD    QWORD PTR [BX+SI+65]
      FADD    QWORD PTR [BP+SI+67]
      FADD    QWORD PTR [SI+69]
      FADD    QWORD PTR [BP+71]
      FADD    QWORD PTR [BX+72]
      FMUL    QWORD PTR [BX+SI+73]
      FMUL    QWORD PTR [BP+SI+75]
      FMUL    QWORD PTR [SI+77]
      FMUL    QWORD PTR [BP+79]
      FMUL    QWORD PTR [BX+80]
      FCOM    QWORD PTR [BX+SI+81]
      FCOM    QWORD PTR [BP+SI+83]
      FCOM    QWORD PTR [SI+85]
      FCOM    QWORD PTR [BP+87]
      FCOM    QWORD PTR [BX+88]
      FCOMP   QWORD PTR [BX+SI+89]
      FCOMP   QWORD PTR [BP+SI+91]
      FCOMP   QWORD PTR [SI+93]
      FCOMP   QWORD PTR [BP+95]
      FCOMP   QWORD PTR [BX+96]
      FSUB    QWORD PTR [BX+SI+97]
      FSUB    QWORD PTR [BP+SI+99]
      FSUB    QWORD PTR [SI+101]
      FSUB    QWORD PTR [BP+103]
      FSUB    QWORD PTR [BX+104]
      FSUBR   QWORD PTR [BX+SI+105]
      FSUBR   QWORD PTR [BP+SI+107]
      FSUBR   QWORD PTR [SI+109]
      FSUBR   QWORD PTR [BP+111]
      FSUBR   QWORD PTR [BX+112]
      FDIV    QWORD PTR [BX+SI+113]
      FDIV    QWORD PTR [BP+SI+115]
      FDIV    QWORD PTR [SI+117]
      FDIV    QWORD PTR [BP+119]
      FDIV    QWORD PTR [BX+120]
      FDIVR   QWORD PTR [BX+SI+121]
      FDIVR   QWORD PTR [BP+SI+123]
      FDIVR   QWORD PTR [SI+125]
      FDIVR   QWORD PTR [BP+127]
      FDIVR   QWORD PTR [BX-128]
      FADD    QWORD PTR [BX+SI+8281H]
      FADD    QWORD PTR [BP+SI+8483H]
      FADD    QWORD PTR [SI+8685H]
      FADD    QWORD PTR [BP+8887H]
      FADD    QWORD PTR [BX+8988H]
      FMUL    QWORD PTR [BX+SI+8A89H]
      FMUL    QWORD PTR [BP+SI+8C8BH]
      FMUL    QWORD PTR [SI+8E8DH]
      FMUL    QWORD PTR [BP+908FH]
      FMUL    QWORD PTR [BX+9190H]
      FCOM    QWORD PTR [BX+SI+9291H]
      FCOM    QWORD PTR [BP+SI+9493H]
      FCOM    QWORD PTR [SI+9695H]
      FCOM    QWORD PTR [BP+9897H]
      FCOM    QWORD PTR [BX+9998H]
      FCOMP   QWORD PTR [BX+SI+9A99H]
      FCOMP   QWORD PTR [BP+SI+9C9BH]
      FCOMP   QWORD PTR [SI+9E9DH]
      FCOMP   QWORD PTR [BP+0A09FH]
      FCOMP   QWORD PTR [BX+0A1A0H]
      FSUB    QWORD PTR [BX+SI+0A2A1H]
      FSUB    QWORD PTR [BP+SI+0A4A3H]
      FSUB    QWORD PTR [SI+0A6A5H]
      FSUB    QWORD PTR [BP+0A8A7H]
      FSUB    QWORD PTR [BX+0A9A8H]
      FSUBR   QWORD PTR [BX+SI+0AAA9H]
      FSUBR   QWORD PTR [BP+SI+0ACABH]
      FSUBR   QWORD PTR [SI+0AEADH]
      FSUBR   QWORD PTR [BP+0B0AFH]
      FSUBR   QWORD PTR [BX+0B1B0H]
      FDIV    QWORD PTR [BX+SI+0B2B1H]
      FDIV    QWORD PTR [BP+SI+0B4B3H]
      FDIV    QWORD PTR [SI+0B6B5H]
      FDIV    QWORD PTR [BP+0B8B7H]
      FDIV    QWORD PTR [BX+0B9B8H]
      FDIVR   QWORD PTR [BX+SI+0BAB9H]
      FDIVR   QWORD PTR [BP+SI+0BCBBH]
      FDIVR   QWORD PTR [SI+0BEBDH]
      FDIVR   QWORD PTR [BP+0C0BFH]
      FDIVR   QWORD PTR [BX+0C1C0H]
      FADD    ST(0), ST
      FMUL    ST(0), ST
      FSTP    ST(6)
      FLD     QWORD PTR [BX+SI]
      FLD     QWORD PTR [BP+SI]
      FLD     QWORD PTR [SI]
      FLD     QWORD PTR [0807H]
      FLD     QWORD PTR [BX]
      FST     QWORD PTR [BX+SI]
      FST     QWORD PTR [BP+SI]
      FST     QWORD PTR [SI]
      FST     QWORD PTR [1817H]
      FST     QWORD PTR [BX]
      FSTP    QWORD PTR [BX+SI]
      FSTP    QWORD PTR [BP+SI]
      FSTP    QWORD PTR [SI]
      FSTP    QWORD PTR [201FH]
      FSTP    QWORD PTR [BX]
      FRSTOR  [BX+SI]
      FRSTOR  [BP+SI]
      FRSTOR  [SI]
      FRSTOR  [2827H]
      FRSTOR  [BX]
      FNSAVE  [BX+SI]
      FNSAVE  [BP+SI]
      FNSAVE  [SI]
      FNSAVE  [3837H]
      FNSAVE  [BX]
      FNSTSW  [BX+SI]
      FNSTSW  [BP+SI]
      FNSTSW  [SI]
      FNSTSW  [403FH]
      FNSTSW  [BX]
      FLD     QWORD PTR [BX+SI+65]
      FLD     QWORD PTR [BP+SI+67]
      FLD     QWORD PTR [SI+69]
      FLD     QWORD PTR [BP+71]
      FLD     QWORD PTR [BX+72]
      FST     QWORD PTR [BX+SI+81]
      FST     QWORD PTR [BP+SI+83]
      FST     QWORD PTR [SI+85]
      FST     QWORD PTR [BP+87]
      FST     QWORD PTR [BX+88]
      FSTP    QWORD PTR [BX+SI+89]
      FSTP    QWORD PTR [BP+SI+91]
      FSTP    QWORD PTR [SI+93]
      FSTP    QWORD PTR [BP+95]
      FSTP    QWORD PTR [BX+96]
      FRSTOR  [BX+SI+97]
      FRSTOR  [BP+SI+99]
      FRSTOR  [SI+101]
      FRSTOR  [BP+103]
      FRSTOR  [BX+104]
      FNSAVE  [BX+SI+113]
      FNSAVE  [BP+SI+115]
      FNSAVE  [SI+117]
      FNSAVE  [BP+119]
      FNSAVE  [BX+120]
      FNSTSW  [BX+SI+121]
      FNSTSW  [BP+SI+123]
      FNSTSW  [SI+125]
      FNSTSW  [BP+127]
      FNSTSW  [BX-128]
      FLD     QWORD PTR [BX+SI+8281H]
      FLD     QWORD PTR [BP+SI+8483H]
      FLD     QWORD PTR [SI+8685H]
      FLD     QWORD PTR [BP+8887H]
      FLD     QWORD PTR [BX+8988H]
      FST     QWORD PTR [BX+SI+9291H]
      FST     QWORD PTR [BP+SI+9493H]
      FST     QWORD PTR [SI+9695H]
      FST     QWORD PTR [BP+9897H]
      FST     QWORD PTR [BX+9998H]
      FSTP    QWORD PTR [BX+SI+9A99H]
      FSTP    QWORD PTR [BP+SI+9C9BH]
      FSTP    QWORD PTR [SI+9E9DH]
      FSTP    QWORD PTR [BP+0A09FH]
      FSTP    QWORD PTR [BX+0A1A0H]
      FRSTOR  [BX+SI+0A2A1H]
      FRSTOR  [BP+SI+0A4A3H]
      FRSTOR  [SI+0A6A5H]
      FRSTOR  [BP+0A8A7H]
      FRSTOR  [BX+0A9A8H]
      FNSAVE  [BX+SI+0B2B1H]
      FNSAVE  [BP+SI+0B4B3H]
      FNSAVE  [SI+0B6B5H]
      FNSAVE  [BP+0B8B7H]
      FNSAVE  [BX+0B9B8H]
      FNSTSW  [BX+SI+0BAB9H]
      FNSTSW  [BP+SI+0BCBBH]
      FNSTSW  [SI+0BEBDH]
      FNSTSW  [BP+0C0BFH]
      FNSTSW  [BX+0C1C0H]
      FFREE   ST(0)
      FST     ST(0)
      FSUBRP  ST(0), ST
      FSUBP   ST(0), ST
      FDIVRP  ST(0), ST
      FDIVP   ST(0), ST
      FIADD   WORD PTR [BX+SI]
      FIADD   WORD PTR [BP+SI]
      FIADD   WORD PTR [SI]
      FIADD   WORD PTR [0807H]
      FIADD   WORD PTR [BX]
      FIMUL   WORD PTR [BX+SI]
      FIMUL   WORD PTR [BP+SI]
      FIMUL   WORD PTR [SI]
      FIMUL   WORD PTR [100FH]
      FIMUL   WORD PTR [BX]
      FICOM   WORD PTR [BX+SI]
      FICOM   WORD PTR [BP+SI]
      FICOM   WORD PTR [SI]
      FICOM   WORD PTR [1817H]
      FICOM   WORD PTR [BX]
      FICOMP  WORD PTR [BX+SI]
      FICOMP  WORD PTR [BP+SI]
      FICOMP  WORD PTR [SI]
      FICOMP  WORD PTR [201FH]
      FICOMP  WORD PTR [BX]
      FISUB   WORD PTR [BX+SI]
      FISUB   WORD PTR [BP+SI]
      FISUB   WORD PTR [SI]
      FISUB   WORD PTR [2827H]
      FISUB   WORD PTR [BX]
      FISUBR  WORD PTR [BX+SI]
      FISUBR  WORD PTR [BP+SI]
      FISUBR  WORD PTR [SI]
      FISUBR  WORD PTR [302FH]
      FISUBR  WORD PTR [BX]
      FIDIV   WORD PTR [BX+SI]
      FIDIV   WORD PTR [BP+SI]
      FIDIV   WORD PTR [SI]
      FIDIV   WORD PTR [3837H]
      FIDIV   WORD PTR [BX]
      FIDIVR  WORD PTR [BX+SI]
      FIDIVR  WORD PTR [BP+SI]
      FIDIVR  WORD PTR [SI]
      FIDIVR  WORD PTR [403FH]
      FIDIVR  WORD PTR [BX]
      FIADD   WORD PTR [BX+SI+65]
      FIADD   WORD PTR [BP+SI+67]
      FIADD   WORD PTR [SI+69]
      FIADD   WORD PTR [BP+71]
      FIADD   WORD PTR [BX+72]
      FIMUL   WORD PTR [BX+SI+73]
      FIMUL   WORD PTR [BP+SI+75]
      FIMUL   WORD PTR [SI+77]
      FIMUL   WORD PTR [BP+79]
      FIMUL   WORD PTR [BX+80]
      FICOM   WORD PTR [BX+SI+81]
      FICOM   WORD PTR [BP+SI+83]
      FICOM   WORD PTR [SI+85]
      FICOM   WORD PTR [BP+87]
      FICOM   WORD PTR [BX+88]
      FICOMP  WORD PTR [BX+SI+89]
      FICOMP  WORD PTR [BP+SI+91]
      FICOMP  WORD PTR [SI+93]
      FICOMP  WORD PTR [BP+95]
      FICOMP  WORD PTR [BX+96]
      FISUB   WORD PTR [BX+SI+97]
      FISUB   WORD PTR [BP+SI+99]
      FISUB   WORD PTR [SI+101]
      FISUB   WORD PTR [BP+103]
      FISUB   WORD PTR [BX+104]
      FISUBR  WORD PTR [BX+SI+105]
      FISUBR  WORD PTR [BP+SI+107]
      FISUBR  WORD PTR [SI+109]
      FISUBR  WORD PTR [BP+111]
      FISUBR  WORD PTR [BX+112]
      FIDIV   WORD PTR [BX+SI+113]
      FIDIV   WORD PTR [BP+SI+115]
      FIDIV   WORD PTR [SI+117]
      FIDIV   WORD PTR [BP+119]
      FIDIV   WORD PTR [BX+120]
      FIDIVR  WORD PTR [BX+SI+121]
      FIDIVR  WORD PTR [BP+SI+123]
      FIDIVR  WORD PTR [SI+125]
      FIDIVR  WORD PTR [BP+127]
      FIDIVR  WORD PTR [BX-128]
      FIADD   WORD PTR [BX+SI+8281H]
      FIADD   WORD PTR [BP+SI+8483H]
      FIADD   WORD PTR [SI+8685H]
      FIADD   WORD PTR [BP+8887H]
      FIADD   WORD PTR [BX+8988H]
      FIMUL   WORD PTR [BX+SI+8A89H]
      FIMUL   WORD PTR [BP+SI+8C8BH]
      FIMUL   WORD PTR [SI+8E8DH]
      FIMUL   WORD PTR [BP+908FH]
      FIMUL   WORD PTR [BX+9190H]
      FICOM   WORD PTR [BX+SI+9291H]
      FICOM   WORD PTR [BP+SI+9493H]
      FICOM   WORD PTR [SI+9695H]
      FICOM   WORD PTR [BP+9897H]
      FICOM   WORD PTR [BX+9998H]
      FICOMP  WORD PTR [BX+SI+9A99H]
      FICOMP  WORD PTR [BP+SI+9C9BH]
      FICOMP  WORD PTR [SI+9E9DH]
      FICOMP  WORD PTR [BP+0A09FH]
      FICOMP  WORD PTR [BX+0A1A0H]
      FISUB   WORD PTR [BX+SI+0A2A1H]
      FISUB   WORD PTR [BP+SI+0A4A3H]
      FISUB   WORD PTR [SI+0A6A5H]
      FISUB   WORD PTR [BP+0A8A7H]
      FISUB   WORD PTR [BX+0A9A8H]
      FISUBR  WORD PTR [BX+SI+0AAA9H]
      FISUBR  WORD PTR [BP+SI+0ACABH]
      FISUBR  WORD PTR [SI+0AEADH]
      FISUBR  WORD PTR [BP+0B0AFH]
      FISUBR  WORD PTR [BX+0B1B0H]
      FIDIV   WORD PTR [BX+SI+0B2B1H]
      FIDIV   WORD PTR [BP+SI+0B4B3H]
      FIDIV   WORD PTR [SI+0B6B5H]
      FIDIV   WORD PTR [BP+0B8B7H]
      FIDIV   WORD PTR [BX+0B9B8H]
      FIDIVR  WORD PTR [BX+SI+0BAB9H]
      FIDIVR  WORD PTR [BP+SI+0BCBBH]
      FIDIVR  WORD PTR [SI+0BEBDH]
      FIDIVR  WORD PTR [BP+0C0BFH]
      FIDIVR  WORD PTR [BX+0C1C0H]
      FADDP   ST(0), ST
      FMULP   ST(0), ST
      FCOMPP
      FILD    WORD PTR [BX+SI]
      FILD    WORD PTR [BP+SI]
      FILD    WORD PTR [SI]
      FILD    WORD PTR [0807H]
      FILD    WORD PTR [BX]
      FIST    WORD PTR [BX+SI]
      FIST    WORD PTR [BP+SI]
      FIST    WORD PTR [SI]
      FIST    WORD PTR [1817H]
      FIST    WORD PTR [BX]
      FISTP   WORD PTR [BX+SI]
      FISTP   WORD PTR [BP+SI]
      FISTP   WORD PTR [SI]
      FISTP   WORD PTR [201FH]
      FISTP   WORD PTR [BX]
      FBLD    TBYTE PTR [BX+SI]
      FBLD    TBYTE PTR [BP+SI]
      FBLD    TBYTE PTR [SI]
      FBLD    TBYTE PTR [2827H]
      FBLD    TBYTE PTR [BX]
      FILD    QWORD PTR [BX+SI]
      FILD    QWORD PTR [BP+SI]
      FILD    QWORD PTR [SI]
      FILD    QWORD PTR [302FH]
      FILD    QWORD PTR [BX]
      FBSTP   TBYTE PTR [BX+SI]
      FBSTP   TBYTE PTR [BP+SI]
      FBSTP   TBYTE PTR [SI]
      FBSTP   TBYTE PTR [3837H]
      FBSTP   TBYTE PTR [BX]
      FISTP   QWORD PTR [BX+SI]
      FISTP   QWORD PTR [BP+SI]
      FISTP   QWORD PTR [SI]
      FISTP   QWORD PTR [403FH]
      FISTP   QWORD PTR [BX]
      FILD    WORD PTR [BX+SI+65]
      FILD    WORD PTR [BP+SI+67]
      FILD    WORD PTR [SI+69]
      FILD    WORD PTR [BP+71]
      FILD    WORD PTR [BX+72]
      FIST    WORD PTR [BX+SI+81]
      FIST    WORD PTR [BP+SI+83]
      FIST    WORD PTR [SI+85]
      FIST    WORD PTR [BP+87]
      FIST    WORD PTR [BX+88]
      FISTP   WORD PTR [BX+SI+89]
      FISTP   WORD PTR [BP+SI+91]
      FISTP   WORD PTR [SI+93]
      FISTP   WORD PTR [BP+95]
      FISTP   WORD PTR [BX+96]
      FBLD    TBYTE PTR [BX+SI+97]
      FBLD    TBYTE PTR [BP+SI+99]
      FBLD    TBYTE PTR [SI+101]
      FBLD    TBYTE PTR [BP+103]
      FBLD    TBYTE PTR [BX+104]
      FILD    QWORD PTR [BX+SI+105]
      FILD    QWORD PTR [BP+SI+107]
      FILD    QWORD PTR [SI+109]
      FILD    QWORD PTR [BP+111]
      FILD    QWORD PTR [BX+112]
      FBSTP   TBYTE PTR [BX+SI+113]
      FBSTP   TBYTE PTR [BP+SI+115]
      FBSTP   TBYTE PTR [SI+117]
      FBSTP   TBYTE PTR [BP+119]
      FBSTP   TBYTE PTR [BX+120]
      FISTP   QWORD PTR [BX+SI+121]
      FISTP   QWORD PTR [BP+SI+123]
      FISTP   QWORD PTR [SI+125]
      FISTP   QWORD PTR [BP+127]
      FISTP   QWORD PTR [BX-128]
      FILD    WORD PTR [BX+SI+8281H]
      FILD    WORD PTR [BP+SI+8483H]
      FILD    WORD PTR [SI+8685H]
      FILD    WORD PTR [BP+8887H]
      FILD    WORD PTR [BX+8988H]
      FIST    WORD PTR [BX+SI+9291H]
      FIST    WORD PTR [BP+SI+9493H]
      FIST    WORD PTR [SI+9695H]
      FIST    WORD PTR [BP+9897H]
      FIST    WORD PTR [BX+9998H]
      FISTP   WORD PTR [BX+SI+9A99H]
      FISTP   WORD PTR [BP+SI+9C9BH]
      FISTP   WORD PTR [SI+9E9DH]
      FISTP   WORD PTR [BP+0A09FH]
      FISTP   WORD PTR [BX+0A1A0H]
      FBLD    TBYTE PTR [BX+SI+0A2A1H]
      FBLD    TBYTE PTR [BP+SI+0A4A3H]
      FBLD    TBYTE PTR [SI+0A6A5H]
      FBLD    TBYTE PTR [BP+0A8A7H]
      FBLD    TBYTE PTR [BX+0A9A8H]
      FILD    QWORD PTR [BX+SI+0AAA9H]
      FILD    QWORD PTR [BP+SI+0ACABH]
      FILD    QWORD PTR [SI+0AEADH]
      FILD    QWORD PTR [BP+0B0AFH]
      FILD    QWORD PTR [BX+0B1B0H]
      FBSTP   TBYTE PTR [BX+SI+0B2B1H]
      FBSTP   TBYTE PTR [BP+SI+0B4B3H]
      FBSTP   TBYTE PTR [SI+0B6B5H]
      FBSTP   TBYTE PTR [BP+0B8B7H]
      FBSTP   TBYTE PTR [BX+0B9B8H]
      FISTP   QWORD PTR [BX+SI+0BAB9H]
      FISTP   QWORD PTR [BP+SI+0BCBBH]
      FISTP   QWORD PTR [SI+0BEBDH]
      FISTP   QWORD PTR [BP+0C0BFH]
      FISTP   QWORD PTR [BX+0C1C0H]
      LOOPNE  $-29
      LOOPE   $-28
      LOOP    $-27
      JCXZ    $-26
      IN      AL, 0E5H
      IN      AX, 0E6H
      OUT     0E7H, AL
      OUT     0E8H, AX
      CALL    $-1514H
      JMP     $-1413H
      JMPF    0EEEDH:0ECEBH
      JMP     $-18
      IN      AL, DX
      IN      AX, DX
      OUT     DX, AL
      OUT     DX, AX
      LOCK
      REPNE MOVSB
      REPNE MOVSW
      REPNE CMPSB
      REPNE CMPSW
      REPNE STOSB
      REPNE STOSW
      REPNE LODSB
      REPNE LODSW
      REPNE SCASB
      REPNE SCASW
      REP MOVSB
      REP MOVSW
      REP CMPSB
      REP CMPSW
      REP STOSB
      REP STOSW
      REP LODSB
      REP LODSW
      REP SCASB
      REP SCASW
      HLT
      CMC
      DIV     BH
      IDIV    AL
      IDIV    AH
      TEST    BYTE PTR [BX+SI], 1
      TEST    BYTE PTR [BP+SI], 3
      TEST    BYTE PTR [SI], 5
      TEST    BYTE PTR [0807H], 9
      TEST    BYTE PTR [BX], 8
      NOT     BYTE PTR [BX+SI]
      NOT     BYTE PTR [BP+SI]
      NOT     BYTE PTR [SI]
      NOT     BYTE PTR [1817H]
      NOT     BYTE PTR [BX]
      NEG     BYTE PTR [BX+SI]
      NEG     BYTE PTR [BP+SI]
      NEG     BYTE PTR [SI]
      NEG     BYTE PTR [201FH]
      NEG     BYTE PTR [BX]
      MUL     BYTE PTR [BX+SI]
      MUL     BYTE PTR [BP+SI]
      MUL     BYTE PTR [SI]
      MUL     BYTE PTR [2827H]
      MUL     BYTE PTR [BX]
      IMUL    BYTE PTR [BX+SI]
      IMUL    BYTE PTR [BP+SI]
      IMUL    BYTE PTR [SI]
      IMUL    BYTE PTR [302FH]
      IMUL    BYTE PTR [BX]
      DIV     BYTE PTR [BX+SI]
      DIV     BYTE PTR [BP+SI]
      DIV     BYTE PTR [SI]
      DIV     BYTE PTR [3837H]
      DIV     BYTE PTR [BX]
      IDIV    BYTE PTR [BX+SI]
      IDIV    BYTE PTR [BP+SI]
      IDIV    BYTE PTR [SI]
      IDIV    BYTE PTR [403FH]
      IDIV    BYTE PTR [BX]
      TEST    BYTE PTR [BX+SI+65], 42H
      TEST    BYTE PTR [BP+SI+67], 44H
      TEST    BYTE PTR [SI+69], 46H
      TEST    BYTE PTR [BP+71], 48H
      TEST    BYTE PTR [BX+72], 49H
      NOT     BYTE PTR [BX+SI+81]
      NOT     BYTE PTR [BP+SI+83]
      NOT     BYTE PTR [SI+85]
      NOT     BYTE PTR [BP+87]
      NOT     BYTE PTR [BX+88]
      NEG     BYTE PTR [BX+SI+89]
      NEG     BYTE PTR [BP+SI+91]
      NEG     BYTE PTR [SI+93]
      NEG     BYTE PTR [BP+95]
      NEG     BYTE PTR [BX+96]
      MUL     BYTE PTR [BX+SI+97]
      MUL     BYTE PTR [BP+SI+99]
      MUL     BYTE PTR [SI+101]
      MUL     BYTE PTR [BP+103]
      MUL     BYTE PTR [BX+104]
      IMUL    BYTE PTR [BX+SI+105]
      IMUL    BYTE PTR [BP+SI+107]
      IMUL    BYTE PTR [SI+109]
      IMUL    BYTE PTR [BP+111]
      IMUL    BYTE PTR [BX+112]
      DIV     BYTE PTR [BX+SI+113]
      DIV     BYTE PTR [BP+SI+115]
      DIV     BYTE PTR [SI+117]
      DIV     BYTE PTR [BP+119]
      DIV     BYTE PTR [BX+120]
      IDIV    BYTE PTR [BX+SI+121]
      IDIV    BYTE PTR [BP+SI+123]
      IDIV    BYTE PTR [SI+125]
      IDIV    BYTE PTR [BP+127]
      IDIV    BYTE PTR [BX-128]
      TEST    BYTE PTR [BX+SI+8281H], 83H
      TEST    BYTE PTR [BP+SI+8483H], 85H
      TEST    BYTE PTR [SI+8685H], 87H
      TEST    BYTE PTR [BP+8887H], 89H
      TEST    BYTE PTR [BX+8988H], 8AH
      NOT     BYTE PTR [BX+SI+9291H]
      NOT     BYTE PTR [BP+SI+9493H]
      NOT     BYTE PTR [SI+9695H]
      NOT     BYTE PTR [BP+9897H]
      NOT     BYTE PTR [BX+9998H]
      NEG     BYTE PTR [BX+SI+9A99H]
      NEG     BYTE PTR [BP+SI+9C9BH]
      NEG     BYTE PTR [SI+9E9DH]
      NEG     BYTE PTR [BP+0A09FH]
      NEG     BYTE PTR [BX+0A1A0H]
      MUL     BYTE PTR [BX+SI+0A2A1H]
      MUL     BYTE PTR [BP+SI+0A4A3H]
      MUL     BYTE PTR [SI+0A6A5H]
      MUL     BYTE PTR [BP+0A8A7H]
      MUL     BYTE PTR [BX+0A9A8H]
      IMUL    BYTE PTR [BX+SI+0AAA9H]
      IMUL    BYTE PTR [BP+SI+0ACABH]
      IMUL    BYTE PTR [SI+0AEADH]
      IMUL    BYTE PTR [BP+0B0AFH]
      IMUL    BYTE PTR [BX+0B1B0H]
      DIV     BYTE PTR [BX+SI+0B2B1H]
      DIV     BYTE PTR [BP+SI+0B4B3H]
      DIV     BYTE PTR [SI+0B6B5H]
      DIV     BYTE PTR [BP+0B8B7H]
      DIV     BYTE PTR [BX+0B9B8H]
      IDIV    BYTE PTR [BX+SI+0BAB9H]
      IDIV    BYTE PTR [BP+SI+0BCBBH]
      IDIV    BYTE PTR [SI+0BEBDH]
      IDIV    BYTE PTR [BP+0C0BFH]
      IDIV    BYTE PTR [BX+0C1C0H]
      TEST    AL, 0C1H
      TEST    AH, 0C5H
      NOT     AL
      NOT     AH
      NEG     AL
      NEG     AH
      MUL     AL
      MUL     AH
      IMUL    AL
      IMUL    AH
      DIV     AL
      IDIV    AX
      IDIV    CX
      IDIV    SP
      IDIV    SI
      TEST    WORD PTR [BX+SI], 0201H
      TEST    WORD PTR [BP+SI], 0403H
      TEST    WORD PTR [SI], 0605H
      TEST    WORD PTR [0807H], 0A09H
      TEST    WORD PTR [BX], 0908H
      NOT     WORD PTR [BX+SI]
      NOT     WORD PTR [BP+SI]
      NOT     WORD PTR [SI]
      NOT     WORD PTR [1817H]
      NOT     WORD PTR [BX]
      NEG     WORD PTR [BX+SI]
      NEG     WORD PTR [BP+SI]
      NEG     WORD PTR [SI]
      NEG     WORD PTR [201FH]
      NEG     WORD PTR [BX]
      MUL     WORD PTR [BX+SI]
      MUL     WORD PTR [BP+SI]
      MUL     WORD PTR [SI]
      MUL     WORD PTR [2827H]
      MUL     WORD PTR [BX]
      IMUL    WORD PTR [BX+SI]
      IMUL    WORD PTR [BP+SI]
      IMUL    WORD PTR [SI]
      IMUL    WORD PTR [302FH]
      IMUL    WORD PTR [BX]
      DIV     WORD PTR [BX+SI]
      DIV     WORD PTR [BP+SI]
      DIV     WORD PTR [SI]
      DIV     WORD PTR [3837H]
      DIV     WORD PTR [BX]
      IDIV    WORD PTR [BX+SI]
      IDIV    WORD PTR [BP+SI]
      IDIV    WORD PTR [SI]
      IDIV    WORD PTR [403FH]
      IDIV    WORD PTR [BX]
      TEST    WORD PTR [BX+SI+65], 4342H
      TEST    WORD PTR [BP+SI+67], 4544H
      TEST    WORD PTR [SI+69], 4746H
      TEST    WORD PTR [BP+71], 4948H
      TEST    WORD PTR [BX+72], 4A49H
      NOT     WORD PTR [BX+SI+81]
      NOT     WORD PTR [BP+SI+83]
      NOT     WORD PTR [SI+85]
      NOT     WORD PTR [BP+87]
      NOT     WORD PTR [BX+88]
      NEG     WORD PTR [BX+SI+89]
      NEG     WORD PTR [BP+SI+91]
      NEG     WORD PTR [SI+93]
      NEG     WORD PTR [BP+95]
      NEG     WORD PTR [BX+96]
      MUL     WORD PTR [BX+SI+97]
      MUL     WORD PTR [BP+SI+99]
      MUL     WORD PTR [SI+101]
      MUL     WORD PTR [BP+103]
      MUL     WORD PTR [BX+104]
      IMUL    WORD PTR [BX+SI+105]
      IMUL    WORD PTR [BP+SI+107]
      IMUL    WORD PTR [SI+109]
      IMUL    WORD PTR [BP+111]
      IMUL    WORD PTR [BX+112]
      DIV     WORD PTR [BX+SI+113]
      DIV     WORD PTR [BP+SI+115]
      DIV     WORD PTR [SI+117]
      DIV     WORD PTR [BP+119]
      DIV     WORD PTR [BX+120]
      IDIV    WORD PTR [BX+SI+121]
      IDIV    WORD PTR [BP+SI+123]
      IDIV    WORD PTR [SI+125]
      IDIV    WORD PTR [BP+127]
      IDIV    WORD PTR [BX-128]
      TEST    WORD PTR [BX+SI+8281H], 8483H
      TEST    WORD PTR [BP+SI+8483H], 8685H
      TEST    WORD PTR [SI+8685H], 8887H
      TEST    WORD PTR [BP+8887H], 8A89H
      TEST    WORD PTR [BX+8988H], 8B8AH
      NOT     WORD PTR [BX+SI+9291H]
      NOT     WORD PTR [BP+SI+9493H]
      NOT     WORD PTR [SI+9695H]
      NOT     WORD PTR [BP+9897H]
      NOT     WORD PTR [BX+9998H]
      NEG     WORD PTR [BX+SI+9A99H]
      NEG     WORD PTR [BP+SI+9C9BH]
      NEG     WORD PTR [SI+9E9DH]
      NEG     WORD PTR [BP+0A09FH]
      NEG     WORD PTR [BX+0A1A0H]
      MUL     WORD PTR [BX+SI+0A2A1H]
      MUL     WORD PTR [BP+SI+0A4A3H]
      MUL     WORD PTR [SI+0A6A5H]
      MUL     WORD PTR [BP+0A8A7H]
      MUL     WORD PTR [BX+0A9A8H]
      IMUL    WORD PTR [BX+SI+0AAA9H]
      IMUL    WORD PTR [BP+SI+0ACABH]
      IMUL    WORD PTR [SI+0AEADH]
      IMUL    WORD PTR [BP+0B0AFH]
      IMUL    WORD PTR [BX+0B1B0H]
      DIV     WORD PTR [BX+SI+0B2B1H]
      DIV     WORD PTR [BP+SI+0B4B3H]
      DIV     WORD PTR [SI+0B6B5H]
      DIV     WORD PTR [BP+0B8B7H]
      DIV     WORD PTR [BX+0B9B8H]
      IDIV    WORD PTR [BX+SI+0BAB9H]
      IDIV    WORD PTR [BP+SI+0BCBBH]
      IDIV    WORD PTR [SI+0BEBDH]
      IDIV    WORD PTR [BP+0C0BFH]
      IDIV    WORD PTR [BX+0C1C0H]
      TEST    AX, 0C2C1H
      TEST    CX, 0C3C2H
      TEST    SP, 0C6C5H
      TEST    SI, 0C8C7H
      NOT     AX
      NOT     CX
      NOT     SP
      NOT     SI
      NEG     AX
      NEG     CX
      NEG     SP
      NEG     SI
      MUL     AX
      MUL     CX
      MUL     SP
      MUL     SI
      IMUL    AX
      IMUL    CX
      IMUL    SP
      IMUL    SI
      DIV     AX
      DIV     CX
      DIV     SP
      DIV     SI
      CLC
      STC
      CLI
      STI
      CLD
      STD
      INC     BYTE PTR [BX+SI]
      INC     BYTE PTR [BP+SI]
      INC     BYTE PTR [SI]
      INC     BYTE PTR [0807H]
      INC     BYTE PTR [BX]
      DEC     BYTE PTR [BX+SI]
      DEC     BYTE PTR [BP+SI]
      DEC     BYTE PTR [SI]
      DEC     BYTE PTR [100FH]
      DEC     BYTE PTR [BX]
      INC     BYTE PTR [BX+SI+65]
      INC     BYTE PTR [BP+SI+67]
      INC     BYTE PTR [SI+69]
      INC     BYTE PTR [BP+71]
      INC     BYTE PTR [BX+72]
      DEC     BYTE PTR [BX+SI+73]
      DEC     BYTE PTR [BP+SI+75]
      DEC     BYTE PTR [SI+77]
      DEC     BYTE PTR [BP+79]
      DEC     BYTE PTR [BX+80]
      INC     BYTE PTR [BX+SI+8281H]
      INC     BYTE PTR [BP+SI+8483H]
      INC     BYTE PTR [SI+8685H]
      INC     BYTE PTR [BP+8887H]
      INC     BYTE PTR [BX+8988H]
      DEC     BYTE PTR [BX+SI+8A89H]
      DEC     BYTE PTR [BP+SI+8C8BH]
      DEC     BYTE PTR [SI+8E8DH]
      DEC     BYTE PTR [BP+908FH]
      DEC     BYTE PTR [BX+9190H]
      INC     AL
      INC     AH
      DEC     AL
      DEC     AH
      INC     WORD PTR [BX+SI]
      INC     WORD PTR [BP+SI]
      INC     WORD PTR [SI]
      INC     WORD PTR [0807H]
      INC     WORD PTR [BX]
      DEC     WORD PTR [BX+SI]
      DEC     WORD PTR [BP+SI]
      DEC     WORD PTR [SI]
      DEC     WORD PTR [100FH]
      DEC     WORD PTR [BX]
      CALL    [BX+SI]
      CALL    [BP+SI]
      CALL    [SI]
      CALL    [1817H]
      CALL    [BX]
      CALLF   [BX+SI]
      CALLF   [BP+SI]
      CALLF   [SI]
      CALLF   [201FH]
      CALLF   [BX]
      JMP     [BX+SI]
      JMP     [BP+SI]
      JMP     [SI]
      JMP     [2827H]
      JMP     [BX]
      JMPF    [BX+SI]
      JMPF    [BP+SI]
      JMPF    [SI]
      JMPF    [302FH]
      JMPF    [BX]
      PUSH    [BX+SI]
      PUSH    [BP+SI]
      PUSH    [SI]
      PUSH    [3837H]
      PUSH    [BX]
      INC     WORD PTR [BX+SI+65]
      INC     WORD PTR [BP+SI+67]
      INC     WORD PTR [SI+69]
      INC     WORD PTR [BP+71]
      INC     WORD PTR [BX+72]
      DEC     WORD PTR [BX+SI+73]
      DEC     WORD PTR [BP+SI+75]
      DEC     WORD PTR [SI+77]
      DEC     WORD PTR [BP+79]
      DEC     WORD PTR [BX+80]
      CALL    [BX+SI+81]
      CALL    [BP+SI+83]
      CALL    [SI+85]
      CALL    [BP+87]
      CALL    [BX+88]
      CALLF   [BX+SI+89]
      CALLF   [BP+SI+91]
      CALLF   [SI+93]
      CALLF   [BP+95]
      CALLF   [BX+96]
      JMP     [BX+SI+97]
      JMP     [BP+SI+99]
      JMP     [SI+101]
      JMP     [BP+103]
      JMP     [BX+104]
      JMPF    [BX+SI+105]
      JMPF    [BP+SI+107]
      JMPF    [SI+109]
      JMPF    [BP+111]
      JMPF    [BX+112]
      PUSH    [BX+SI+113]
      PUSH    [BP+SI+115]
      PUSH    [SI+117]
      PUSH    [BP+119]
      PUSH    [BX+120]
      INC     WORD PTR [BX+SI+8281H]
      INC     WORD PTR [BP+SI+8483H]
      INC     WORD PTR [SI+8685H]
      INC     WORD PTR [BP+8887H]
      INC     WORD PTR [BX+8988H]
      DEC     WORD PTR [BX+SI+8A89H]
      DEC     WORD PTR [BP+SI+8C8BH]
      DEC     WORD PTR [SI+8E8DH]
      DEC     WORD PTR [BP+908FH]
      DEC     WORD PTR [BX+9190H]
      CALL    [BX+SI+9291H]
      CALL    [BP+SI+9493H]
      CALL    [SI+9695H]
      CALL    [BP+9897H]
      CALL    [BX+9998H]
      CALLF   [BX+SI+9A99H]
      CALLF   [BP+SI+9C9BH]
      CALLF   [SI+9E9DH]
      CALLF   [BP+0A09FH]
      CALLF   [BX+0A1A0H]
      JMP     [BX+SI+0A2A1H]
      JMP     [BP+SI+0A4A3H]
      JMP     [SI+0A6A5H]
      JMP     [BP+0A8A7H]
      JMP     [BX+0A9A8H]
      JMPF    [BX+SI+0AAA9H]
      JMPF    [BP+SI+0ACABH]
      JMPF    [SI+0AEADH]
      JMPF    [BP+0B0AFH]
      JMPF    [BX+0B1B0H]
      PUSH    [BX+SI+0B2B1H]
      PUSH    [BP+SI+0B4B3H]
      PUSH    [SI+0B6B5H]
      PUSH    [BP+0B8B7H]
      PUSH    [BX+0B9B8H]
      INC     AX
      INC     CX
      INC     SP
      INC     SI
      DEC     AX
      DEC     CX
      DEC     SP
      DEC     SI
      CALL    AX
      CALL    CX
      CALL    SP
      CALL    SI
      JMP     AX
      JMP     CX
      JMP     SP
      JMP     SI
      PUSH    AX
      PUSH    CX
      PUSH    SP
      PUSH    SI
      FSTENV  [BX+SI]
      FSTENV  [BP+SI]
      FSTENV  [SI]
      FSTENV  [3837H]
      FSTENV  [BX]
      FSTCW   [BX+SI]
      FSTCW   [BP+SI]
      FSTCW   [SI]
      FSTCW   [403FH]
      FSTCW   [BX]
      FSTENV  [BX+SI+113]
      FSTENV  [BP+SI+115]
      FSTENV  [SI+117]
      FSTENV  [BP+119]
      FSTENV  [BX+120]
      FSTCW   [BX+SI+121]
      FSTCW   [BP+SI+123]
      FSTCW   [SI+125]
      FSTCW   [BP+127]
      FSTCW   [BX-128]
      FSTENV  [BX+SI+0B2B1H]
      FSTENV  [BP+SI+0B4B3H]
      FSTENV  [SI+0B6B5H]
      FSTENV  [BP+0B8B7H]
      FSTENV  [BX+0B9B8H]
      FSTCW   [BX+SI+0BAB9H]
      FSTCW   [BP+SI+0BCBBH]
      FSTCW   [SI+0BEBDH]
      FSTCW   [BP+0C0BFH]
      FSTCW   [BX+0C1C0H]
      FENI
      FDISI
      FCLEX
      FINIT
      FSAVE   [BX+SI]
      FSAVE   [BP+SI]
      FSAVE   [SI]
      FSAVE   [3837H]
      FSAVE   [BX]
      FSTSW   [BX+SI]
      FSTSW   [BP+SI]
      FSTSW   [SI]
      FSTSW   [403FH]
      FSTSW   [BX]
      FSAVE   [BX+SI+113]
      FSAVE   [BP+SI+115]
      FSAVE   [SI+117]
      FSAVE   [BP+119]
      FSAVE   [BX+120]
      FSTSW   [BX+SI+121]
      FSTSW   [BP+SI+123]
      FSTSW   [SI+125]
      FSTSW   [BP+127]
      FSTSW   [BX-128]
      FSAVE   [BX+SI+0B2B1H]
      FSAVE   [BP+SI+0B4B3H]
      FSAVE   [SI+0B6B5H]
      FSAVE   [BP+0B8B7H]
      FSAVE   [BX+0B9B8H]
      FSTSW   [BX+SI+0BAB9H]
      FSTSW   [BP+SI+0BCBBH]
      FSTSW   [SI+0BEBDH]
      FSTSW   [BP+0C0BFH]
      FSTSW   [BX+0C1C0H]
