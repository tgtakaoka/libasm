;### AUTO GENERATED FILE
;### generated by: gen_z8000 -g -C Z8002 -o gen_z8k2.inc -l gen_z8k2.lst
      addb   rh0, #1
      addb   rl0, #9
      addb   rh0, @r1
      addb   rl0, @r1
      add    r0, #0x0201
      add    r0, @r1
      subb   rh0, #1
      subb   rl0, #9
      subb   rh0, @r1
      subb   rl0, @r1
      sub    r0, #0x0401
      sub    r0, @r1
      orb    rh0, #1
      orb    rl0, #9
      orb    rh0, @r1
      orb    rl0, @r1
      or     r0, #0x0601
      or     r0, @r1
      andb   rh0, #1
      andb   rl0, #9
      andb   rh0, @r1
      andb   rl0, @r1
      and    r0, #0x0801
      and    r0, @r1
      xorb   rh0, #1
      xorb   rl0, #9
      xorb   rh0, @r1
      xorb   rl0, @r1
      xor    r0, #0x0a01
      xor    r0, @r1
      cpb    rh0, #1
      cpb    rl0, #9
      cpb    rh0, @r1
      cpb    rl0, @r1
      cp     r0, #0x0c01
      cp     r0, @r1
      comb   @r1
      cpb    @r1, #18
      negb   @r1
      testb  @r1
      ldb    @r1, #22
      tsetb  @r1
      clrb   @r1
      com    @r1
      cp     @r1, #0x0e12
      neg    @r1
      test   @r1
      ld     @r1, #0x0e16
      tset   @r1
      clr    @r1
      push   @r1, #0x0e1a
      cpl    rr0, #0x11011202
      cpl    rr0, @r1
      pushl  @r1, @r2
      subl   rr0, #0x13011402
      subl   rr0, @r1
      push   @r1, @r2
      ldl    rr0, #0x15011602
      ldl    rr0, @r1
      popl   @r2, @r1
      addl   rr0, #0x17011802
      addl   rr0, @r1
      pop    @r2, @r1
      multl  rq0, #0x19011a02
      multl  rq0, @r1
      mult   rr0, #0x1a01
      mult   rr0, @r1
      divl   rq0, #0x1b011c02
      divl   rq0, @r1
      div    rr0, #0x1c01
      div    rr0, @r1
      ldm    r0, @r1, #1
      testl  @r1
      ldm    @r1, r0, #1
      ldl    @r1, rr0
      jp     f, @r1
      jp     lt, @r1
      jp     le, @r1
      jp     ule, @r1
      jp     ov, @r1
      jp     mi, @r1
      jp     z, @r1
      jp     c, @r1
      jp     @r1
      jp     ge, @r1
      jp     gt, @r1
      jp     ugt, @r1
      jp     nov, @r1
      jp     pl, @r1
      jp     nz, @r1
      jp     nc, @r1
      call   @r1
      ldb    rh0, @r1
      ldb    rl0, @r1
      ld     r0, #0x2201
      ld     r0, @r1
      resb   rh0, r0
      resb   rl0, r0
      resb   @r1, #0
      res    r0, r0
      res    @r1, #0
      setb   rh0, r0
      setb   rl0, r0
      setb   @r1, #0
      set    r0, r0
      set    @r1, #0
      bitb   rh0, r0
      bitb   rl0, r0
      bitb   @r1, #0
      bit    r0, r0
      bit    @r1, #0
      incb   @r1, #1
      inc    @r1, #1
      decb   @r1, #1
      dec    @r1, #1
      exb    rh0, @r1
      exb    rl0, @r1
      ex     r0, @r1
      ldb    @r1, rh0
      ldb    @r1, rl0
      ld     @r1, r0
      ldrb   rh0, .+0x3105
      ldrb   rh0, .-0x1158
      ldrb   rh0, .
      ldrb   rl0, .+0x310d
      ldrb   rl0, .-0x1164
      ldrb   rl0, .
      ldb    rh0, r1(#0x3111)
      ldb    rl0, r1(#0x3119)
      ldr    r0, .+0x3206
      ldr    r0, .-0x1178
      ldr    r0, .
      ld     r0, r1(#0x3211)
      ldrb   .+0x3305, rh0
      ldrb   .-0x1188, rh0
      ldrb   ., rh0
      ldrb   .+0x330d, rl0
      ldrb   .-0x1194, rl0
      ldrb   ., rl0
      ldb    r1(#0x3311), rh0
      ldb    r1(#0x3319), rl0
      ldr    .+0x3406, r0
      ldr    .-0x11a8, r0
      ldr    ., r0
      ld     r1(#0x3411), r0
      ldar   r0, .+0x3505
      ldar   r0, .-0x11b8
      ldar   r0, .
      lda    r0, r1(#0x3511)
      ldrl   rr0, .+0x3606
      ldrl   rr0, .-0x11c8
      ldrl   rr0, .
      ldl    rr0, r1(#0x3611)
      ldrl   .+0x3806, rr0
      ldrl   .-0x11d8, rr0
      ldrl   ., rr0
      ldl    r1(#0x3811), rr0
      ldps   @r1
      inb    rh0, #0x3b05
      sinb   rh0, #0x3b06
      outb   #0x3b07, rh0
      soutb  #0x3b08, rh0
      inirb  @r1, @r1, r0
      inib   @r1, @r1, r0
      sinirb @r1, @r1, r0
      sinib  @r1, @r1, r0
      otirb  @r1, @r1, r0
      outib  @r1, @r1, r0
      sotirb @r1, @r1, r0
      soutib @r1, @r1, r0
      indrb  @r1, @r1, r0
      indb   @r1, @r1, r0
      sindrb @r1, @r1, r0
      sindb  @r1, @r1, r0
      otdrb  @r1, @r1, r0
      outdb  @r1, @r1, r0
      sotdrb @r1, @r1, r0
      soutdb @r1, @r1, r0
      inb    rl0, #0x3b85
      sinb   rl0, #0x3b86
      outb   #0x3b87, rl0
      soutb  #0x3b88, rl0
      in     r0, #0x3c05
      sin    r0, #0x3c06
      out    #0x3c07, r0
      sout   #0x3c08, r0
      inir   @r1, @r1, r0
      ini    @r1, @r1, r0
      sinir  @r1, @r1, r0
      sini   @r1, @r1, r0
      otir   @r1, @r1, r0
      outi   @r1, @r1, r0
      sotir  @r1, @r1, r0
      souti  @r1, @r1, r0
      indr   @r1, @r1, r0
      ind    @r1, @r1, r0
      sindr  @r1, @r1, r0
      sind   @r1, @r1, r0
      otdr   @r1, @r1, r0
      outd   @r1, @r1, r0
      sotdr  @r1, @r1, r0
      soutd  @r1, @r1, r0
      inb    rh0, @r1
      inb    rl0, @r1
      in     r0, @r1
      outb   @r1, rh0
      outb   @r1, rl0
      out    @r1, r0
      addb   rh0, 0x4101
      addb   rl0, 0x4109
      addb   rh0, 0x4111(r1)
      addb   rl0, 0x4119(r1)
      add    r0, 0x4202
      add    r0, 0x4211(r1)
      subb   rh0, 0x4301
      subb   rl0, 0x4309
      subb   rh0, 0x4311(r1)
      subb   rl0, 0x4319(r1)
      sub    r0, 0x4402
      sub    r0, 0x4411(r1)
      orb    rh0, 0x4501
      orb    rl0, 0x4509
      orb    rh0, 0x4511(r1)
      orb    rl0, 0x4519(r1)
      or     r0, 0x4602
      or     r0, 0x4611(r1)
      andb   rh0, 0x4701
      andb   rl0, 0x4709
      andb   rh0, 0x4711(r1)
      andb   rl0, 0x4719(r1)
      and    r0, 0x4802
      and    r0, 0x4811(r1)
      xorb   rh0, 0x4901
      xorb   rl0, 0x4909
      xorb   rh0, 0x4911(r1)
      xorb   rl0, 0x4919(r1)
      xor    r0, 0x4a02
      xor    r0, 0x4a11(r1)
      cpb    rh0, 0x4b01
      cpb    rl0, 0x4b09
      cpb    rh0, 0x4b11(r1)
      cpb    rl0, 0x4b19(r1)
      cp     r0, 0x4c02
      cp     r0, 0x4c11(r1)
      comb   0x4d01
      cpb    0x4d02, #3
      negb   0x4d03
      testb  0x4d05
      ldb    0x4d06, #7
      tsetb  0x4d07
      clrb   0x4d09
      comb   0x4d11(r1)
      cpb    0x4d12(r1), #19
      negb   0x4d13(r1)
      testb  0x4d15(r1)
      ldb    0x4d16(r1), #23
      tsetb  0x4d17(r1)
      clrb   0x4d19(r1)
      com    0x4e02
      cp     0x4e02, #0x4f03
      neg    0x4e04
      test   0x4e06
      ld     0x4e06, #0x4f07
      tset   0x4e08
      clr    0x4e0a
      com    0x4e11(r1)
      cp     0x4e12(r1), #0x4f13
      neg    0x4e13(r1)
      test   0x4e15(r1)
      ld     0x4e16(r1), #0x4f17
      tset   0x4e17(r1)
      clr    0x4e19(r1)
      cpl    rr0, 0x5102
      cpl    rr0, 0x5111(r1)
      pushl  @r1, 0x5212
      pushl  @r1, 0x5213(r2)
      subl   rr0, 0x5302
      subl   rr0, 0x5311(r1)
      push   @r1, 0x5412
      push   @r1, 0x5413(r2)
      ldl    rr0, 0x5502
      ldl    rr0, 0x5511(r1)
      popl   0x5612, @r1
      popl   0x5613(r2), @r1
      addl   rr0, 0x5702
      addl   rr0, 0x5711(r1)
      pop    0x5812, @r1
      pop    0x5813(r2), @r1
      multl  rq0, 0x5902
      multl  rq0, 0x5911(r1)
      mult   rr0, 0x5a02
      mult   rr0, 0x5a11(r1)
      divl   rq0, 0x5b02
      divl   rq0, 0x5b11(r1)
      div    rr0, 0x5c02
      div    rr0, 0x5c11(r1)
      ldm    r0, 0x0102, #1
      testl  0x5d0a
      ldm    0x0102, r0, #1
      ldm    r0, 0x0101(r1), #1
      testl  0x5d19(r1)
      ldm    0x0101(r1), r0, #1
      ldl    0x5e02, rr0
      ldl    0x5e11(r1), rr0
      jp     f, 0x5f02
      jp     lt, 0x5f02
      jp     le, 0x5f04
      jp     ule, 0x5f04
      jp     ov, 0x5f06
      jp     mi, 0x5f06
      jp     z, 0x5f08
      jp     c, 0x5f08
      jp     0x5f0a
      jp     ge, 0x5f0a
      jp     gt, 0x5f0c
      jp     ugt, 0x5f0c
      jp     nov, 0x5f0e
      jp     pl, 0x5f0e
      jp     nz, 0x5f10
      jp     nc, 0x5f10
      jp     f, 0x5f11(r1)
      jp     lt, 0x5f12(r1)
      jp     le, 0x5f13(r1)
      jp     ule, 0x5f14(r1)
      jp     ov, 0x5f15(r1)
      jp     mi, 0x5f16(r1)
      jp     z, 0x5f17(r1)
      jp     c, 0x5f18(r1)
      jp     0x5f19(r1)
      jp     ge, 0x5f1a(r1)
      jp     gt, 0x5f1b(r1)
      jp     ugt, 0x5f1c(r1)
      jp     nov, 0x5f1d(r1)
      jp     pl, 0x5f1e(r1)
      jp     nz, 0x5f1f(r1)
      jp     nc, 0x5f20(r1)
      call   0x6002
      call   0x6011(r1)
      ldb    rh0, 0x6101
      ldb    rl0, 0x6109
      ldb    rh0, 0x6111(r1)
      ldb    rl0, 0x6119(r1)
      ld     r0, 0x6202
      ld     r0, 0x6211(r1)
      resb   0x6301, #0
      resb   0x6311(r1), #0
      res    0x6402, #0
      res    0x6411(r1), #0
      setb   0x6501, #0
      setb   0x6511(r1), #0
      set    0x6602, #0
      set    0x6611(r1), #0
      bitb   0x6701, #0
      bitb   0x6711(r1), #0
      bit    0x6802, #0
      bit    0x6811(r1), #0
      incb   0x6901, #1
      incb   0x6911(r1), #1
      inc    0x6a02, #1
      inc    0x6a11(r1), #1
      decb   0x6b01, #1
      decb   0x6b11(r1), #1
      dec    0x6c02, #1
      dec    0x6c11(r1), #1
      exb    rh0, 0x6d01
      exb    rl0, 0x6d09
      exb    rh0, 0x6d11(r1)
      exb    rl0, 0x6d19(r1)
      ex     r0, 0x6e02
      ex     r0, 0x6e11(r1)
      ldb    0x6f01, rh0
      ldb    0x6f09, rl0
      ldb    0x6f11(r1), rh0
      ldb    0x6f19(r1), rl0
      ld     0x7002, r0
      ld     0x7011(r1), r0
      ldb    rh0, r1(r0)
      ldb    rl0, r1(r0)
      ld     r0, r1(r0)
      ldb    r1(r0), rh0
      ldb    r1(r0), rl0
      ld     r1(r0), r0
      lda    r0, r1(r0)
      ldl    rr0, r1(r0)
      lda    r0, 0x7701
      lda    r0, 0x7711(r1)
      ldl    r1(r0), rr0
      ldps   0x7a02
      ldps   0x7a11(r1)
      halt
      iret
      mset
      mres
      mbit
      mreq   r0
      di     vi,nvi
      di     vi
      di     nvi
      ei     vi,nvi
      ei     vi
      ei     nvi
      ldctl  r0, fcw
      ldctl  r0, refresh
      ldctl  r0, psap
      ldctl  r0, nsp
      ldctl  fcw, r0
      ldctl  refresh, r0
      ldctl  psap, r0
      ldctl  nsp, r0
      sc     #0
      addb   rh0, rh0
      addb   rl0, rh0
      addb   rh0, rl0
      addb   rl0, rl0
      add    r0, r0
      subb   rh0, rh0
      subb   rl0, rh0
      subb   rh0, rl0
      subb   rl0, rl0
      sub    r0, r0
      orb    rh0, rh0
      orb    rl0, rh0
      orb    rh0, rl0
      orb    rl0, rl0
      or     r0, r0
      andb   rh0, rh0
      andb   rl0, rh0
      andb   rh0, rl0
      andb   rl0, rl0
      and    r0, r0
      xorb   rh0, rh0
      xorb   rl0, rh0
      xorb   rh0, rl0
      xorb   rl0, rl0
      xor    r0, r0
      cpb    rh0, rh0
      cpb    rl0, rh0
      cpb    rh0, rl0
      cpb    rl0, rl0
      cp     r0, r0
      comb   rh0
      ldctlb rh0, flags
      negb   rh0
      testb  rh0
      tsetb  rh0
      clrb   rh0
      ldctlb flags, rh0
      comb   rl0
      ldctlb rl0, flags
      negb   rl0
      testb  rl0
      tsetb  rl0
      clrb   rl0
      ldctlb flags, rl0
      com    r0
      neg    r0
      test   r0
      tset   r0
      nop
      clr    r0
      setflg p
      resflg p
      comflg p
      setflg s
      resflg s
      comflg s
      setflg s,p
      resflg s,p
      comflg s,p
      setflg z
      resflg z
      comflg z
      setflg z,p
      resflg z,p
      comflg z,p
      setflg z,s
      resflg z,s
      comflg z,s
      setflg z,s,p
      resflg z,s,p
      comflg z,s,p
      setflg c
      resflg c
      comflg c
      setflg c,p
      resflg c,p
      comflg c,p
      setflg c,s
      resflg c,s
      comflg c,s
      setflg c,s,p
      resflg c,s,p
      comflg c,s,p
      setflg c,z
      resflg c,z
      comflg c,z
      setflg c,z,p
      resflg c,z,p
      comflg c,z,p
      setflg c,z,s
      resflg c,z,s
      comflg c,z,s
      setflg c,z,s,p
      resflg c,z,s,p
      comflg c,z,s,p
      cpl    rr0, rr0
      pushl  @r1, rr2
      subl   rr0, rr0
      push   @r1, r0
      ldl    rr0, rr0
      popl   rr2, @r1
      addl   rr0, rr0
      pop    r0, @r1
      multl  rq0, rr0
      mult   rr0, r0
      divl   rq0, rr0
      div    rr0, r0
      testl  rr0
      ret    f
      ret    lt
      ret    le
      ret    ule
      ret    ov
      ret    mi
      ret    z
      ret    c
      ret
      ret    ge
      ret    gt
      ret    ugt
      ret    nov
      ret    pl
      ret    nz
      ret    nc
      ldb    rh0, rh0
      ldb    rl0, rh0
      ldb    rh0, rl0
      ldb    rl0, rl0
      ld     r0, r0
      resb   rh0, #0
      resb   rl0, #0
      res    r0, #0
      setb   rh0, #0
      setb   rl0, #0
      set    r0, #0
      bitb   rh0, #0
      bitb   rl0, #0
      bit    r0, #0
      incb   rh0, #1
      incb   rl0, #1
      inc    r0, #1
      decb   rh0, #1
      decb   rl0, #1
      dec    r0, #1
      exb    rh0, rh0
      exb    rl0, rh0
      exb    rh0, rl0
      exb    rl0, rl0
      ex     r0, r0
      tccb   f, rh0
      tccb   lt, rh0
      tccb   le, rh0
      tccb   ule, rh0
      tccb   ov, rh0
      tccb   mi, rh0
      tccb   z, rh0
      tccb   c, rh0
      tccb   rh0
      tccb   ge, rh0
      tccb   gt, rh0
      tccb   ugt, rh0
      tccb   nov, rh0
      tccb   pl, rh0
      tccb   nz, rh0
      tccb   nc, rh0
      tccb   f, rl0
      tccb   lt, rl0
      tccb   le, rl0
      tccb   ule, rl0
      tccb   ov, rl0
      tccb   mi, rl0
      tccb   z, rl0
      tccb   c, rl0
      tccb   rl0
      tccb   ge, rl0
      tccb   gt, rl0
      tccb   ugt, rl0
      tccb   nov, rl0
      tccb   pl, rl0
      tccb   nz, rl0
      tccb   nc, rl0
      tcc    f, r0
      tcc    lt, r0
      tcc    le, r0
      tcc    ule, r0
      tcc    ov, r0
      tcc    mi, r0
      tcc    z, r0
      tcc    c, r0
      tcc    r0
      tcc    ge, r0
      tcc    gt, r0
      tcc    ugt, r0
      tcc    nov, r0
      tcc    pl, r0
      tcc    nz, r0
      tcc    nc, r0
      dab    rh0
      dab    rl0
      extsb  r0
      extsl  rq0
      exts   rr0
      rlb    rh0, #1
      srlb   rh0, #8
      sllb   rh0, #0
      sdlb   rh0, r0
      rrb    rh0, #1
      rlcb   rh0, #1
      srab   rh0, #8
      slab   rh0, #0
      sdab   rh0, r0
      rrcb   rh0, #1
      rlb    rl0, #1
      srlb   rl0, #8
      sllb   rl0, #0
      sdlb   rl0, r0
      rrb    rl0, #1
      rlcb   rl0, #1
      srab   rl0, #8
      slab   rl0, #0
      sdab   rl0, r0
      rrcb   rl0, #1
      rl     r0, #1
      srl    r0, #16
      sll    r0, #0
      sdl    r0, r0
      rr     r0, #1
      srll   rr0, #32
      slll   rr0, #0
      sdll   rr0, r0
      rlc    r0, #1
      sra    r0, #16
      sla    r0, #0
      sda    r0, r0
      rrc    r0, #1
      sral   rr0, #32
      slal   rr0, #0
      sdal   rr0, r0
      adcb   rh0, rh0
      adcb   rl0, rh0
      adcb   rh0, rl0
      adcb   rl0, rl0
      adc    r0, r0
      sbcb   rh0, rh0
      sbcb   rl0, rh0
      sbcb   rh0, rl0
      sbcb   rl0, rl0
      sbc    r0, r0
      trib   @r2, @r3, r0
      trtib  @r2, @r3, r0
      trirb  @r2, @r3, r0
      trtirb @r2, @r3, r0
      trdb   @r2, @r3, r0
      trtdb  @r2, @r3, r0
      trdrb  @r2, @r3, r0
      trtdrb @r2, @r3, r0
      cpib   rh2, @r1, r0, f
      cpib   rh2, @r1, r0, lt
      cpib   rh2, @r1, r0, le
      cpib   rh2, @r1, r0, ule
      cpib   rh2, @r1, r0, ov
      cpib   rh2, @r1, r0, mi
      cpib   rh2, @r1, r0, z
      cpib   rh2, @r1, r0, c
      cpib   rh2, @r1, r0
      cpib   rh2, @r1, r0, ge
      cpib   rh2, @r1, r0, gt
      cpib   rh2, @r1, r0, ugt
      cpib   rh2, @r1, r0, nov
      cpib   rh2, @r1, r0, pl
      cpib   rh2, @r1, r0, nz
      cpib   rh2, @r1, r0, nc
      cpib   rl2, @r1, r0, f
      cpib   rl2, @r1, r0, lt
      cpib   rl2, @r1, r0, le
      cpib   rl2, @r1, r0, ule
      cpib   rl2, @r1, r0, ov
      cpib   rl2, @r1, r0, mi
      cpib   rl2, @r1, r0, z
      cpib   rl2, @r1, r0, c
      cpib   rl2, @r1, r0
      cpib   rl2, @r1, r0, ge
      cpib   rl2, @r1, r0, gt
      cpib   rl2, @r1, r0, ugt
      cpib   rl2, @r1, r0, nov
      cpib   rl2, @r1, r0, pl
      cpib   rl2, @r1, r0, nz
      cpib   rl2, @r1, r0, nc
      ldirb  @r2, @r1, r0
      ldib   @r2, @r1, r0
      cpsib  @r2, @r1, r0, f
      cpsib  @r2, @r1, r0, lt
      cpsib  @r2, @r1, r0, le
      cpsib  @r2, @r1, r0, ule
      cpsib  @r2, @r1, r0, ov
      cpsib  @r2, @r1, r0, mi
      cpsib  @r2, @r1, r0, z
      cpsib  @r2, @r1, r0, c
      cpsib  @r2, @r1, r0
      cpsib  @r2, @r1, r0, ge
      cpsib  @r2, @r1, r0, gt
      cpsib  @r2, @r1, r0, ugt
      cpsib  @r2, @r1, r0, nov
      cpsib  @r2, @r1, r0, pl
      cpsib  @r2, @r1, r0, nz
      cpsib  @r2, @r1, r0, nc
      cpirb  rh2, @r1, r0, f
      cpirb  rh2, @r1, r0, lt
      cpirb  rh2, @r1, r0, le
      cpirb  rh2, @r1, r0, ule
      cpirb  rh2, @r1, r0, ov
      cpirb  rh2, @r1, r0, mi
      cpirb  rh2, @r1, r0, z
      cpirb  rh2, @r1, r0, c
      cpirb  rh2, @r1, r0
      cpirb  rh2, @r1, r0, ge
      cpirb  rh2, @r1, r0, gt
      cpirb  rh2, @r1, r0, ugt
      cpirb  rh2, @r1, r0, nov
      cpirb  rh2, @r1, r0, pl
      cpirb  rh2, @r1, r0, nz
      cpirb  rh2, @r1, r0, nc
      cpirb  rl2, @r1, r0, f
      cpirb  rl2, @r1, r0, lt
      cpirb  rl2, @r1, r0, le
      cpirb  rl2, @r1, r0, ule
      cpirb  rl2, @r1, r0, ov
      cpirb  rl2, @r1, r0, mi
      cpirb  rl2, @r1, r0, z
      cpirb  rl2, @r1, r0, c
      cpirb  rl2, @r1, r0
      cpirb  rl2, @r1, r0, ge
      cpirb  rl2, @r1, r0, gt
      cpirb  rl2, @r1, r0, ugt
      cpirb  rl2, @r1, r0, nov
      cpirb  rl2, @r1, r0, pl
      cpirb  rl2, @r1, r0, nz
      cpirb  rl2, @r1, r0, nc
      cpsirb @r2, @r1, r0, f
      cpsirb @r2, @r1, r0, lt
      cpsirb @r2, @r1, r0, le
      cpsirb @r2, @r1, r0, ule
      cpsirb @r2, @r1, r0, ov
      cpsirb @r2, @r1, r0, mi
      cpsirb @r2, @r1, r0, z
      cpsirb @r2, @r1, r0, c
      cpsirb @r2, @r1, r0
      cpsirb @r2, @r1, r0, ge
      cpsirb @r2, @r1, r0, gt
      cpsirb @r2, @r1, r0, ugt
      cpsirb @r2, @r1, r0, nov
      cpsirb @r2, @r1, r0, pl
      cpsirb @r2, @r1, r0, nz
      cpsirb @r2, @r1, r0, nc
      cpdb   rh2, @r1, r0, f
      cpdb   rh2, @r1, r0, lt
      cpdb   rh2, @r1, r0, le
      cpdb   rh2, @r1, r0, ule
      cpdb   rh2, @r1, r0, ov
      cpdb   rh2, @r1, r0, mi
      cpdb   rh2, @r1, r0, z
      cpdb   rh2, @r1, r0, c
      cpdb   rh2, @r1, r0
      cpdb   rh2, @r1, r0, ge
      cpdb   rh2, @r1, r0, gt
      cpdb   rh2, @r1, r0, ugt
      cpdb   rh2, @r1, r0, nov
      cpdb   rh2, @r1, r0, pl
      cpdb   rh2, @r1, r0, nz
      cpdb   rh2, @r1, r0, nc
      cpdb   rl2, @r1, r0, f
      cpdb   rl2, @r1, r0, lt
      cpdb   rl2, @r1, r0, le
      cpdb   rl2, @r1, r0, ule
      cpdb   rl2, @r1, r0, ov
      cpdb   rl2, @r1, r0, mi
      cpdb   rl2, @r1, r0, z
      cpdb   rl2, @r1, r0, c
      cpdb   rl2, @r1, r0
      cpdb   rl2, @r1, r0, ge
      cpdb   rl2, @r1, r0, gt
      cpdb   rl2, @r1, r0, ugt
      cpdb   rl2, @r1, r0, nov
      cpdb   rl2, @r1, r0, pl
      cpdb   rl2, @r1, r0, nz
      cpdb   rl2, @r1, r0, nc
      lddrb  @r2, @r1, r0
      lddb   @r2, @r1, r0
      cpsdb  @r2, @r1, r0, f
      cpsdb  @r2, @r1, r0, lt
      cpsdb  @r2, @r1, r0, le
      cpsdb  @r2, @r1, r0, ule
      cpsdb  @r2, @r1, r0, ov
      cpsdb  @r2, @r1, r0, mi
      cpsdb  @r2, @r1, r0, z
      cpsdb  @r2, @r1, r0, c
      cpsdb  @r2, @r1, r0
      cpsdb  @r2, @r1, r0, ge
      cpsdb  @r2, @r1, r0, gt
      cpsdb  @r2, @r1, r0, ugt
      cpsdb  @r2, @r1, r0, nov
      cpsdb  @r2, @r1, r0, pl
      cpsdb  @r2, @r1, r0, nz
      cpsdb  @r2, @r1, r0, nc
      cpdrb  rh2, @r1, r0, f
      cpdrb  rh2, @r1, r0, lt
      cpdrb  rh2, @r1, r0, le
      cpdrb  rh2, @r1, r0, ule
      cpdrb  rh2, @r1, r0, ov
      cpdrb  rh2, @r1, r0, mi
      cpdrb  rh2, @r1, r0, z
      cpdrb  rh2, @r1, r0, c
      cpdrb  rh2, @r1, r0
      cpdrb  rh2, @r1, r0, ge
      cpdrb  rh2, @r1, r0, gt
      cpdrb  rh2, @r1, r0, ugt
      cpdrb  rh2, @r1, r0, nov
      cpdrb  rh2, @r1, r0, pl
      cpdrb  rh2, @r1, r0, nz
      cpdrb  rh2, @r1, r0, nc
      cpdrb  rl2, @r1, r0, f
      cpdrb  rl2, @r1, r0, lt
      cpdrb  rl2, @r1, r0, le
      cpdrb  rl2, @r1, r0, ule
      cpdrb  rl2, @r1, r0, ov
      cpdrb  rl2, @r1, r0, mi
      cpdrb  rl2, @r1, r0, z
      cpdrb  rl2, @r1, r0, c
      cpdrb  rl2, @r1, r0
      cpdrb  rl2, @r1, r0, ge
      cpdrb  rl2, @r1, r0, gt
      cpdrb  rl2, @r1, r0, ugt
      cpdrb  rl2, @r1, r0, nov
      cpdrb  rl2, @r1, r0, pl
      cpdrb  rl2, @r1, r0, nz
      cpdrb  rl2, @r1, r0, nc
      cpsdrb @r2, @r1, r0, f
      cpsdrb @r2, @r1, r0, lt
      cpsdrb @r2, @r1, r0, le
      cpsdrb @r2, @r1, r0, ule
      cpsdrb @r2, @r1, r0, ov
      cpsdrb @r2, @r1, r0, mi
      cpsdrb @r2, @r1, r0, z
      cpsdrb @r2, @r1, r0, c
      cpsdrb @r2, @r1, r0
      cpsdrb @r2, @r1, r0, ge
      cpsdrb @r2, @r1, r0, gt
      cpsdrb @r2, @r1, r0, ugt
      cpsdrb @r2, @r1, r0, nov
      cpsdrb @r2, @r1, r0, pl
      cpsdrb @r2, @r1, r0, nz
      cpsdrb @r2, @r1, r0, nc
      cpi    r2, @r1, r0, f
      cpi    r2, @r1, r0, lt
      cpi    r2, @r1, r0, le
      cpi    r2, @r1, r0, ule
      cpi    r2, @r1, r0, ov
      cpi    r2, @r1, r0, mi
      cpi    r2, @r1, r0, z
      cpi    r2, @r1, r0, c
      cpi    r2, @r1, r0
      cpi    r2, @r1, r0, ge
      cpi    r2, @r1, r0, gt
      cpi    r2, @r1, r0, ugt
      cpi    r2, @r1, r0, nov
      cpi    r2, @r1, r0, pl
      cpi    r2, @r1, r0, nz
      cpi    r2, @r1, r0, nc
      ldir   @r2, @r1, r0
      ldi    @r2, @r1, r0
      cpsi   @r2, @r1, r0, f
      cpsi   @r2, @r1, r0, lt
      cpsi   @r2, @r1, r0, le
      cpsi   @r2, @r1, r0, ule
      cpsi   @r2, @r1, r0, ov
      cpsi   @r2, @r1, r0, mi
      cpsi   @r2, @r1, r0, z
      cpsi   @r2, @r1, r0, c
      cpsi   @r2, @r1, r0
      cpsi   @r2, @r1, r0, ge
      cpsi   @r2, @r1, r0, gt
      cpsi   @r2, @r1, r0, ugt
      cpsi   @r2, @r1, r0, nov
      cpsi   @r2, @r1, r0, pl
      cpsi   @r2, @r1, r0, nz
      cpsi   @r2, @r1, r0, nc
      cpir   r2, @r1, r0, f
      cpir   r2, @r1, r0, lt
      cpir   r2, @r1, r0, le
      cpir   r2, @r1, r0, ule
      cpir   r2, @r1, r0, ov
      cpir   r2, @r1, r0, mi
      cpir   r2, @r1, r0, z
      cpir   r2, @r1, r0, c
      cpir   r2, @r1, r0
      cpir   r2, @r1, r0, ge
      cpir   r2, @r1, r0, gt
      cpir   r2, @r1, r0, ugt
      cpir   r2, @r1, r0, nov
      cpir   r2, @r1, r0, pl
      cpir   r2, @r1, r0, nz
      cpir   r2, @r1, r0, nc
      cpsir  @r2, @r1, r0, f
      cpsir  @r2, @r1, r0, lt
      cpsir  @r2, @r1, r0, le
      cpsir  @r2, @r1, r0, ule
      cpsir  @r2, @r1, r0, ov
      cpsir  @r2, @r1, r0, mi
      cpsir  @r2, @r1, r0, z
      cpsir  @r2, @r1, r0, c
      cpsir  @r2, @r1, r0
      cpsir  @r2, @r1, r0, ge
      cpsir  @r2, @r1, r0, gt
      cpsir  @r2, @r1, r0, ugt
      cpsir  @r2, @r1, r0, nov
      cpsir  @r2, @r1, r0, pl
      cpsir  @r2, @r1, r0, nz
      cpsir  @r2, @r1, r0, nc
      cpd    r2, @r1, r0, f
      cpd    r2, @r1, r0, lt
      cpd    r2, @r1, r0, le
      cpd    r2, @r1, r0, ule
      cpd    r2, @r1, r0, ov
      cpd    r2, @r1, r0, mi
      cpd    r2, @r1, r0, z
      cpd    r2, @r1, r0, c
      cpd    r2, @r1, r0
      cpd    r2, @r1, r0, ge
      cpd    r2, @r1, r0, gt
      cpd    r2, @r1, r0, ugt
      cpd    r2, @r1, r0, nov
      cpd    r2, @r1, r0, pl
      cpd    r2, @r1, r0, nz
      cpd    r2, @r1, r0, nc
      lddr   @r2, @r1, r0
      ldd    @r2, @r1, r0
      cpsd   @r2, @r1, r0, f
      cpsd   @r2, @r1, r0, lt
      cpsd   @r2, @r1, r0, le
      cpsd   @r2, @r1, r0, ule
      cpsd   @r2, @r1, r0, ov
      cpsd   @r2, @r1, r0, mi
      cpsd   @r2, @r1, r0, z
      cpsd   @r2, @r1, r0, c
      cpsd   @r2, @r1, r0
      cpsd   @r2, @r1, r0, ge
      cpsd   @r2, @r1, r0, gt
      cpsd   @r2, @r1, r0, ugt
      cpsd   @r2, @r1, r0, nov
      cpsd   @r2, @r1, r0, pl
      cpsd   @r2, @r1, r0, nz
      cpsd   @r2, @r1, r0, nc
      cpdr   r2, @r1, r0, f
      cpdr   r2, @r1, r0, lt
      cpdr   r2, @r1, r0, le
      cpdr   r2, @r1, r0, ule
      cpdr   r2, @r1, r0, ov
      cpdr   r2, @r1, r0, mi
      cpdr   r2, @r1, r0, z
      cpdr   r2, @r1, r0, c
      cpdr   r2, @r1, r0
      cpdr   r2, @r1, r0, ge
      cpdr   r2, @r1, r0, gt
      cpdr   r2, @r1, r0, ugt
      cpdr   r2, @r1, r0, nov
      cpdr   r2, @r1, r0, pl
      cpdr   r2, @r1, r0, nz
      cpdr   r2, @r1, r0, nc
      cpsdr  @r2, @r1, r0, f
      cpsdr  @r2, @r1, r0, lt
      cpsdr  @r2, @r1, r0, le
      cpsdr  @r2, @r1, r0, ule
      cpsdr  @r2, @r1, r0, ov
      cpsdr  @r2, @r1, r0, mi
      cpsdr  @r2, @r1, r0, z
      cpsdr  @r2, @r1, r0, c
      cpsdr  @r2, @r1, r0
      cpsdr  @r2, @r1, r0, ge
      cpsdr  @r2, @r1, r0, gt
      cpsdr  @r2, @r1, r0, ugt
      cpsdr  @r2, @r1, r0, nov
      cpsdr  @r2, @r1, r0, pl
      cpsdr  @r2, @r1, r0, nz
      cpsdr  @r2, @r1, r0, nc
      rrdb   rh0, rh0
      rrdb   rl0, rh0
      rrdb   rh0, rl0
      rrdb   rl0, rl0
      ldk    r0, #0
      rldb   rh0, rh0
      rldb   rl0, rh0
      rldb   rh0, rl0
      rldb   rl0, rl0
      ldb    rh0, #0
      ldb    rl0, #0
      calr   .+2
      calr   .
      calr   .-2
      jr     f, .+2
      jr     f, .-254
      jr     f, .
      jr     lt, .+2
      jr     lt, .-254
      jr     lt, .
      jr     le, .+2
      jr     le, .-254
      jr     le, .
      jr     ule, .+2
      jr     ule, .-254
      jr     ule, .
      jr     ov, .+2
      jr     ov, .-254
      jr     ov, .
      jr     mi, .+2
      jr     mi, .-254
      jr     mi, .
      jr     z, .+2
      jr     z, .-254
      jr     z, .
      jr     c, .+2
      jr     c, .-254
      jr     c, .
      jr     .+2
      jr     .-254
      jr     .
      jr     ge, .+2
      jr     ge, .-254
      jr     ge, .
      jr     gt, .+2
      jr     gt, .-254
      jr     gt, .
      jr     ugt, .+2
      jr     ugt, .-254
      jr     ugt, .
      jr     nov, .+2
      jr     nov, .-254
      jr     nov, .
      jr     pl, .+2
      jr     pl, .-254
      jr     pl, .
      jr     nz, .+2
      jr     nz, .-254
      jr     nz, .
      jr     nc, .+2
      jr     nc, .-254
      jr     nc, .
      dbjnz  rh0, .+2
      dbjnz  rh0, .
      dbjnz  rh0, .-2
      djnz   r0, .+2
      djnz   r0, .
      djnz   r0, .-2
      dbjnz  rl0, .+2
      dbjnz  rl0, .
      dbjnz  rl0, .-2
