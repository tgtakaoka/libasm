;### AUTO GENERATED FILE
;### generated by: gen_z8000 -g -C Z8001 -o gen_z8k1.inc -l gen_z8k1.lst
      addb   rh0, #1
      addb   rl0, #9
      addb   rh0, @rr2
      addb   rl0, @rr2
      add    r0, #0x0201
      add    r0, @rr2
      subb   rh0, #1
      subb   rl0, #9
      subb   rh0, @rr2
      subb   rl0, @rr2
      sub    r0, #0x0401
      sub    r0, @rr2
      orb    rh0, #1
      orb    rl0, #9
      orb    rh0, @rr2
      orb    rl0, @rr2
      or     r0, #0x0601
      or     r0, @rr2
      andb   rh0, #1
      andb   rl0, #9
      andb   rh0, @rr2
      andb   rl0, @rr2
      and    r0, #0x0801
      and    r0, @rr2
      xorb   rh0, #1
      xorb   rl0, #9
      xorb   rh0, @rr2
      xorb   rl0, @rr2
      xor    r0, #0x0a01
      xor    r0, @rr2
      cpb    rh0, #1
      cpb    rl0, #9
      cpb    rh0, @rr2
      cpb    rl0, @rr2
      cp     r0, #0x0c01
      cp     r0, @rr2
      comb   @rr2
      cpb    @rr2, #0x22
      negb   @rr2
      testb  @rr2
      ldb    @rr2, #0x26
      tsetb  @rr2
      clrb   @rr2
      com    @rr2
      cp     @rr2, #0x0e22
      neg    @rr2
      test   @rr2
      ld     @rr2, #0x0e26
      tset   @rr2
      clr    @rr2
      push   @rr2, #0x0e2a
      cpl    rr0, #0x11011202
      cpl    rr0, @rr2
      pushl  @rr2, @rr4
      subl   rr0, #0x13011402
      subl   rr0, @rr2
      push   @rr2, @rr4
      ldl    rr0, #0x15011602
      ldl    rr0, @rr2
      popl   @rr4, @rr2
      addl   rr0, #0x17011802
      addl   rr0, @rr2
      pop    @rr4, @rr2
      multl  rq0, #0x19011a02
      multl  rq0, @rr2
      mult   rr0, #0x1a01
      mult   rr0, @rr2
      divl   rq0, #0x1b011c02
      divl   rq0, @rr2
      div    rr0, #0x1c01
      div    rr0, @rr2
      ldm    r0, @rr2, #1
      testl  @rr2
      ldm    @rr2, r0, #1
      ldl    @rr2, rr0
      jp     f, @rr2
      jp     lt, @rr2
      jp     le, @rr2
      jp     ule, @rr2
      jp     ov, @rr2
      jp     mi, @rr2
      jp     z, @rr2
      jp     c, @rr2
      jp     @rr2
      jp     ge, @rr2
      jp     gt, @rr2
      jp     ugt, @rr2
      jp     nov, @rr2
      jp     pl, @rr2
      jp     nz, @rr2
      jp     nc, @rr2
      call   @rr2
      ldb    rh0, @rr2
      ldb    rl0, @rr2
      ld     r0, #0x2201
      ld     r0, @rr2
      resb   rh0, r0
      resb   rl0, r0
      resb   @rr2, #0
      res    r0, r0
      res    @rr2, #0
      setb   rh0, r0
      setb   rl0, r0
      setb   @rr2, #0
      set    r0, r0
      set    @rr2, #0
      bitb   rh0, r0
      bitb   rl0, r0
      bitb   @rr2, #0
      bit    r0, r0
      bit    @rr2, #0
      incb   @rr2, #1
      inc    @rr2, #1
      decb   @rr2, #1
      dec    @rr2, #1
      exb    rh0, @rr2
      exb    rl0, @rr2
      ex     r0, @rr2
      ldb    @rr2, rh0
      ldb    @rr2, rl0
      ld     @rr2, r0
      ldrb   rh0, .+0x3106
      ldrb   rh0, .-0x1158
      ldrb   rh0, .
      ldrb   rl0, .+0x310e
      ldrb   rl0, .-0x1164
      ldrb   rl0, .
      ldb    rh0, rr2(#0x3121)
      ldb    rl0, rr2(#0x3129)
      ldr    r0, .+0x3206
      ldr    r0, .-0x1178
      ldr    r0, .
      ld     r0, rr2(#0x3221)
      ldrb   .+0x3306, rh0
      ldrb   .-0x1188, rh0
      ldrb   ., rh0
      ldrb   .+0x330e, rl0
      ldrb   .-0x1194, rl0
      ldrb   ., rl0
      ldb    rr2(#0x3321), rh0
      ldb    rr2(#0x3329), rl0
      ldr    .+0x3406, r0
      ldr    .-0x11a8, r0
      ldr    ., r0
      ld     rr2(#0x3421), r0
      ldar   rr0, .+0x3506
      ldar   rr0, .-0x11b8
      ldar   rr0, .
      lda    rr0, rr2(#0x3521)
      ldrl   rr0, .+0x3606
      ldrl   rr0, .-0x11c8
      ldrl   rr0, .
      ldl    rr0, rr2(#0x3621)
      ldrl   .+0x3806, rr0
      ldrl   .-0x11d8, rr0
      ldrl   ., rr0
      ldl    rr2(#0x3821), rr0
      ldps   @rr2
      inb    rh0, #0x3b05
      sinb   rh0, #0x3b06
      outb   #0x3b07, rh0
      soutb  #0x3b08, rh0
      inirb  @rr2, @r1, r0
      inib   @rr2, @r1, r0
      sinirb @rr2, @r1, r0
      sinib  @rr2, @r1, r0
      indrb  @rr2, @r1, r0
      indb   @rr2, @r1, r0
      sindrb @rr2, @r1, r0
      sindb  @rr2, @r1, r0
      otirb  @r1, @rr2, r0
      outib  @r1, @rr2, r0
      sotirb @r1, @rr2, r0
      soutib @r1, @rr2, r0
      otdrb  @r1, @rr2, r0
      outdb  @r1, @rr2, r0
      sotdrb @r1, @rr2, r0
      soutdb @r1, @rr2, r0
      inb    rl0, #0x3b85
      sinb   rl0, #0x3b86
      outb   #0x3b87, rl0
      soutb  #0x3b88, rl0
      in     r0, #0x3c05
      sin    r0, #0x3c06
      out    #0x3c07, r0
      sout   #0x3c08, r0
      inir   @rr2, @r1, r0
      ini    @rr2, @r1, r0
      sinir  @rr2, @r1, r0
      sini   @rr2, @r1, r0
      indr   @rr2, @r1, r0
      ind    @rr2, @r1, r0
      sindr  @rr2, @r1, r0
      sind   @rr2, @r1, r0
      otir   @r1, @rr2, r0
      outi   @r1, @rr2, r0
      sotir  @r1, @rr2, r0
      souti  @r1, @rr2, r0
      otdr   @r1, @rr2, r0
      outd   @r1, @rr2, r0
      sotdr  @r1, @rr2, r0
      soutd  @r1, @rr2, r0
      inb    rh0, @r1
      inb    rl0, @r1
      in     r0, @r1
      outb   @r1, rh0
      outb   @r1, rl0
      out    @r1, r0
      addb   rh0, 0x410001
      addb   rh0, 0x008101
      addb   rl0, 0x410009
      addb   rl0, 0x008101
      addb   rh0, 0x410011(r1)
      addb   rh0, 0x008101(r1)
      addb   rl0, 0x410019(r1)
      addb   rl0, 0x008101(r1)
      add    r0, 0x420001
      add    r0, 0x008101
      add    r0, 0x420011(r1)
      add    r0, 0x008101(r1)
      subb   rh0, 0x430001
      subb   rh0, 0x008101
      subb   rl0, 0x430009
      subb   rl0, 0x008101
      subb   rh0, 0x430011(r1)
      subb   rh0, 0x008101(r1)
      subb   rl0, 0x430019(r1)
      subb   rl0, 0x008101(r1)
      sub    r0, 0x440001
      sub    r0, 0x008101
      sub    r0, 0x440011(r1)
      sub    r0, 0x008101(r1)
      orb    rh0, 0x450001
      orb    rh0, 0x008101
      orb    rl0, 0x450009
      orb    rl0, 0x008101
      orb    rh0, 0x450011(r1)
      orb    rh0, 0x008101(r1)
      orb    rl0, 0x450019(r1)
      orb    rl0, 0x008101(r1)
      or     r0, 0x460001
      or     r0, 0x008101
      or     r0, 0x460011(r1)
      or     r0, 0x008101(r1)
      andb   rh0, 0x470001
      andb   rh0, 0x008101
      andb   rl0, 0x470009
      andb   rl0, 0x008101
      andb   rh0, 0x470011(r1)
      andb   rh0, 0x008101(r1)
      andb   rl0, 0x470019(r1)
      andb   rl0, 0x008101(r1)
      and    r0, 0x480001
      and    r0, 0x008101
      and    r0, 0x480011(r1)
      and    r0, 0x008101(r1)
      xorb   rh0, 0x490001
      xorb   rh0, 0x008101
      xorb   rl0, 0x490009
      xorb   rl0, 0x008101
      xorb   rh0, 0x490011(r1)
      xorb   rh0, 0x008101(r1)
      xorb   rl0, 0x490019(r1)
      xorb   rl0, 0x008101(r1)
      xor    r0, 0x4a0001
      xor    r0, 0x008101
      xor    r0, 0x4a0011(r1)
      xor    r0, 0x008101(r1)
      cpb    rh0, 0x4b0001
      cpb    rh0, 0x008101
      cpb    rl0, 0x4b0009
      cpb    rl0, 0x008101
      cpb    rh0, 0x4b0011(r1)
      cpb    rh0, 0x008101(r1)
      cpb    rl0, 0x4b0019(r1)
      cpb    rl0, 0x008101(r1)
      cp     r0, 0x4c0001
      cp     r0, 0x008101
      cp     r0, 0x4c0011(r1)
      cp     r0, 0x008101(r1)
      comb   0x4d0001
      comb   0x008101
      cpb    0x4d0002, #3
      cpb    0x018201, #2
      negb   0x4d0003
      negb   0x008101
      testb  0x4d0005
      testb  0x008101
      ldb    0x4d0006, #7
      ldb    0x018201, #2
      tsetb  0x4d0007
      tsetb  0x008101
      clrb   0x4d0009
      clrb   0x008101
      comb   0x4d0011(r1)
      comb   0x008101(r1)
      cpb    0x4d0012(r1), #19
      cpb    0x018201(r1), #2
      negb   0x4d0013(r1)
      negb   0x008101(r1)
      testb  0x4d0015(r1)
      testb  0x008101(r1)
      ldb    0x4d0016(r1), #23
      ldb    0x018201(r1), #2
      tsetb  0x4d0017(r1)
      tsetb  0x008101(r1)
      clrb   0x4d0019(r1)
      clrb   0x008101(r1)
      com    0x4e0001
      com    0x008101
      cp     0x4e0002, #0x4f03
      cp     0x018201, #0x8302
      neg    0x4e0003
      neg    0x008101
      test   0x4e0005
      test   0x008101
      ld     0x4e0006, #0x4f07
      ld     0x018201, #0x8302
      tset   0x4e0007
      tset   0x008101
      clr    0x4e0009
      clr    0x008101
      com    0x4e0011(r1)
      com    0x008101(r1)
      cp     0x4e0012(r1), #0x4f13
      cp     0x018201(r1), #0x8302
      neg    0x4e0013(r1)
      neg    0x008101(r1)
      test   0x4e0015(r1)
      test   0x008101(r1)
      ld     0x4e0016(r1), #0x4f17
      ld     0x018201(r1), #0x8302
      tset   0x4e0017(r1)
      tset   0x008101(r1)
      clr    0x4e0019(r1)
      clr    0x008101(r1)
      cpl    rr0, 0x510001
      cpl    rr0, 0x008101
      cpl    rr0, 0x510011(r1)
      cpl    rr0, 0x008101(r1)
      pushl  @rr2, 0x520021
      pushl  @rr2, 0x008101
      pushl  @rr2, 0x520022(r1)
      pushl  @rr2, 0x008101(r1)
      subl   rr0, 0x530001
      subl   rr0, 0x008101
      subl   rr0, 0x530011(r1)
      subl   rr0, 0x008101(r1)
      push   @rr2, 0x540021
      push   @rr2, 0x008101
      push   @rr2, 0x540022(r1)
      push   @rr2, 0x008101(r1)
      ldl    rr0, 0x550001
      ldl    rr0, 0x008101
      ldl    rr0, 0x550011(r1)
      ldl    rr0, 0x008101(r1)
      popl   0x560021, @rr2
      popl   0x008101, @rr2
      popl   0x560022(r1), @rr2
      popl   0x008101(r1), @rr2
      addl   rr0, 0x570001
      addl   rr0, 0x008101
      addl   rr0, 0x570011(r1)
      addl   rr0, 0x008101(r1)
      pop    0x580021, @rr2
      pop    0x008101, @rr2
      pop    0x580022(r1), @rr2
      pop    0x008101(r1), @rr2
      multl  rq0, 0x590001
      multl  rq0, 0x008101
      multl  rq0, 0x590011(r1)
      multl  rq0, 0x008101(r1)
      mult   rr0, 0x5a0001
      mult   rr0, 0x008101
      mult   rr0, 0x5a0011(r1)
      mult   rr0, 0x008101(r1)
      divl   rq0, 0x5b0001
      divl   rq0, 0x008101
      divl   rq0, 0x5b0011(r1)
      divl   rq0, 0x008101(r1)
      div    rr0, 0x5c0001
      div    rr0, 0x008101
      div    rr0, 0x5c0011(r1)
      div    rr0, 0x008101(r1)
      ldm    r0, 0x010001, #1
      ldm    r0, 0x008101, #1
      testl  0x5d0009
      testl  0x008101
      ldm    0x010001, r0, #1
      ldm    0x008101, r0, #1
      ldm    r0, 0x010001(r1), #1
      ldm    r0, 0x008101(r1), #1
      testl  0x5d0019(r1)
      testl  0x008101(r1)
      ldm    0x010001(r1), r0, #1
      ldm    0x008101(r1), r0, #1
      ldl    0x5e0001, rr0
      ldl    0x008101, rr0
      ldl    0x5e0011(r1), rr0
      ldl    0x008101(r1), rr0
      jp     f, 0x5f0001
      jp     f, 0x008101
      jp     lt, 0x5f0002
      jp     lt, 0x008101
      jp     le, 0x5f0003
      jp     le, 0x008101
      jp     ule, 0x5f0004
      jp     ule, 0x008101
      jp     ov, 0x5f0005
      jp     ov, 0x008101
      jp     mi, 0x5f0006
      jp     mi, 0x008101
      jp     z, 0x5f0007
      jp     z, 0x008101
      jp     c, 0x5f0008
      jp     c, 0x008101
      jp     0x5f0009
      jp     0x008101
      jp     ge, 0x5f000a
      jp     ge, 0x008101
      jp     gt, 0x5f000b
      jp     gt, 0x008101
      jp     ugt, 0x5f000c
      jp     ugt, 0x008101
      jp     nov, 0x5f000d
      jp     nov, 0x008101
      jp     pl, 0x5f000e
      jp     pl, 0x008101
      jp     nz, 0x5f000f
      jp     nz, 0x008101
      jp     nc, 0x5f0010
      jp     nc, 0x008101
      jp     f, 0x5f0011(r1)
      jp     f, 0x008101(r1)
      jp     lt, 0x5f0012(r1)
      jp     lt, 0x008101(r1)
      jp     le, 0x5f0013(r1)
      jp     le, 0x008101(r1)
      jp     ule, 0x5f0014(r1)
      jp     ule, 0x008101(r1)
      jp     ov, 0x5f0015(r1)
      jp     ov, 0x008101(r1)
      jp     mi, 0x5f0016(r1)
      jp     mi, 0x008101(r1)
      jp     z, 0x5f0017(r1)
      jp     z, 0x008101(r1)
      jp     c, 0x5f0018(r1)
      jp     c, 0x008101(r1)
      jp     0x5f0019(r1)
      jp     0x008101(r1)
      jp     ge, 0x5f001a(r1)
      jp     ge, 0x008101(r1)
      jp     gt, 0x5f001b(r1)
      jp     gt, 0x008101(r1)
      jp     ugt, 0x5f001c(r1)
      jp     ugt, 0x008101(r1)
      jp     nov, 0x5f001d(r1)
      jp     nov, 0x008101(r1)
      jp     pl, 0x5f001e(r1)
      jp     pl, 0x008101(r1)
      jp     nz, 0x5f001f(r1)
      jp     nz, 0x008101(r1)
      jp     nc, 0x5f0020(r1)
      jp     nc, 0x008101(r1)
      call   0x600001
      call   0x008101
      call   0x600011(r1)
      call   0x008101(r1)
      ldb    rh0, 0x610001
      ldb    rh0, 0x008101
      ldb    rl0, 0x610009
      ldb    rl0, 0x008101
      ldb    rh0, 0x610011(r1)
      ldb    rh0, 0x008101(r1)
      ldb    rl0, 0x610019(r1)
      ldb    rl0, 0x008101(r1)
      ld     r0, 0x620001
      ld     r0, 0x008101
      ld     r0, 0x620011(r1)
      ld     r0, 0x008101(r1)
      resb   0x630001, #0
      resb   0x008101, #0
      resb   0x630011(r1), #0
      resb   0x008101(r1), #0
      res    0x640001, #0
      res    0x008101, #0
      res    0x640011(r1), #0
      res    0x008101(r1), #0
      setb   0x650001, #0
      setb   0x008101, #0
      setb   0x650011(r1), #0
      setb   0x008101(r1), #0
      set    0x660001, #0
      set    0x008101, #0
      set    0x660011(r1), #0
      set    0x008101(r1), #0
      bitb   0x670001, #0
      bitb   0x008101, #0
      bitb   0x670011(r1), #0
      bitb   0x008101(r1), #0
      bit    0x680001, #0
      bit    0x008101, #0
      bit    0x680011(r1), #0
      bit    0x008101(r1), #0
      incb   0x690001, #1
      incb   0x008101, #1
      incb   0x690011(r1), #1
      incb   0x008101(r1), #1
      inc    0x6a0001, #1
      inc    0x008101, #1
      inc    0x6a0011(r1), #1
      inc    0x008101(r1), #1
      decb   0x6b0001, #1
      decb   0x008101, #1
      decb   0x6b0011(r1), #1
      decb   0x008101(r1), #1
      dec    0x6c0001, #1
      dec    0x008101, #1
      dec    0x6c0011(r1), #1
      dec    0x008101(r1), #1
      exb    rh0, 0x6d0001
      exb    rh0, 0x008101
      exb    rl0, 0x6d0009
      exb    rl0, 0x008101
      exb    rh0, 0x6d0011(r1)
      exb    rh0, 0x008101(r1)
      exb    rl0, 0x6d0019(r1)
      exb    rl0, 0x008101(r1)
      ex     r0, 0x6e0001
      ex     r0, 0x008101
      ex     r0, 0x6e0011(r1)
      ex     r0, 0x008101(r1)
      ldb    0x6f0001, rh0
      ldb    0x008101, rh0
      ldb    0x6f0009, rl0
      ldb    0x008101, rl0
      ldb    0x6f0011(r1), rh0
      ldb    0x008101(r1), rh0
      ldb    0x6f0019(r1), rl0
      ldb    0x008101(r1), rl0
      ld     0x700001, r0
      ld     0x008101, r0
      ld     0x700011(r1), r0
      ld     0x008101(r1), r0
      ldb    rh0, rr2(r0)
      ldb    rl0, rr2(r0)
      ld     r0, rr2(r0)
      ldb    rr2(r0), rh0
      ldb    rr2(r0), rl0
      ld     rr2(r0), r0
      lda    rr0, rr2(r0)
      ldl    rr0, rr2(r0)
      lda    rr0, 0x770001
      lda    rr0, 0x008101
      lda    rr0, 0x770011(r1)
      lda    rr0, 0x008101(r1)
      ldl    rr2(r0), rr0
      ldps   0x7a0001
      ldps   0x008101
      ldps   0x7a0011(r1)
      ldps   0x008101(r1)
      halt
      iret
      mset
      mres
      mbit
      mreq   r0
      di     vi,nvi
      di     vi
      di     nvi
      ei     vi,nvi
      ei     vi
      ei     nvi
      ldctl  r0, fcw
      ldctl  r0, refresh
      ldctl  r0, psapseg
      ldctl  r0, psapoff
      ldctl  r0, nspseg
      ldctl  r0, nspoff
      ldctl  fcw, r0
      ldctl  refresh, r0
      ldctl  psapseg, r0
      ldctl  psapoff, r0
      ldctl  nspseg, r0
      ldctl  nspoff, r0
      sc     #0
      addb   rh0, rh0
      addb   rl0, rh0
      addb   rh0, rl0
      addb   rl0, rl0
      add    r0, r0
      subb   rh0, rh0
      subb   rl0, rh0
      subb   rh0, rl0
      subb   rl0, rl0
      sub    r0, r0
      orb    rh0, rh0
      orb    rl0, rh0
      orb    rh0, rl0
      orb    rl0, rl0
      or     r0, r0
      andb   rh0, rh0
      andb   rl0, rh0
      andb   rh0, rl0
      andb   rl0, rl0
      and    r0, r0
      xorb   rh0, rh0
      xorb   rl0, rh0
      xorb   rh0, rl0
      xorb   rl0, rl0
      xor    r0, r0
      cpb    rh0, rh0
      cpb    rl0, rh0
      cpb    rh0, rl0
      cpb    rl0, rl0
      cp     r0, r0
      comb   rh0
      ldctlb rh0, flags
      negb   rh0
      testb  rh0
      tsetb  rh0
      clrb   rh0
      ldctlb flags, rh0
      comb   rl0
      ldctlb rl0, flags
      negb   rl0
      testb  rl0
      tsetb  rl0
      clrb   rl0
      ldctlb flags, rl0
      com    r0
      neg    r0
      test   r0
      tset   r0
      nop
      clr    r0
      setflg p
      resflg p
      comflg p
      setflg s
      resflg s
      comflg s
      setflg s,p
      resflg s,p
      comflg s,p
      setflg z
      resflg z
      comflg z
      setflg z,p
      resflg z,p
      comflg z,p
      setflg z,s
      resflg z,s
      comflg z,s
      setflg z,s,p
      resflg z,s,p
      comflg z,s,p
      setflg c
      resflg c
      comflg c
      setflg c,p
      resflg c,p
      comflg c,p
      setflg c,s
      resflg c,s
      comflg c,s
      setflg c,s,p
      resflg c,s,p
      comflg c,s,p
      setflg c,z
      resflg c,z
      comflg c,z
      setflg c,z,p
      resflg c,z,p
      comflg c,z,p
      setflg c,z,s
      resflg c,z,s
      comflg c,z,s
      setflg c,z,s,p
      resflg c,z,s,p
      comflg c,z,s,p
      cpl    rr0, rr0
      pushl  @rr2, rr0
      subl   rr0, rr0
      push   @rr2, r0
      ldl    rr0, rr0
      popl   rr0, @rr2
      addl   rr0, rr0
      pop    r0, @rr2
      multl  rq0, rr0
      mult   rr0, r0
      divl   rq0, rr0
      div    rr0, r0
      testl  rr0
      ret    f
      ret    lt
      ret    le
      ret    ule
      ret    ov
      ret    mi
      ret    z
      ret    c
      ret
      ret    ge
      ret    gt
      ret    ugt
      ret    nov
      ret    pl
      ret    nz
      ret    nc
      ldb    rh0, rh0
      ldb    rl0, rh0
      ldb    rh0, rl0
      ldb    rl0, rl0
      ld     r0, r0
      resb   rh0, #0
      resb   rl0, #0
      res    r0, #0
      setb   rh0, #0
      setb   rl0, #0
      set    r0, #0
      bitb   rh0, #0
      bitb   rl0, #0
      bit    r0, #0
      incb   rh0, #1
      incb   rl0, #1
      inc    r0, #1
      decb   rh0, #1
      decb   rl0, #1
      dec    r0, #1
      exb    rh0, rh0
      exb    rl0, rh0
      exb    rh0, rl0
      exb    rl0, rl0
      ex     r0, r0
      tccb   f, rh0
      tccb   lt, rh0
      tccb   le, rh0
      tccb   ule, rh0
      tccb   ov, rh0
      tccb   mi, rh0
      tccb   z, rh0
      tccb   c, rh0
      tccb   rh0
      tccb   ge, rh0
      tccb   gt, rh0
      tccb   ugt, rh0
      tccb   nov, rh0
      tccb   pl, rh0
      tccb   nz, rh0
      tccb   nc, rh0
      tccb   f, rl0
      tccb   lt, rl0
      tccb   le, rl0
      tccb   ule, rl0
      tccb   ov, rl0
      tccb   mi, rl0
      tccb   z, rl0
      tccb   c, rl0
      tccb   rl0
      tccb   ge, rl0
      tccb   gt, rl0
      tccb   ugt, rl0
      tccb   nov, rl0
      tccb   pl, rl0
      tccb   nz, rl0
      tccb   nc, rl0
      tcc    f, r0
      tcc    lt, r0
      tcc    le, r0
      tcc    ule, r0
      tcc    ov, r0
      tcc    mi, r0
      tcc    z, r0
      tcc    c, r0
      tcc    r0
      tcc    ge, r0
      tcc    gt, r0
      tcc    ugt, r0
      tcc    nov, r0
      tcc    pl, r0
      tcc    nz, r0
      tcc    nc, r0
      dab    rh0
      dab    rl0
      extsb  r0
      extsl  rq0
      exts   rr0
      rlb    rh0, #1
      sllb   rh0, #0
      srlb   rh0, #8
      sdlb   rh0, r0
      rrb    rh0, #1
      rlcb   rh0, #1
      slab   rh0, #0
      srab   rh0, #8
      sdab   rh0, r0
      rrcb   rh0, #1
      rlb    rl0, #1
      sllb   rl0, #0
      srlb   rl0, #8
      sdlb   rl0, r0
      rrb    rl0, #1
      rlcb   rl0, #1
      slab   rl0, #0
      srab   rl0, #8
      sdab   rl0, r0
      rrcb   rl0, #1
      rl     r0, #1
      srl    r0, #16
      sll    r0, #0
      sdl    r0, r0
      rr     r0, #1
      srll   rr0, #32
      slll   rr0, #0
      sdll   rr0, r0
      rlc    r0, #1
      sra    r0, #16
      sla    r0, #0
      sda    r0, r0
      rrc    r0, #1
      sral   rr0, #32
      slal   rr0, #0
      sdal   rr0, r0
      adcb   rh0, rh0
      adcb   rl0, rh0
      adcb   rh0, rl0
      adcb   rl0, rl0
      adc    r0, r0
      sbcb   rh0, rh0
      sbcb   rl0, rh0
      sbcb   rh0, rl0
      sbcb   rl0, rl0
      sbc    r0, r0
      trib   @rr2, @rr4, r0
      trtib  @rr2, @rr4, r0
      trirb  @rr2, @rr4, r0
      trtirb @rr2, @rr4, r0
      trdb   @rr2, @rr4, r0
      trtdb  @rr2, @rr4, r0
      trdrb  @rr2, @rr4, r0
      trtdrb @rr2, @rr4, r0
      cpib   rh1, @rr2, r0, f
      cpib   rh1, @rr2, r0, lt
      cpib   rh1, @rr2, r0, le
      cpib   rh1, @rr2, r0, ule
      cpib   rh1, @rr2, r0, ov
      cpib   rh1, @rr2, r0, mi
      cpib   rh1, @rr2, r0, z
      cpib   rh1, @rr2, r0, c
      cpib   rh1, @rr2, r0
      cpib   rh1, @rr2, r0, ge
      cpib   rh1, @rr2, r0, gt
      cpib   rh1, @rr2, r0, ugt
      cpib   rh1, @rr2, r0, nov
      cpib   rh1, @rr2, r0, pl
      cpib   rh1, @rr2, r0, nz
      cpib   rh1, @rr2, r0, nc
      cpib   rl1, @rr2, r0, f
      cpib   rl1, @rr2, r0, lt
      cpib   rl1, @rr2, r0, le
      cpib   rl1, @rr2, r0, ule
      cpib   rl1, @rr2, r0, ov
      cpib   rl1, @rr2, r0, mi
      cpib   rl1, @rr2, r0, z
      cpib   rl1, @rr2, r0, c
      cpib   rl1, @rr2, r0
      cpib   rl1, @rr2, r0, ge
      cpib   rl1, @rr2, r0, gt
      cpib   rl1, @rr2, r0, ugt
      cpib   rl1, @rr2, r0, nov
      cpib   rl1, @rr2, r0, pl
      cpib   rl1, @rr2, r0, nz
      cpib   rl1, @rr2, r0, nc
      ldirb  @rr4, @rr2, r0
      ldib   @rr4, @rr2, r0
      cpsib  @rr4, @rr2, r0, f
      cpsib  @rr4, @rr2, r0, lt
      cpsib  @rr4, @rr2, r0, le
      cpsib  @rr4, @rr2, r0, ule
      cpsib  @rr4, @rr2, r0, ov
      cpsib  @rr4, @rr2, r0, mi
      cpsib  @rr4, @rr2, r0, z
      cpsib  @rr4, @rr2, r0, c
      cpsib  @rr4, @rr2, r0
      cpsib  @rr4, @rr2, r0, ge
      cpsib  @rr4, @rr2, r0, gt
      cpsib  @rr4, @rr2, r0, ugt
      cpsib  @rr4, @rr2, r0, nov
      cpsib  @rr4, @rr2, r0, pl
      cpsib  @rr4, @rr2, r0, nz
      cpsib  @rr4, @rr2, r0, nc
      cpirb  rh1, @rr2, r0, f
      cpirb  rh1, @rr2, r0, lt
      cpirb  rh1, @rr2, r0, le
      cpirb  rh1, @rr2, r0, ule
      cpirb  rh1, @rr2, r0, ov
      cpirb  rh1, @rr2, r0, mi
      cpirb  rh1, @rr2, r0, z
      cpirb  rh1, @rr2, r0, c
      cpirb  rh1, @rr2, r0
      cpirb  rh1, @rr2, r0, ge
      cpirb  rh1, @rr2, r0, gt
      cpirb  rh1, @rr2, r0, ugt
      cpirb  rh1, @rr2, r0, nov
      cpirb  rh1, @rr2, r0, pl
      cpirb  rh1, @rr2, r0, nz
      cpirb  rh1, @rr2, r0, nc
      cpirb  rl1, @rr2, r0, f
      cpirb  rl1, @rr2, r0, lt
      cpirb  rl1, @rr2, r0, le
      cpirb  rl1, @rr2, r0, ule
      cpirb  rl1, @rr2, r0, ov
      cpirb  rl1, @rr2, r0, mi
      cpirb  rl1, @rr2, r0, z
      cpirb  rl1, @rr2, r0, c
      cpirb  rl1, @rr2, r0
      cpirb  rl1, @rr2, r0, ge
      cpirb  rl1, @rr2, r0, gt
      cpirb  rl1, @rr2, r0, ugt
      cpirb  rl1, @rr2, r0, nov
      cpirb  rl1, @rr2, r0, pl
      cpirb  rl1, @rr2, r0, nz
      cpirb  rl1, @rr2, r0, nc
      cpsirb @rr4, @rr2, r0, f
      cpsirb @rr4, @rr2, r0, lt
      cpsirb @rr4, @rr2, r0, le
      cpsirb @rr4, @rr2, r0, ule
      cpsirb @rr4, @rr2, r0, ov
      cpsirb @rr4, @rr2, r0, mi
      cpsirb @rr4, @rr2, r0, z
      cpsirb @rr4, @rr2, r0, c
      cpsirb @rr4, @rr2, r0
      cpsirb @rr4, @rr2, r0, ge
      cpsirb @rr4, @rr2, r0, gt
      cpsirb @rr4, @rr2, r0, ugt
      cpsirb @rr4, @rr2, r0, nov
      cpsirb @rr4, @rr2, r0, pl
      cpsirb @rr4, @rr2, r0, nz
      cpsirb @rr4, @rr2, r0, nc
      cpdb   rh1, @rr2, r0, f
      cpdb   rh1, @rr2, r0, lt
      cpdb   rh1, @rr2, r0, le
      cpdb   rh1, @rr2, r0, ule
      cpdb   rh1, @rr2, r0, ov
      cpdb   rh1, @rr2, r0, mi
      cpdb   rh1, @rr2, r0, z
      cpdb   rh1, @rr2, r0, c
      cpdb   rh1, @rr2, r0
      cpdb   rh1, @rr2, r0, ge
      cpdb   rh1, @rr2, r0, gt
      cpdb   rh1, @rr2, r0, ugt
      cpdb   rh1, @rr2, r0, nov
      cpdb   rh1, @rr2, r0, pl
      cpdb   rh1, @rr2, r0, nz
      cpdb   rh1, @rr2, r0, nc
      cpdb   rl1, @rr2, r0, f
      cpdb   rl1, @rr2, r0, lt
      cpdb   rl1, @rr2, r0, le
      cpdb   rl1, @rr2, r0, ule
      cpdb   rl1, @rr2, r0, ov
      cpdb   rl1, @rr2, r0, mi
      cpdb   rl1, @rr2, r0, z
      cpdb   rl1, @rr2, r0, c
      cpdb   rl1, @rr2, r0
      cpdb   rl1, @rr2, r0, ge
      cpdb   rl1, @rr2, r0, gt
      cpdb   rl1, @rr2, r0, ugt
      cpdb   rl1, @rr2, r0, nov
      cpdb   rl1, @rr2, r0, pl
      cpdb   rl1, @rr2, r0, nz
      cpdb   rl1, @rr2, r0, nc
      lddrb  @rr4, @rr2, r0
      lddb   @rr4, @rr2, r0
      cpsdb  @rr4, @rr2, r0, f
      cpsdb  @rr4, @rr2, r0, lt
      cpsdb  @rr4, @rr2, r0, le
      cpsdb  @rr4, @rr2, r0, ule
      cpsdb  @rr4, @rr2, r0, ov
      cpsdb  @rr4, @rr2, r0, mi
      cpsdb  @rr4, @rr2, r0, z
      cpsdb  @rr4, @rr2, r0, c
      cpsdb  @rr4, @rr2, r0
      cpsdb  @rr4, @rr2, r0, ge
      cpsdb  @rr4, @rr2, r0, gt
      cpsdb  @rr4, @rr2, r0, ugt
      cpsdb  @rr4, @rr2, r0, nov
      cpsdb  @rr4, @rr2, r0, pl
      cpsdb  @rr4, @rr2, r0, nz
      cpsdb  @rr4, @rr2, r0, nc
      cpdrb  rh1, @rr2, r0, f
      cpdrb  rh1, @rr2, r0, lt
      cpdrb  rh1, @rr2, r0, le
      cpdrb  rh1, @rr2, r0, ule
      cpdrb  rh1, @rr2, r0, ov
      cpdrb  rh1, @rr2, r0, mi
      cpdrb  rh1, @rr2, r0, z
      cpdrb  rh1, @rr2, r0, c
      cpdrb  rh1, @rr2, r0
      cpdrb  rh1, @rr2, r0, ge
      cpdrb  rh1, @rr2, r0, gt
      cpdrb  rh1, @rr2, r0, ugt
      cpdrb  rh1, @rr2, r0, nov
      cpdrb  rh1, @rr2, r0, pl
      cpdrb  rh1, @rr2, r0, nz
      cpdrb  rh1, @rr2, r0, nc
      cpdrb  rl1, @rr2, r0, f
      cpdrb  rl1, @rr2, r0, lt
      cpdrb  rl1, @rr2, r0, le
      cpdrb  rl1, @rr2, r0, ule
      cpdrb  rl1, @rr2, r0, ov
      cpdrb  rl1, @rr2, r0, mi
      cpdrb  rl1, @rr2, r0, z
      cpdrb  rl1, @rr2, r0, c
      cpdrb  rl1, @rr2, r0
      cpdrb  rl1, @rr2, r0, ge
      cpdrb  rl1, @rr2, r0, gt
      cpdrb  rl1, @rr2, r0, ugt
      cpdrb  rl1, @rr2, r0, nov
      cpdrb  rl1, @rr2, r0, pl
      cpdrb  rl1, @rr2, r0, nz
      cpdrb  rl1, @rr2, r0, nc
      cpsdrb @rr4, @rr2, r0, f
      cpsdrb @rr4, @rr2, r0, lt
      cpsdrb @rr4, @rr2, r0, le
      cpsdrb @rr4, @rr2, r0, ule
      cpsdrb @rr4, @rr2, r0, ov
      cpsdrb @rr4, @rr2, r0, mi
      cpsdrb @rr4, @rr2, r0, z
      cpsdrb @rr4, @rr2, r0, c
      cpsdrb @rr4, @rr2, r0
      cpsdrb @rr4, @rr2, r0, ge
      cpsdrb @rr4, @rr2, r0, gt
      cpsdrb @rr4, @rr2, r0, ugt
      cpsdrb @rr4, @rr2, r0, nov
      cpsdrb @rr4, @rr2, r0, pl
      cpsdrb @rr4, @rr2, r0, nz
      cpsdrb @rr4, @rr2, r0, nc
      cpi    r1, @rr2, r0, f
      cpi    r1, @rr2, r0, lt
      cpi    r1, @rr2, r0, le
      cpi    r1, @rr2, r0, ule
      cpi    r1, @rr2, r0, ov
      cpi    r1, @rr2, r0, mi
      cpi    r1, @rr2, r0, z
      cpi    r1, @rr2, r0, c
      cpi    r1, @rr2, r0
      cpi    r1, @rr2, r0, ge
      cpi    r1, @rr2, r0, gt
      cpi    r1, @rr2, r0, ugt
      cpi    r1, @rr2, r0, nov
      cpi    r1, @rr2, r0, pl
      cpi    r1, @rr2, r0, nz
      cpi    r1, @rr2, r0, nc
      ldir   @rr4, @rr2, r0
      ldi    @rr4, @rr2, r0
      cpsi   @rr4, @rr2, r0, f
      cpsi   @rr4, @rr2, r0, lt
      cpsi   @rr4, @rr2, r0, le
      cpsi   @rr4, @rr2, r0, ule
      cpsi   @rr4, @rr2, r0, ov
      cpsi   @rr4, @rr2, r0, mi
      cpsi   @rr4, @rr2, r0, z
      cpsi   @rr4, @rr2, r0, c
      cpsi   @rr4, @rr2, r0
      cpsi   @rr4, @rr2, r0, ge
      cpsi   @rr4, @rr2, r0, gt
      cpsi   @rr4, @rr2, r0, ugt
      cpsi   @rr4, @rr2, r0, nov
      cpsi   @rr4, @rr2, r0, pl
      cpsi   @rr4, @rr2, r0, nz
      cpsi   @rr4, @rr2, r0, nc
      cpir   r1, @rr2, r0, f
      cpir   r1, @rr2, r0, lt
      cpir   r1, @rr2, r0, le
      cpir   r1, @rr2, r0, ule
      cpir   r1, @rr2, r0, ov
      cpir   r1, @rr2, r0, mi
      cpir   r1, @rr2, r0, z
      cpir   r1, @rr2, r0, c
      cpir   r1, @rr2, r0
      cpir   r1, @rr2, r0, ge
      cpir   r1, @rr2, r0, gt
      cpir   r1, @rr2, r0, ugt
      cpir   r1, @rr2, r0, nov
      cpir   r1, @rr2, r0, pl
      cpir   r1, @rr2, r0, nz
      cpir   r1, @rr2, r0, nc
      cpsir  @rr4, @rr2, r0, f
      cpsir  @rr4, @rr2, r0, lt
      cpsir  @rr4, @rr2, r0, le
      cpsir  @rr4, @rr2, r0, ule
      cpsir  @rr4, @rr2, r0, ov
      cpsir  @rr4, @rr2, r0, mi
      cpsir  @rr4, @rr2, r0, z
      cpsir  @rr4, @rr2, r0, c
      cpsir  @rr4, @rr2, r0
      cpsir  @rr4, @rr2, r0, ge
      cpsir  @rr4, @rr2, r0, gt
      cpsir  @rr4, @rr2, r0, ugt
      cpsir  @rr4, @rr2, r0, nov
      cpsir  @rr4, @rr2, r0, pl
      cpsir  @rr4, @rr2, r0, nz
      cpsir  @rr4, @rr2, r0, nc
      cpd    r1, @rr2, r0, f
      cpd    r1, @rr2, r0, lt
      cpd    r1, @rr2, r0, le
      cpd    r1, @rr2, r0, ule
      cpd    r1, @rr2, r0, ov
      cpd    r1, @rr2, r0, mi
      cpd    r1, @rr2, r0, z
      cpd    r1, @rr2, r0, c
      cpd    r1, @rr2, r0
      cpd    r1, @rr2, r0, ge
      cpd    r1, @rr2, r0, gt
      cpd    r1, @rr2, r0, ugt
      cpd    r1, @rr2, r0, nov
      cpd    r1, @rr2, r0, pl
      cpd    r1, @rr2, r0, nz
      cpd    r1, @rr2, r0, nc
      lddr   @rr4, @rr2, r0
      ldd    @rr4, @rr2, r0
      cpsd   @rr4, @rr2, r0, f
      cpsd   @rr4, @rr2, r0, lt
      cpsd   @rr4, @rr2, r0, le
      cpsd   @rr4, @rr2, r0, ule
      cpsd   @rr4, @rr2, r0, ov
      cpsd   @rr4, @rr2, r0, mi
      cpsd   @rr4, @rr2, r0, z
      cpsd   @rr4, @rr2, r0, c
      cpsd   @rr4, @rr2, r0
      cpsd   @rr4, @rr2, r0, ge
      cpsd   @rr4, @rr2, r0, gt
      cpsd   @rr4, @rr2, r0, ugt
      cpsd   @rr4, @rr2, r0, nov
      cpsd   @rr4, @rr2, r0, pl
      cpsd   @rr4, @rr2, r0, nz
      cpsd   @rr4, @rr2, r0, nc
      cpdr   r1, @rr2, r0, f
      cpdr   r1, @rr2, r0, lt
      cpdr   r1, @rr2, r0, le
      cpdr   r1, @rr2, r0, ule
      cpdr   r1, @rr2, r0, ov
      cpdr   r1, @rr2, r0, mi
      cpdr   r1, @rr2, r0, z
      cpdr   r1, @rr2, r0, c
      cpdr   r1, @rr2, r0
      cpdr   r1, @rr2, r0, ge
      cpdr   r1, @rr2, r0, gt
      cpdr   r1, @rr2, r0, ugt
      cpdr   r1, @rr2, r0, nov
      cpdr   r1, @rr2, r0, pl
      cpdr   r1, @rr2, r0, nz
      cpdr   r1, @rr2, r0, nc
      cpsdr  @rr4, @rr2, r0, f
      cpsdr  @rr4, @rr2, r0, lt
      cpsdr  @rr4, @rr2, r0, le
      cpsdr  @rr4, @rr2, r0, ule
      cpsdr  @rr4, @rr2, r0, ov
      cpsdr  @rr4, @rr2, r0, mi
      cpsdr  @rr4, @rr2, r0, z
      cpsdr  @rr4, @rr2, r0, c
      cpsdr  @rr4, @rr2, r0
      cpsdr  @rr4, @rr2, r0, ge
      cpsdr  @rr4, @rr2, r0, gt
      cpsdr  @rr4, @rr2, r0, ugt
      cpsdr  @rr4, @rr2, r0, nov
      cpsdr  @rr4, @rr2, r0, pl
      cpsdr  @rr4, @rr2, r0, nz
      cpsdr  @rr4, @rr2, r0, nc
      rrdb   rh0, rh0
      rrdb   rl0, rh0
      rrdb   rh0, rl0
      rrdb   rl0, rl0
      ldk    r0, #0
      rldb   rh0, rh0
      rldb   rl0, rh0
      rldb   rh0, rl0
      rldb   rl0, rl0
      ldb    rh0, #0
      ldb    rl0, #0
      calr   .+2
      calr   .
      calr   .-2
      jr     f, .+2
      jr     f, .-254
      jr     f, .
      jr     lt, .+2
      jr     lt, .-254
      jr     lt, .
      jr     le, .+2
      jr     le, .-254
      jr     le, .
      jr     ule, .+2
      jr     ule, .-254
      jr     ule, .
      jr     ov, .+2
      jr     ov, .-254
      jr     ov, .
      jr     mi, .+2
      jr     mi, .-254
      jr     mi, .
      jr     z, .+2
      jr     z, .-254
      jr     z, .
      jr     c, .+2
      jr     c, .-254
      jr     c, .
      jr     .+2
      jr     .-254
      jr     .
      jr     ge, .+2
      jr     ge, .-254
      jr     ge, .
      jr     gt, .+2
      jr     gt, .-254
      jr     gt, .
      jr     ugt, .+2
      jr     ugt, .-254
      jr     ugt, .
      jr     nov, .+2
      jr     nov, .-254
      jr     nov, .
      jr     pl, .+2
      jr     pl, .-254
      jr     pl, .
      jr     nz, .+2
      jr     nz, .-254
      jr     nz, .
      jr     nc, .+2
      jr     nc, .-254
      jr     nc, .
      dbjnz  rh0, .+2
      dbjnz  rh0, .
      dbjnz  rh0, .-2
      djnz   r0, .+2
      djnz   r0, .
      djnz   r0, .-2
      dbjnz  rl0, .+2
      dbjnz  rl0, .
      dbjnz  rl0, .-2
