;;; AUTO GENERATED FILE
;;; generated by: gen_tlcs900 -C TLCS900 -o gen_tlcs900.inc -l /tmp/g_base.lst
      cpu    tlcs900
      org    0100H
      nop
      normal
      push   sr
      pop    sr
      max
      halt
      ei     7
      reti
      ld     (9), 10
      push   10
      ldw    (11), 0D0CH
      pushw  0D0CH
      incf
      decf
      ret
      retd   1110H
      rcf
      scf
      ccf
      zcf
      push   a
      pop    a
      ex     f, f'
      ldf    0
      push   f
      pop    f
      jp     (1C1BH)
      jp     (1E1D1CH)
      call   (1E1DH)
      call   (201F1EH)
      calr   $+2022H
      ld     w, 21H
      ld     a, 22H
      ld     b, 23H
      ld     c, 24H
      ld     d, 25H
      ld     e, 26H
      ld     h, 27H
      ld     l, 28H
      push   wa
      push   bc
      push   de
      push   hl
      push   ix
      push   iy
      push   iz
      push   sp
      ld     wa, 3231H
      ld     bc, 3332H
      ld     de, 3433H
      ld     hl, 3534H
      ld     ix, 3635H
      ld     iy, 3736H
      ld     iz, 3837H
      ld     sp, 3938H
      push   xix
      push   xiy
      push   xiz
      push   xsp
      ld     xix, 48474645H
      ld     xiy, 49484746H
      ld     xiz, 4A494847H
      ld     xsp, 4B4A4948H
      pop    wa
      pop    bc
      pop    de
      pop    hl
      pop    ix
      pop    iy
      pop    iz
      pop    sp
      pop    xix
      pop    xiy
      pop    xiz
      pop    xsp
      jr     f, $+99
      jr     lt, $+100
      jr     le, $+101
      jr     ule, $+102
      jr     ov, $+103
      jr     mi, $+104
      jr     z, $+105
      jr     c, $+106
      jr     t, $+107
      jr     ge, $+108
      jr     gt, $+109
      jr     ugt, $+110
      jr     nov, $+111
      jr     pl, $+112
      jr     nz, $+113
      jr     nc, $+114
      jrl    f, $+7274H
      jrl    lt, $+7375H
      jrl    le, $+7476H
      jrl    ule, $+7577H
      jrl    ov, $+7678H
      jrl    mi, $+7779H
      jrl    z, $+787AH
      jrl    c, $+797BH
      jrl    t, $+7A7CH
      jrl    ge, $+7B7DH
      jrl    gt, $+7C7EH
      jrl    ugt, $+7D7FH
      jrl    nov, $+7E80H
      jrl    pl, $+7F81H
      jrl    nz, $-017EH
      jrl    nc, $-017DH
      ldi
      ldir
      ldd
      lddr
      cpi
      cpir
      cpd
      cpdr
      add    e, (xix)
      add    h, (xix)
      add    l, (xix)
      adc    w, (xix)
      adc    a, (xix)
      adc    b, (xix)
      adc    c, (xix)
      adc    d, (xix)
      adc    e, (xix)
      adc    h, (xix)
      adc    l, (xix)
      sub    w, (xix)
      sub    a, (xix)
      sub    b, (xix)
      sub    c, (xix)
      sub    d, (xix)
      sub    e, (xix)
      sub    h, (xix)
      sub    l, (xix)
      sbc    w, (xix)
      sbc    a, (xix)
      sbc    b, (xix)
      sbc    c, (xix)
      sbc    d, (xix)
      sbc    e, (xix)
      sbc    h, (xix)
      sbc    l, (xix)
      and    w, (xix)
      and    a, (xix)
      and    b, (xix)
      and    c, (xix)
      and    d, (xix)
      and    e, (xix)
      and    h, (xix)
      and    l, (xix)
      xor    w, (xix)
      xor    a, (xix)
      xor    b, (xix)
      xor    c, (xix)
      xor    d, (xix)
      xor    e, (xix)
      xor    h, (xix)
      xor    l, (xix)
      or     w, (xix)
      or     a, (xix)
      or     b, (xix)
      or     c, (xix)
      or     d, (xix)
      or     e, (xix)
      or     h, (xix)
      or     l, (xix)
      rlc    0E9H, (xix)
      rrc    0EAH, (xix)
      rl     0EBH, (xix)
      rr     0ECH, (xix)
      sla    0EDH, (xix)
      sra    0EEH, (xix)
      sll    0EFH, (xix)
      srl    0F0H, (xix)
      cp     w, (xix)
      cp     a, (xix)
      cp     b, (xix)
      cp     c, (xix)
      cp     d, (xix)
      cp     e, (xix)
      cp     h, (xix)
      cp     l, (xix)
      push   (xix)
      rld    a, (xix)
      rrd    a, (xix)
      ld     (1B1AH), (xix)
      ld     w, (xix)
      ld     a, (xix)
      ld     b, (xix)
      ld     c, (xix)
      ld     d, (xix)
      ld     e, (xix)
      ld     h, (xix)
      ld     l, (xix)
      ex     w, (xix)
      ex     a, (xix)
      ex     b, (xix)
      ex     c, (xix)
      ex     d, (xix)
      ex     e, (xix)
      ex     h, (xix)
      ex     l, (xix)
      cp     (xix), 40H
      mul    wa, (xix)
      mul    bc, (xix)
      mul    de, (xix)
      mul    hl, (xix)
      muls   wa, (xix)
      muls   bc, (xix)
      muls   de, (xix)
      muls   hl, (xix)
      div    wa, (xix)
      div    bc, (xix)
      div    de, (xix)
      div    hl, (xix)
      divs   wa, (xix)
      divs   bc, (xix)
      divs   de, (xix)
      divs   hl, (xix)
      inc    1, (xix)
      dec    1, (xix)
      add    w, (xix)
      add    a, (xix)
      add    b, (xix)
      add    c, (xix)
      add    d, (xix)
      add    h, (xiy)
      add    l, (xiy)
      adc    w, (xiy)
      adc    a, (xiy)
      adc    b, (xiy)
      adc    c, (xiy)
      adc    d, (xiy)
      adc    e, (xiy)
      adc    h, (xiy)
      adc    l, (xiy)
      sub    w, (xiy)
      sub    a, (xiy)
      sub    b, (xiy)
      sub    c, (xiy)
      sub    d, (xiy)
      sub    e, (xiy)
      sub    h, (xiy)
      sub    l, (xiy)
      sbc    w, (xiy)
      sbc    a, (xiy)
      sbc    b, (xiy)
      sbc    c, (xiy)
      sbc    d, (xiy)
      sbc    e, (xiy)
      sbc    h, (xiy)
      sbc    l, (xiy)
      and    w, (xiy)
      and    a, (xiy)
      and    b, (xiy)
      and    c, (xiy)
      and    d, (xiy)
      and    e, (xiy)
      and    h, (xiy)
      and    l, (xiy)
      xor    w, (xiy)
      xor    a, (xiy)
      xor    b, (xiy)
      xor    c, (xiy)
      xor    d, (xiy)
      xor    e, (xiy)
      xor    h, (xiy)
      xor    l, (xiy)
      or     w, (xiy)
      or     a, (xiy)
      or     b, (xiy)
      or     c, (xiy)
      or     d, (xiy)
      or     e, (xiy)
      or     h, (xiy)
      or     l, (xiy)
      rlc    0E9H, (xiy)
      rrc    0EAH, (xiy)
      rl     0EBH, (xiy)
      rr     0ECH, (xiy)
      sla    0EDH, (xiy)
      sra    0EEH, (xiy)
      sll    0EFH, (xiy)
      srl    0F0H, (xiy)
      cp     w, (xiy)
      cp     a, (xiy)
      cp     b, (xiy)
      cp     c, (xiy)
      cp     d, (xiy)
      cp     e, (xiy)
      cp     h, (xiy)
      cp     l, (xiy)
      push   (xiy)
      rld    a, (xiy)
      rrd    a, (xiy)
      ld     (1B1AH), (xiy)
      ld     w, (xiy)
      ld     a, (xiy)
      ld     b, (xiy)
      ld     c, (xiy)
      ld     d, (xiy)
      ld     e, (xiy)
      ld     h, (xiy)
      ld     l, (xiy)
      ex     w, (xiy)
      ex     a, (xiy)
      ex     b, (xiy)
      ex     c, (xiy)
      ex     d, (xiy)
      ex     e, (xiy)
      ex     h, (xiy)
      ex     l, (xiy)
      cp     (xiy), 40H
      mul    wa, (xiy)
      mul    bc, (xiy)
      mul    de, (xiy)
      mul    hl, (xiy)
      muls   wa, (xiy)
      muls   bc, (xiy)
      muls   de, (xiy)
      muls   hl, (xiy)
      div    wa, (xiy)
      div    bc, (xiy)
      div    de, (xiy)
      div    hl, (xiy)
      divs   wa, (xiy)
      divs   bc, (xiy)
      divs   de, (xiy)
      divs   hl, (xiy)
      inc    1, (xiy)
      dec    1, (xiy)
      add    w, (xiy)
      add    a, (xiy)
      add    b, (xiy)
      add    c, (xiy)
      add    d, (xiy)
      add    e, (xiy)
      add    l, (xiz)
      adc    w, (xiz)
      adc    a, (xiz)
      adc    b, (xiz)
      adc    c, (xiz)
      adc    d, (xiz)
      adc    e, (xiz)
      adc    h, (xiz)
      adc    l, (xiz)
      sub    w, (xiz)
      sub    a, (xiz)
      sub    b, (xiz)
      sub    c, (xiz)
      sub    d, (xiz)
      sub    e, (xiz)
      sub    h, (xiz)
      sub    l, (xiz)
      sbc    w, (xiz)
      sbc    a, (xiz)
      sbc    b, (xiz)
      sbc    c, (xiz)
      sbc    d, (xiz)
      sbc    e, (xiz)
      sbc    h, (xiz)
      sbc    l, (xiz)
      and    w, (xiz)
      and    a, (xiz)
      and    b, (xiz)
      and    c, (xiz)
      and    d, (xiz)
      and    e, (xiz)
      and    h, (xiz)
      and    l, (xiz)
      xor    w, (xiz)
      xor    a, (xiz)
      xor    b, (xiz)
      xor    c, (xiz)
      xor    d, (xiz)
      xor    e, (xiz)
      xor    h, (xiz)
      xor    l, (xiz)
      or     w, (xiz)
      or     a, (xiz)
      or     b, (xiz)
      or     c, (xiz)
      or     d, (xiz)
      or     e, (xiz)
      or     h, (xiz)
      or     l, (xiz)
      rlc    0E9H, (xiz)
      rrc    0EAH, (xiz)
      rl     0EBH, (xiz)
      rr     0ECH, (xiz)
      sla    0EDH, (xiz)
      sra    0EEH, (xiz)
      sll    0EFH, (xiz)
      srl    0F0H, (xiz)
      cp     w, (xiz)
      cp     a, (xiz)
      cp     b, (xiz)
      cp     c, (xiz)
      cp     d, (xiz)
      cp     e, (xiz)
      cp     h, (xiz)
      cp     l, (xiz)
      push   (xiz)
      rld    a, (xiz)
      rrd    a, (xiz)
      ld     (1B1AH), (xiz)
      ld     w, (xiz)
      ld     a, (xiz)
      ld     b, (xiz)
      ld     c, (xiz)
      ld     d, (xiz)
      ld     e, (xiz)
      ld     h, (xiz)
      ld     l, (xiz)
      ex     w, (xiz)
      ex     a, (xiz)
      ex     b, (xiz)
      ex     c, (xiz)
      ex     d, (xiz)
      ex     e, (xiz)
      ex     h, (xiz)
      ex     l, (xiz)
      cp     (xiz), 40H
      mul    wa, (xiz)
      mul    bc, (xiz)
      mul    de, (xiz)
      mul    hl, (xiz)
      muls   wa, (xiz)
      muls   bc, (xiz)
      muls   de, (xiz)
      muls   hl, (xiz)
      div    wa, (xiz)
      div    bc, (xiz)
      div    de, (xiz)
      div    hl, (xiz)
      divs   wa, (xiz)
      divs   bc, (xiz)
      divs   de, (xiz)
      divs   hl, (xiz)
      inc    1, (xiz)
      dec    1, (xiz)
      add    w, (xiz)
      add    a, (xiz)
      add    b, (xiz)
      add    c, (xiz)
      add    d, (xiz)
      add    e, (xiz)
      add    h, (xiz)
      adc    w, (xsp)
      adc    a, (xsp)
      adc    b, (xsp)
      adc    c, (xsp)
      adc    d, (xsp)
      adc    e, (xsp)
      adc    h, (xsp)
      adc    l, (xsp)
      sub    w, (xsp)
      sub    a, (xsp)
      sub    b, (xsp)
      sub    c, (xsp)
      sub    d, (xsp)
      sub    e, (xsp)
      sub    h, (xsp)
      sub    l, (xsp)
      sbc    w, (xsp)
      sbc    a, (xsp)
      sbc    b, (xsp)
      sbc    c, (xsp)
      sbc    d, (xsp)
      sbc    e, (xsp)
      sbc    h, (xsp)
      sbc    l, (xsp)
      and    w, (xsp)
      and    a, (xsp)
      and    b, (xsp)
      and    c, (xsp)
      and    d, (xsp)
      and    e, (xsp)
      and    h, (xsp)
      and    l, (xsp)
      xor    w, (xsp)
      xor    a, (xsp)
      xor    b, (xsp)
      xor    c, (xsp)
      xor    d, (xsp)
      xor    e, (xsp)
      xor    h, (xsp)
      xor    l, (xsp)
      or     w, (xsp)
      or     a, (xsp)
      or     b, (xsp)
      or     c, (xsp)
      or     d, (xsp)
      or     e, (xsp)
      or     h, (xsp)
      or     l, (xsp)
      rlc    0E9H, (xsp)
      rrc    0EAH, (xsp)
      rl     0EBH, (xsp)
      rr     0ECH, (xsp)
      sla    0EDH, (xsp)
      sra    0EEH, (xsp)
      sll    0EFH, (xsp)
      srl    0F0H, (xsp)
      cp     w, (xsp)
      cp     a, (xsp)
      cp     b, (xsp)
      cp     c, (xsp)
      cp     d, (xsp)
      cp     e, (xsp)
      cp     h, (xsp)
      cp     l, (xsp)
      push   (xsp)
      rld    a, (xsp)
      rrd    a, (xsp)
      ld     (1B1AH), (xsp)
      ld     w, (xsp)
      ld     a, (xsp)
      ld     b, (xsp)
      ld     c, (xsp)
      ld     d, (xsp)
      ld     e, (xsp)
      ld     h, (xsp)
      ld     l, (xsp)
      ex     w, (xsp)
      ex     a, (xsp)
      ex     b, (xsp)
      ex     c, (xsp)
      ex     d, (xsp)
      ex     e, (xsp)
      ex     h, (xsp)
      ex     l, (xsp)
      cp     (xsp), 40H
      mul    wa, (xsp)
      mul    bc, (xsp)
      mul    de, (xsp)
      mul    hl, (xsp)
      muls   wa, (xsp)
      muls   bc, (xsp)
      muls   de, (xsp)
      muls   hl, (xsp)
      div    wa, (xsp)
      div    bc, (xsp)
      div    de, (xsp)
      div    hl, (xsp)
      divs   wa, (xsp)
      divs   bc, (xsp)
      divs   de, (xsp)
      divs   hl, (xsp)
      inc    1, (xsp)
      dec    1, (xsp)
      add    w, (xsp)
      add    a, (xsp)
      add    b, (xsp)
      add    c, (xsp)
      add    d, (xsp)
      add    e, (xsp)
      add    h, (xsp)
      add    l, (xsp)
      adc    w, (xix-73H)
      adc    a, (xix-73H)
      adc    b, (xix-73H)
      adc    c, (xix-73H)
      adc    d, (xix-73H)
      adc    e, (xix-73H)
      adc    h, (xix-73H)
      adc    l, (xix-73H)
      sub    w, (xix-73H)
      sub    a, (xix-73H)
      sub    b, (xix-73H)
      sub    c, (xix-73H)
      sub    d, (xix-73H)
      sub    e, (xix-73H)
      sub    h, (xix-73H)
      sub    l, (xix-73H)
      sbc    w, (xix-73H)
      sbc    a, (xix-73H)
      sbc    b, (xix-73H)
      sbc    c, (xix-73H)
      sbc    d, (xix-73H)
      sbc    e, (xix-73H)
      sbc    h, (xix-73H)
      sbc    l, (xix-73H)
      and    w, (xix-73H)
      and    a, (xix-73H)
      and    b, (xix-73H)
      and    c, (xix-73H)
      and    d, (xix-73H)
      and    e, (xix-73H)
      and    h, (xix-73H)
      and    l, (xix-73H)
      xor    w, (xix-73H)
      xor    a, (xix-73H)
      xor    b, (xix-73H)
      xor    c, (xix-73H)
      xor    d, (xix-73H)
      xor    e, (xix-73H)
      xor    h, (xix-73H)
      xor    l, (xix-73H)
      or     w, (xix-73H)
      or     a, (xix-73H)
      or     b, (xix-73H)
      or     c, (xix-73H)
      or     d, (xix-73H)
      or     e, (xix-73H)
      or     h, (xix-73H)
      or     l, (xix-73H)
      rlc    0E9H, (xix-73H)
      rrc    0EAH, (xix-73H)
      rl     0EBH, (xix-73H)
      rr     0ECH, (xix-73H)
      sla    0EDH, (xix-73H)
      sra    0EEH, (xix-73H)
      sll    0EFH, (xix-73H)
      srl    0F0H, (xix-73H)
      cp     w, (xix-73H)
      cp     a, (xix-73H)
      cp     b, (xix-73H)
      cp     c, (xix-73H)
      cp     d, (xix-73H)
      cp     e, (xix-73H)
      cp     h, (xix-73H)
      cp     l, (xix-73H)
      push   (xix-73H)
      rld    a, (xix-73H)
      rrd    a, (xix-73H)
      ld     (1B1AH), (xix-73H)
      ld     w, (xix-73H)
      ld     a, (xix-73H)
      ld     b, (xix-73H)
      ld     c, (xix-73H)
      ld     d, (xix-73H)
      ld     e, (xix-73H)
      ld     h, (xix-73H)
      ld     l, (xix-73H)
      ex     w, (xix-73H)
      ex     a, (xix-73H)
      ex     b, (xix-73H)
      ex     c, (xix-73H)
      ex     d, (xix-73H)
      ex     e, (xix-73H)
      ex     h, (xix-73H)
      ex     l, (xix-73H)
      cp     (xix-73H), 40H
      mul    wa, (xix-73H)
      mul    bc, (xix-73H)
      mul    de, (xix-73H)
      mul    hl, (xix-73H)
      muls   wa, (xix-73H)
      muls   bc, (xix-73H)
      muls   de, (xix-73H)
      muls   hl, (xix-73H)
      div    wa, (xix-73H)
      div    bc, (xix-73H)
      div    de, (xix-73H)
      div    hl, (xix-73H)
      divs   wa, (xix-73H)
      divs   bc, (xix-73H)
      divs   de, (xix-73H)
      divs   hl, (xix-73H)
      inc    1, (xix-73H)
      dec    1, (xix-73H)
      add    w, (xix-73H)
      add    a, (xix-73H)
      add    b, (xix-73H)
      add    c, (xix-73H)
      add    d, (xix-73H)
      add    e, (xix-73H)
      add    h, (xix-73H)
      add    l, (xix-73H)
      push   (xix+0)
      rld    a, (xix+0)
      rrd    a, (xix+0)
      ld     (1B1AH), (xix+0)
      ld     w, (xix+0)
      ld     a, (xix+0)
      ld     b, (xix+0)
      ld     c, (xix+0)
      ld     d, (xix+0)
      ld     e, (xix+0)
      ld     h, (xix+0)
      ld     l, (xix+0)
      ex     w, (xix+0)
      ex     a, (xix+0)
      ex     b, (xix+0)
      ex     c, (xix+0)
      ex     d, (xix+0)
      ex     e, (xix+0)
      ex     h, (xix+0)
      ex     l, (xix+0)
      cp     (xix+0), 40H
      mul    wa, (xix+0)
      mul    bc, (xix+0)
      mul    de, (xix+0)
      mul    hl, (xix+0)
      muls   wa, (xix+0)
      muls   bc, (xix+0)
      muls   de, (xix+0)
      muls   hl, (xix+0)
      div    wa, (xix+0)
      div    bc, (xix+0)
      div    de, (xix+0)
      div    hl, (xix+0)
      divs   wa, (xix+0)
      divs   bc, (xix+0)
      divs   de, (xix+0)
      divs   hl, (xix+0)
      inc    1, (xix+0)
      dec    1, (xix+0)
      add    w, (xix+0)
      add    a, (xix+0)
      add    b, (xix+0)
      add    c, (xix+0)
      add    d, (xix+0)
      add    e, (xix+0)
      add    h, (xix+0)
      add    l, (xix+0)
      adc    w, (xix+0)
      adc    a, (xix+0)
      adc    b, (xix+0)
      adc    c, (xix+0)
      adc    d, (xix+0)
      adc    e, (xix+0)
      adc    h, (xix+0)
      adc    l, (xix+0)
      sub    w, (xix+0)
      sub    a, (xix+0)
      sub    b, (xix+0)
      sub    c, (xix+0)
      sub    d, (xix+0)
      sub    e, (xix+0)
      sub    h, (xix+0)
      sub    l, (xix+0)
      sbc    w, (xix+0)
      sbc    a, (xix+0)
      sbc    b, (xix+0)
      sbc    c, (xix+0)
      sbc    d, (xix+0)
      sbc    e, (xix+0)
      sbc    h, (xix+0)
      sbc    l, (xix+0)
      and    w, (xix+0)
      and    a, (xix+0)
      and    b, (xix+0)
      and    c, (xix+0)
      and    d, (xix+0)
      and    e, (xix+0)
      and    h, (xix+0)
      and    l, (xix+0)
      xor    w, (xix+0)
      xor    a, (xix+0)
      xor    b, (xix+0)
      xor    c, (xix+0)
      xor    d, (xix+0)
      xor    e, (xix+0)
      xor    h, (xix+0)
      xor    l, (xix+0)
      or     w, (xix+0)
      or     a, (xix+0)
      or     b, (xix+0)
      or     c, (xix+0)
      or     d, (xix+0)
      or     e, (xix+0)
      or     h, (xix+0)
      or     l, (xix+0)
      rlc    0E9H, (xix+0)
      rrc    0EAH, (xix+0)
      rl     0EBH, (xix+0)
      rr     0ECH, (xix+0)
      sla    0EDH, (xix+0)
      sra    0EEH, (xix+0)
      sll    0EFH, (xix+0)
      srl    0F0H, (xix+0)
      cp     w, (xix+0)
      cp     a, (xix+0)
      cp     b, (xix+0)
      cp     c, (xix+0)
      cp     d, (xix+0)
      cp     e, (xix+0)
      cp     h, (xix+0)
      cp     l, (xix+0)
      adc    w, (xiy-72H)
      adc    a, (xiy-72H)
      adc    b, (xiy-72H)
      adc    c, (xiy-72H)
      adc    d, (xiy-72H)
      adc    e, (xiy-72H)
      adc    h, (xiy-72H)
      adc    l, (xiy-72H)
      sub    w, (xiy-72H)
      sub    a, (xiy-72H)
      sub    b, (xiy-72H)
      sub    c, (xiy-72H)
      sub    d, (xiy-72H)
      sub    e, (xiy-72H)
      sub    h, (xiy-72H)
      sub    l, (xiy-72H)
      sbc    w, (xiy-72H)
      sbc    a, (xiy-72H)
      sbc    b, (xiy-72H)
      sbc    c, (xiy-72H)
      sbc    d, (xiy-72H)
      sbc    e, (xiy-72H)
      sbc    h, (xiy-72H)
      sbc    l, (xiy-72H)
      and    w, (xiy-72H)
      and    a, (xiy-72H)
      and    b, (xiy-72H)
      and    c, (xiy-72H)
      and    d, (xiy-72H)
      and    e, (xiy-72H)
      and    h, (xiy-72H)
      and    l, (xiy-72H)
      xor    w, (xiy-72H)
      xor    a, (xiy-72H)
      xor    b, (xiy-72H)
      xor    c, (xiy-72H)
      xor    d, (xiy-72H)
      xor    e, (xiy-72H)
      xor    h, (xiy-72H)
      xor    l, (xiy-72H)
      or     w, (xiy-72H)
      or     a, (xiy-72H)
      or     b, (xiy-72H)
      or     c, (xiy-72H)
      or     d, (xiy-72H)
      or     e, (xiy-72H)
      or     h, (xiy-72H)
      or     l, (xiy-72H)
      rlc    0E9H, (xiy-72H)
      rrc    0EAH, (xiy-72H)
      rl     0EBH, (xiy-72H)
      rr     0ECH, (xiy-72H)
      sla    0EDH, (xiy-72H)
      sra    0EEH, (xiy-72H)
      sll    0EFH, (xiy-72H)
      srl    0F0H, (xiy-72H)
      cp     w, (xiy-72H)
      cp     a, (xiy-72H)
      cp     b, (xiy-72H)
      cp     c, (xiy-72H)
      cp     d, (xiy-72H)
      cp     e, (xiy-72H)
      cp     h, (xiy-72H)
      cp     l, (xiy-72H)
      push   (xiy-72H)
      rld    a, (xiy-72H)
      rrd    a, (xiy-72H)
      ld     (1B1AH), (xiy-72H)
      ld     w, (xiy-72H)
      ld     a, (xiy-72H)
      ld     b, (xiy-72H)
      ld     c, (xiy-72H)
      ld     d, (xiy-72H)
      ld     e, (xiy-72H)
      ld     h, (xiy-72H)
      ld     l, (xiy-72H)
      ex     w, (xiy-72H)
      ex     a, (xiy-72H)
      ex     b, (xiy-72H)
      ex     c, (xiy-72H)
      ex     d, (xiy-72H)
      ex     e, (xiy-72H)
      ex     h, (xiy-72H)
      ex     l, (xiy-72H)
      cp     (xiy-72H), 40H
      mul    wa, (xiy-72H)
      mul    bc, (xiy-72H)
      mul    de, (xiy-72H)
      mul    hl, (xiy-72H)
      muls   wa, (xiy-72H)
      muls   bc, (xiy-72H)
      muls   de, (xiy-72H)
      muls   hl, (xiy-72H)
      div    wa, (xiy-72H)
      div    bc, (xiy-72H)
      div    de, (xiy-72H)
      div    hl, (xiy-72H)
      divs   wa, (xiy-72H)
      divs   bc, (xiy-72H)
      divs   de, (xiy-72H)
      divs   hl, (xiy-72H)
      inc    1, (xiy-72H)
      dec    1, (xiy-72H)
      add    w, (xiy-72H)
      add    a, (xiy-72H)
      add    b, (xiy-72H)
      add    c, (xiy-72H)
      add    d, (xiy-72H)
      add    e, (xiy-72H)
      add    h, (xiy-72H)
      add    l, (xiy-72H)
      push   (xiy+0)
      rld    a, (xiy+0)
      rrd    a, (xiy+0)
      ld     (1B1AH), (xiy+0)
      ld     w, (xiy+0)
      ld     a, (xiy+0)
      ld     b, (xiy+0)
      ld     c, (xiy+0)
      ld     d, (xiy+0)
      ld     e, (xiy+0)
      ld     h, (xiy+0)
      ld     l, (xiy+0)
      ex     w, (xiy+0)
      ex     a, (xiy+0)
      ex     b, (xiy+0)
      ex     c, (xiy+0)
      ex     d, (xiy+0)
      ex     e, (xiy+0)
      ex     h, (xiy+0)
      ex     l, (xiy+0)
      cp     (xiy+0), 40H
      mul    wa, (xiy+0)
      mul    bc, (xiy+0)
      mul    de, (xiy+0)
      mul    hl, (xiy+0)
      muls   wa, (xiy+0)
      muls   bc, (xiy+0)
      muls   de, (xiy+0)
      muls   hl, (xiy+0)
      div    wa, (xiy+0)
      div    bc, (xiy+0)
      div    de, (xiy+0)
      div    hl, (xiy+0)
      divs   wa, (xiy+0)
      divs   bc, (xiy+0)
      divs   de, (xiy+0)
      divs   hl, (xiy+0)
      inc    1, (xiy+0)
      dec    1, (xiy+0)
      add    w, (xiy+0)
      add    a, (xiy+0)
      add    b, (xiy+0)
      add    c, (xiy+0)
      add    d, (xiy+0)
      add    e, (xiy+0)
      add    h, (xiy+0)
      add    l, (xiy+0)
      adc    w, (xiy+0)
      adc    a, (xiy+0)
      adc    b, (xiy+0)
      adc    c, (xiy+0)
      adc    d, (xiy+0)
      adc    e, (xiy+0)
      adc    h, (xiy+0)
      adc    l, (xiy+0)
      sub    w, (xiy+0)
      sub    a, (xiy+0)
      sub    b, (xiy+0)
      sub    c, (xiy+0)
      sub    d, (xiy+0)
      sub    e, (xiy+0)
      sub    h, (xiy+0)
      sub    l, (xiy+0)
      sbc    w, (xiy+0)
      sbc    a, (xiy+0)
      sbc    b, (xiy+0)
      sbc    c, (xiy+0)
      sbc    d, (xiy+0)
      sbc    e, (xiy+0)
      sbc    h, (xiy+0)
      sbc    l, (xiy+0)
      and    w, (xiy+0)
      and    a, (xiy+0)
      and    b, (xiy+0)
      and    c, (xiy+0)
      and    d, (xiy+0)
      and    e, (xiy+0)
      and    h, (xiy+0)
      and    l, (xiy+0)
      xor    w, (xiy+0)
      xor    a, (xiy+0)
      xor    b, (xiy+0)
      xor    c, (xiy+0)
      xor    d, (xiy+0)
      xor    e, (xiy+0)
      xor    h, (xiy+0)
      xor    l, (xiy+0)
      or     w, (xiy+0)
      or     a, (xiy+0)
      or     b, (xiy+0)
      or     c, (xiy+0)
      or     d, (xiy+0)
      or     e, (xiy+0)
      or     h, (xiy+0)
      or     l, (xiy+0)
      rlc    0E9H, (xiy+0)
      rrc    0EAH, (xiy+0)
      rl     0EBH, (xiy+0)
      rr     0ECH, (xiy+0)
      sla    0EDH, (xiy+0)
      sra    0EEH, (xiy+0)
      sll    0EFH, (xiy+0)
      srl    0F0H, (xiy+0)
      cp     w, (xiy+0)
      cp     a, (xiy+0)
      cp     b, (xiy+0)
      cp     c, (xiy+0)
      cp     d, (xiy+0)
      cp     e, (xiy+0)
      cp     h, (xiy+0)
      cp     l, (xiy+0)
      adc    w, (xiz-71H)
      adc    a, (xiz-71H)
      adc    b, (xiz-71H)
      adc    c, (xiz-71H)
      adc    d, (xiz-71H)
      adc    e, (xiz-71H)
      adc    h, (xiz-71H)
      adc    l, (xiz-71H)
      sub    w, (xiz-71H)
      sub    a, (xiz-71H)
      sub    b, (xiz-71H)
      sub    c, (xiz-71H)
      sub    d, (xiz-71H)
      sub    e, (xiz-71H)
      sub    h, (xiz-71H)
      sub    l, (xiz-71H)
      sbc    w, (xiz-71H)
      sbc    a, (xiz-71H)
      sbc    b, (xiz-71H)
      sbc    c, (xiz-71H)
      sbc    d, (xiz-71H)
      sbc    e, (xiz-71H)
      sbc    h, (xiz-71H)
      sbc    l, (xiz-71H)
      and    w, (xiz-71H)
      and    a, (xiz-71H)
      and    b, (xiz-71H)
      and    c, (xiz-71H)
      and    d, (xiz-71H)
      and    e, (xiz-71H)
      and    h, (xiz-71H)
      and    l, (xiz-71H)
      xor    w, (xiz-71H)
      xor    a, (xiz-71H)
      xor    b, (xiz-71H)
      xor    c, (xiz-71H)
      xor    d, (xiz-71H)
      xor    e, (xiz-71H)
      xor    h, (xiz-71H)
      xor    l, (xiz-71H)
      or     w, (xiz-71H)
      or     a, (xiz-71H)
      or     b, (xiz-71H)
      or     c, (xiz-71H)
      or     d, (xiz-71H)
      or     e, (xiz-71H)
      or     h, (xiz-71H)
      or     l, (xiz-71H)
      rlc    0E9H, (xiz-71H)
      rrc    0EAH, (xiz-71H)
      rl     0EBH, (xiz-71H)
      rr     0ECH, (xiz-71H)
      sla    0EDH, (xiz-71H)
      sra    0EEH, (xiz-71H)
      sll    0EFH, (xiz-71H)
      srl    0F0H, (xiz-71H)
      cp     w, (xiz-71H)
      cp     a, (xiz-71H)
      cp     b, (xiz-71H)
      cp     c, (xiz-71H)
      cp     d, (xiz-71H)
      cp     e, (xiz-71H)
      cp     h, (xiz-71H)
      cp     l, (xiz-71H)
      push   (xiz-71H)
      rld    a, (xiz-71H)
      rrd    a, (xiz-71H)
      ld     (1B1AH), (xiz-71H)
      ld     w, (xiz-71H)
      ld     a, (xiz-71H)
      ld     b, (xiz-71H)
      ld     c, (xiz-71H)
      ld     d, (xiz-71H)
      ld     e, (xiz-71H)
      ld     h, (xiz-71H)
      ld     l, (xiz-71H)
      ex     w, (xiz-71H)
      ex     a, (xiz-71H)
      ex     b, (xiz-71H)
      ex     c, (xiz-71H)
      ex     d, (xiz-71H)
      ex     e, (xiz-71H)
      ex     h, (xiz-71H)
      ex     l, (xiz-71H)
      cp     (xiz-71H), 40H
      mul    wa, (xiz-71H)
      mul    bc, (xiz-71H)
      mul    de, (xiz-71H)
      mul    hl, (xiz-71H)
      muls   wa, (xiz-71H)
      muls   bc, (xiz-71H)
      muls   de, (xiz-71H)
      muls   hl, (xiz-71H)
      div    wa, (xiz-71H)
      div    bc, (xiz-71H)
      div    de, (xiz-71H)
      div    hl, (xiz-71H)
      divs   wa, (xiz-71H)
      divs   bc, (xiz-71H)
      divs   de, (xiz-71H)
      divs   hl, (xiz-71H)
      inc    1, (xiz-71H)
      dec    1, (xiz-71H)
      add    w, (xiz-71H)
      add    a, (xiz-71H)
      add    b, (xiz-71H)
      add    c, (xiz-71H)
      add    d, (xiz-71H)
      add    e, (xiz-71H)
      add    h, (xiz-71H)
      add    l, (xiz-71H)
      push   (xiz+0)
      rld    a, (xiz+0)
      rrd    a, (xiz+0)
      ld     (1B1AH), (xiz+0)
      ld     w, (xiz+0)
      ld     a, (xiz+0)
      ld     b, (xiz+0)
      ld     c, (xiz+0)
      ld     d, (xiz+0)
      ld     e, (xiz+0)
      ld     h, (xiz+0)
      ld     l, (xiz+0)
      ex     w, (xiz+0)
      ex     a, (xiz+0)
      ex     b, (xiz+0)
      ex     c, (xiz+0)
      ex     d, (xiz+0)
      ex     e, (xiz+0)
      ex     h, (xiz+0)
      ex     l, (xiz+0)
      cp     (xiz+0), 40H
      mul    wa, (xiz+0)
      mul    bc, (xiz+0)
      mul    de, (xiz+0)
      mul    hl, (xiz+0)
      muls   wa, (xiz+0)
      muls   bc, (xiz+0)
      muls   de, (xiz+0)
      muls   hl, (xiz+0)
      div    wa, (xiz+0)
      div    bc, (xiz+0)
      div    de, (xiz+0)
      div    hl, (xiz+0)
      divs   wa, (xiz+0)
      divs   bc, (xiz+0)
      divs   de, (xiz+0)
      divs   hl, (xiz+0)
      inc    1, (xiz+0)
      dec    1, (xiz+0)
      add    w, (xiz+0)
      add    a, (xiz+0)
      add    b, (xiz+0)
      add    c, (xiz+0)
      add    d, (xiz+0)
      add    e, (xiz+0)
      add    h, (xiz+0)
      add    l, (xiz+0)
      adc    w, (xiz+0)
      adc    a, (xiz+0)
      adc    b, (xiz+0)
      adc    c, (xiz+0)
      adc    d, (xiz+0)
      adc    e, (xiz+0)
      adc    h, (xiz+0)
      adc    l, (xiz+0)
      sub    w, (xiz+0)
      sub    a, (xiz+0)
      sub    b, (xiz+0)
      sub    c, (xiz+0)
      sub    d, (xiz+0)
      sub    e, (xiz+0)
      sub    h, (xiz+0)
      sub    l, (xiz+0)
      sbc    w, (xiz+0)
      sbc    a, (xiz+0)
      sbc    b, (xiz+0)
      sbc    c, (xiz+0)
      sbc    d, (xiz+0)
      sbc    e, (xiz+0)
      sbc    h, (xiz+0)
      sbc    l, (xiz+0)
      and    w, (xiz+0)
      and    a, (xiz+0)
      and    b, (xiz+0)
      and    c, (xiz+0)
      and    d, (xiz+0)
      and    e, (xiz+0)
      and    h, (xiz+0)
      and    l, (xiz+0)
      xor    w, (xiz+0)
      xor    a, (xiz+0)
      xor    b, (xiz+0)
      xor    c, (xiz+0)
      xor    d, (xiz+0)
      xor    e, (xiz+0)
      xor    h, (xiz+0)
      xor    l, (xiz+0)
      or     w, (xiz+0)
      or     a, (xiz+0)
      or     b, (xiz+0)
      or     c, (xiz+0)
      or     d, (xiz+0)
      or     e, (xiz+0)
      or     h, (xiz+0)
      or     l, (xiz+0)
      rlc    0E9H, (xiz+0)
      rrc    0EAH, (xiz+0)
      rl     0EBH, (xiz+0)
      rr     0ECH, (xiz+0)
      sla    0EDH, (xiz+0)
      sra    0EEH, (xiz+0)
      sll    0EFH, (xiz+0)
      srl    0F0H, (xiz+0)
      cp     w, (xiz+0)
      cp     a, (xiz+0)
      cp     b, (xiz+0)
      cp     c, (xiz+0)
      cp     d, (xiz+0)
      cp     e, (xiz+0)
      cp     h, (xiz+0)
      cp     l, (xiz+0)
      adc    a, (xsp-70H)
      adc    b, (xsp-70H)
      adc    c, (xsp-70H)
      adc    d, (xsp-70H)
      adc    e, (xsp-70H)
      adc    h, (xsp-70H)
      adc    l, (xsp-70H)
      sub    w, (xsp-70H)
      sub    a, (xsp-70H)
      sub    b, (xsp-70H)
      sub    c, (xsp-70H)
      sub    d, (xsp-70H)
      sub    e, (xsp-70H)
      sub    h, (xsp-70H)
      sub    l, (xsp-70H)
      sbc    w, (xsp-70H)
      sbc    a, (xsp-70H)
      sbc    b, (xsp-70H)
      sbc    c, (xsp-70H)
      sbc    d, (xsp-70H)
      sbc    e, (xsp-70H)
      sbc    h, (xsp-70H)
      sbc    l, (xsp-70H)
      and    w, (xsp-70H)
      and    a, (xsp-70H)
      and    b, (xsp-70H)
      and    c, (xsp-70H)
      and    d, (xsp-70H)
      and    e, (xsp-70H)
      and    h, (xsp-70H)
      and    l, (xsp-70H)
      xor    w, (xsp-70H)
      xor    a, (xsp-70H)
      xor    b, (xsp-70H)
      xor    c, (xsp-70H)
      xor    d, (xsp-70H)
      xor    e, (xsp-70H)
      xor    h, (xsp-70H)
      xor    l, (xsp-70H)
      or     w, (xsp-70H)
      or     a, (xsp-70H)
      or     b, (xsp-70H)
      or     c, (xsp-70H)
      or     d, (xsp-70H)
      or     e, (xsp-70H)
      or     h, (xsp-70H)
      or     l, (xsp-70H)
      rlc    0E9H, (xsp-70H)
      rrc    0EAH, (xsp-70H)
      rl     0EBH, (xsp-70H)
      rr     0ECH, (xsp-70H)
      sla    0EDH, (xsp-70H)
      sra    0EEH, (xsp-70H)
      sll    0EFH, (xsp-70H)
      srl    0F0H, (xsp-70H)
      cp     w, (xsp-70H)
      cp     a, (xsp-70H)
      cp     b, (xsp-70H)
      cp     c, (xsp-70H)
      cp     d, (xsp-70H)
      cp     e, (xsp-70H)
      cp     h, (xsp-70H)
      cp     l, (xsp-70H)
      push   (xsp-70H)
      rld    a, (xsp-70H)
      rrd    a, (xsp-70H)
      ld     (1B1AH), (xsp-70H)
      ld     w, (xsp-70H)
      ld     a, (xsp-70H)
      ld     b, (xsp-70H)
      ld     c, (xsp-70H)
      ld     d, (xsp-70H)
      ld     e, (xsp-70H)
      ld     h, (xsp-70H)
      ld     l, (xsp-70H)
      ex     w, (xsp-70H)
      ex     a, (xsp-70H)
      ex     b, (xsp-70H)
      ex     c, (xsp-70H)
      ex     d, (xsp-70H)
      ex     e, (xsp-70H)
      ex     h, (xsp-70H)
      ex     l, (xsp-70H)
      cp     (xsp-70H), 40H
      mul    wa, (xsp-70H)
      mul    bc, (xsp-70H)
      mul    de, (xsp-70H)
      mul    hl, (xsp-70H)
      muls   wa, (xsp-70H)
      muls   bc, (xsp-70H)
      muls   de, (xsp-70H)
      muls   hl, (xsp-70H)
      div    wa, (xsp-70H)
      div    bc, (xsp-70H)
      div    de, (xsp-70H)
      div    hl, (xsp-70H)
      divs   wa, (xsp-70H)
      divs   bc, (xsp-70H)
      divs   de, (xsp-70H)
      divs   hl, (xsp-70H)
      inc    1, (xsp-70H)
      dec    1, (xsp-70H)
      add    w, (xsp-70H)
      add    a, (xsp-70H)
      add    b, (xsp-70H)
      add    c, (xsp-70H)
      add    d, (xsp-70H)
      add    e, (xsp-70H)
      add    h, (xsp-70H)
      add    l, (xsp-70H)
      adc    w, (xsp-70H)
      push   (xsp+0)
      rld    a, (xsp+0)
      rrd    a, (xsp+0)
      ld     (1B1AH), (xsp+0)
      ld     w, (xsp+0)
      ld     a, (xsp+0)
      ld     b, (xsp+0)
      ld     c, (xsp+0)
      ld     d, (xsp+0)
      ld     e, (xsp+0)
      ld     h, (xsp+0)
      ld     l, (xsp+0)
      ex     w, (xsp+0)
      ex     a, (xsp+0)
      ex     b, (xsp+0)
      ex     c, (xsp+0)
      ex     d, (xsp+0)
      ex     e, (xsp+0)
      ex     h, (xsp+0)
      ex     l, (xsp+0)
      cp     (xsp+0), 40H
      mul    wa, (xsp+0)
      mul    bc, (xsp+0)
      mul    de, (xsp+0)
      mul    hl, (xsp+0)
      muls   wa, (xsp+0)
      muls   bc, (xsp+0)
      muls   de, (xsp+0)
      muls   hl, (xsp+0)
      div    wa, (xsp+0)
      div    bc, (xsp+0)
      div    de, (xsp+0)
      div    hl, (xsp+0)
      divs   wa, (xsp+0)
      divs   bc, (xsp+0)
      divs   de, (xsp+0)
      divs   hl, (xsp+0)
      inc    1, (xsp+0)
      dec    1, (xsp+0)
      add    w, (xsp+0)
      add    a, (xsp+0)
      add    b, (xsp+0)
      add    c, (xsp+0)
      add    d, (xsp+0)
      add    e, (xsp+0)
      add    h, (xsp+0)
      add    l, (xsp+0)
      adc    w, (xsp+0)
      adc    a, (xsp+0)
      adc    b, (xsp+0)
      adc    c, (xsp+0)
      adc    d, (xsp+0)
      adc    e, (xsp+0)
      adc    h, (xsp+0)
      adc    l, (xsp+0)
      sub    w, (xsp+0)
      sub    a, (xsp+0)
      sub    b, (xsp+0)
      sub    c, (xsp+0)
      sub    d, (xsp+0)
      sub    e, (xsp+0)
      sub    h, (xsp+0)
      sub    l, (xsp+0)
      sbc    w, (xsp+0)
      sbc    a, (xsp+0)
      sbc    b, (xsp+0)
      sbc    c, (xsp+0)
      sbc    d, (xsp+0)
      sbc    e, (xsp+0)
      sbc    h, (xsp+0)
      sbc    l, (xsp+0)
      and    w, (xsp+0)
      and    a, (xsp+0)
      and    b, (xsp+0)
      and    c, (xsp+0)
      and    d, (xsp+0)
      and    e, (xsp+0)
      and    h, (xsp+0)
      and    l, (xsp+0)
      xor    w, (xsp+0)
      xor    a, (xsp+0)
      xor    b, (xsp+0)
      xor    c, (xsp+0)
      xor    d, (xsp+0)
      xor    e, (xsp+0)
      xor    h, (xsp+0)
      xor    l, (xsp+0)
      or     w, (xsp+0)
      or     a, (xsp+0)
      or     b, (xsp+0)
      or     c, (xsp+0)
      or     d, (xsp+0)
      or     e, (xsp+0)
      or     h, (xsp+0)
      or     l, (xsp+0)
      rlc    0E9H, (xsp+0)
      rrc    0EAH, (xsp+0)
      rl     0EBH, (xsp+0)
      rr     0ECH, (xsp+0)
      sla    0EDH, (xsp+0)
      sra    0EEH, (xsp+0)
      sll    0EFH, (xsp+0)
      srl    0F0H, (xsp+0)
      cp     w, (xsp+0)
      cp     a, (xsp+0)
      cp     b, (xsp+0)
      cp     c, (xsp+0)
      cp     d, (xsp+0)
      cp     e, (xsp+0)
      cp     h, (xsp+0)
      cp     l, (xsp+0)
      adc    iy, (xix)
      adc    iz, (xix)
      adc    sp, (xix)
      sub    wa, (xix)
      sub    bc, (xix)
      sub    de, (xix)
      sub    hl, (xix)
      sub    ix, (xix)
      sub    iy, (xix)
      sub    iz, (xix)
      sub    sp, (xix)
      sbc    wa, (xix)
      sbc    bc, (xix)
      sbc    de, (xix)
      sbc    hl, (xix)
      sbc    ix, (xix)
      sbc    iy, (xix)
      sbc    iz, (xix)
      sbc    sp, (xix)
      and    wa, (xix)
      and    bc, (xix)
      and    de, (xix)
      and    hl, (xix)
      and    ix, (xix)
      and    iy, (xix)
      and    iz, (xix)
      and    sp, (xix)
      xor    wa, (xix)
      xor    bc, (xix)
      xor    de, (xix)
      xor    hl, (xix)
      xor    ix, (xix)
      xor    iy, (xix)
      xor    iz, (xix)
      xor    sp, (xix)
      or     wa, (xix)
      or     bc, (xix)
      or     de, (xix)
      or     hl, (xix)
      or     ix, (xix)
      or     iy, (xix)
      or     iz, (xix)
      or     sp, (xix)
      cp     wa, (xix)
      cp     bc, (xix)
      cp     de, (xix)
      cp     hl, (xix)
      cp     ix, (xix)
      cp     iy, (xix)
      cp     iz, (xix)
      cp     sp, (xix)
      ld     wa, (xix)
      ld     bc, (xix)
      ld     de, (xix)
      ld     hl, (xix)
      ld     ix, (xix)
      ld     iy, (xix)
      ld     iz, (xix)
      ld     sp, (xix)
      ex     wa, (xix)
      ex     bc, (xix)
      ex     de, (xix)
      ex     hl, (xix)
      ex     ix, (xix)
      ex     iy, (xix)
      ex     iz, (xix)
      ex     sp, (xix)
      mul    xix, (xix)
      mul    xiy, (xix)
      mul    xiz, (xix)
      mul    xsp, (xix)
      muls   xix, (xix)
      muls   xiy, (xix)
      muls   xiz, (xix)
      muls   xsp, (xix)
      div    xix, (xix)
      div    xiy, (xix)
      div    xiz, (xix)
      div    xsp, (xix)
      divs   xix, (xix)
      divs   xiy, (xix)
      divs   xiz, (xix)
      divs   xsp, (xix)
      add    wa, (xix)
      add    bc, (xix)
      add    de, (xix)
      add    hl, (xix)
      add    ix, (xix)
      add    iy, (xix)
      add    iz, (xix)
      add    sp, (xix)
      adc    wa, (xix)
      adc    bc, (xix)
      adc    de, (xix)
      adc    hl, (xix)
      adc    ix, (xix)
      adc    iz, (xiy)
      adc    sp, (xiy)
      sub    wa, (xiy)
      sub    bc, (xiy)
      sub    de, (xiy)
      sub    hl, (xiy)
      sub    ix, (xiy)
      sub    iy, (xiy)
      sub    iz, (xiy)
      sub    sp, (xiy)
      sbc    wa, (xiy)
      sbc    bc, (xiy)
      sbc    de, (xiy)
      sbc    hl, (xiy)
      sbc    ix, (xiy)
      sbc    iy, (xiy)
      sbc    iz, (xiy)
      sbc    sp, (xiy)
      and    wa, (xiy)
      and    bc, (xiy)
      and    de, (xiy)
      and    hl, (xiy)
      and    ix, (xiy)
      and    iy, (xiy)
      and    iz, (xiy)
      and    sp, (xiy)
      xor    wa, (xiy)
      xor    bc, (xiy)
      xor    de, (xiy)
      xor    hl, (xiy)
      xor    ix, (xiy)
      xor    iy, (xiy)
      xor    iz, (xiy)
      xor    sp, (xiy)
      or     wa, (xiy)
      or     bc, (xiy)
      or     de, (xiy)
      or     hl, (xiy)
      or     ix, (xiy)
      or     iy, (xiy)
      or     iz, (xiy)
      or     sp, (xiy)
      cp     wa, (xiy)
      cp     bc, (xiy)
      cp     de, (xiy)
      cp     hl, (xiy)
      cp     ix, (xiy)
      cp     iy, (xiy)
      cp     iz, (xiy)
      cp     sp, (xiy)
      ld     wa, (xiy)
      ld     bc, (xiy)
      ld     de, (xiy)
      ld     hl, (xiy)
      ld     ix, (xiy)
      ld     iy, (xiy)
      ld     iz, (xiy)
      ld     sp, (xiy)
      ex     wa, (xiy)
      ex     bc, (xiy)
      ex     de, (xiy)
      ex     hl, (xiy)
      ex     ix, (xiy)
      ex     iy, (xiy)
      ex     iz, (xiy)
      ex     sp, (xiy)
      mul    xix, (xiy)
      mul    xiy, (xiy)
      mul    xiz, (xiy)
      mul    xsp, (xiy)
      muls   xix, (xiy)
      muls   xiy, (xiy)
      muls   xiz, (xiy)
      muls   xsp, (xiy)
      div    xix, (xiy)
      div    xiy, (xiy)
      div    xiz, (xiy)
      div    xsp, (xiy)
      divs   xix, (xiy)
      divs   xiy, (xiy)
      divs   xiz, (xiy)
      divs   xsp, (xiy)
      add    wa, (xiy)
      add    bc, (xiy)
      add    de, (xiy)
      add    hl, (xiy)
      add    ix, (xiy)
      add    iy, (xiy)
      add    iz, (xiy)
      add    sp, (xiy)
      adc    wa, (xiy)
      adc    bc, (xiy)
      adc    de, (xiy)
      adc    hl, (xiy)
      adc    ix, (xiy)
      adc    iy, (xiy)
      adc    sp, (xiz)
      sub    wa, (xiz)
      sub    bc, (xiz)
      sub    de, (xiz)
      sub    hl, (xiz)
      sub    ix, (xiz)
      sub    iy, (xiz)
      sub    iz, (xiz)
      sub    sp, (xiz)
      sbc    wa, (xiz)
      sbc    bc, (xiz)
      sbc    de, (xiz)
      sbc    hl, (xiz)
      sbc    ix, (xiz)
      sbc    iy, (xiz)
      sbc    iz, (xiz)
      sbc    sp, (xiz)
      and    wa, (xiz)
      and    bc, (xiz)
      and    de, (xiz)
      and    hl, (xiz)
      and    ix, (xiz)
      and    iy, (xiz)
      and    iz, (xiz)
      and    sp, (xiz)
      xor    wa, (xiz)
      xor    bc, (xiz)
      xor    de, (xiz)
      xor    hl, (xiz)
      xor    ix, (xiz)
      xor    iy, (xiz)
      xor    iz, (xiz)
      xor    sp, (xiz)
      or     wa, (xiz)
      or     bc, (xiz)
      or     de, (xiz)
      or     hl, (xiz)
      or     ix, (xiz)
      or     iy, (xiz)
      or     iz, (xiz)
      or     sp, (xiz)
      cp     wa, (xiz)
      cp     bc, (xiz)
      cp     de, (xiz)
      cp     hl, (xiz)
      cp     ix, (xiz)
      cp     iy, (xiz)
      cp     iz, (xiz)
      cp     sp, (xiz)
      ld     wa, (xiz)
      ld     bc, (xiz)
      ld     de, (xiz)
      ld     hl, (xiz)
      ld     ix, (xiz)
      ld     iy, (xiz)
      ld     iz, (xiz)
      ld     sp, (xiz)
      ex     wa, (xiz)
      ex     bc, (xiz)
      ex     de, (xiz)
      ex     hl, (xiz)
      ex     ix, (xiz)
      ex     iy, (xiz)
      ex     iz, (xiz)
      ex     sp, (xiz)
      mul    xix, (xiz)
      mul    xiy, (xiz)
      mul    xiz, (xiz)
      mul    xsp, (xiz)
      muls   xix, (xiz)
      muls   xiy, (xiz)
      muls   xiz, (xiz)
      muls   xsp, (xiz)
      div    xix, (xiz)
      div    xiy, (xiz)
      div    xiz, (xiz)
      div    xsp, (xiz)
      divs   xix, (xiz)
      divs   xiy, (xiz)
      divs   xiz, (xiz)
      divs   xsp, (xiz)
      add    wa, (xiz)
      add    bc, (xiz)
      add    de, (xiz)
      add    hl, (xiz)
      add    ix, (xiz)
      add    iy, (xiz)
      add    iz, (xiz)
      add    sp, (xiz)
      adc    wa, (xiz)
      adc    bc, (xiz)
      adc    de, (xiz)
      adc    hl, (xiz)
      adc    ix, (xiz)
      adc    iy, (xiz)
      adc    iz, (xiz)
      sub    wa, (xsp)
      sub    bc, (xsp)
      sub    de, (xsp)
      sub    hl, (xsp)
      sub    ix, (xsp)
      sub    iy, (xsp)
      sub    iz, (xsp)
      sub    sp, (xsp)
      sbc    wa, (xsp)
      sbc    bc, (xsp)
      sbc    de, (xsp)
      sbc    hl, (xsp)
      sbc    ix, (xsp)
      sbc    iy, (xsp)
      sbc    iz, (xsp)
      sbc    sp, (xsp)
      and    wa, (xsp)
      and    bc, (xsp)
      and    de, (xsp)
      and    hl, (xsp)
      and    ix, (xsp)
      and    iy, (xsp)
      and    iz, (xsp)
      and    sp, (xsp)
      xor    wa, (xsp)
      xor    bc, (xsp)
      xor    de, (xsp)
      xor    hl, (xsp)
      xor    ix, (xsp)
      xor    iy, (xsp)
      xor    iz, (xsp)
      xor    sp, (xsp)
      or     wa, (xsp)
      or     bc, (xsp)
      or     de, (xsp)
      or     hl, (xsp)
      or     ix, (xsp)
      or     iy, (xsp)
      or     iz, (xsp)
      or     sp, (xsp)
      cp     wa, (xsp)
      cp     bc, (xsp)
      cp     de, (xsp)
      cp     hl, (xsp)
      cp     ix, (xsp)
      cp     iy, (xsp)
      cp     iz, (xsp)
      cp     sp, (xsp)
      ld     wa, (xsp)
      ld     bc, (xsp)
      ld     de, (xsp)
      ld     hl, (xsp)
      ld     ix, (xsp)
      ld     iy, (xsp)
      ld     iz, (xsp)
      ld     sp, (xsp)
      ex     wa, (xsp)
      ex     bc, (xsp)
      ex     de, (xsp)
      ex     hl, (xsp)
      ex     ix, (xsp)
      ex     iy, (xsp)
      ex     iz, (xsp)
      ex     sp, (xsp)
      mul    xix, (xsp)
      mul    xiy, (xsp)
      mul    xiz, (xsp)
      mul    xsp, (xsp)
      muls   xix, (xsp)
      muls   xiy, (xsp)
      muls   xiz, (xsp)
      muls   xsp, (xsp)
      div    xix, (xsp)
      div    xiy, (xsp)
      div    xiz, (xsp)
      div    xsp, (xsp)
      divs   xix, (xsp)
      divs   xiy, (xsp)
      divs   xiz, (xsp)
      divs   xsp, (xsp)
      add    wa, (xsp)
      add    bc, (xsp)
      add    de, (xsp)
      add    hl, (xsp)
      add    ix, (xsp)
      add    iy, (xsp)
      add    iz, (xsp)
      add    sp, (xsp)
      adc    wa, (xsp)
      adc    bc, (xsp)
      adc    de, (xsp)
      adc    hl, (xsp)
      adc    ix, (xsp)
      adc    iy, (xsp)
      adc    iz, (xsp)
      adc    sp, (xsp)
      sub    wa, (xix-63H)
      sub    bc, (xix-63H)
      sub    de, (xix-63H)
      sub    hl, (xix-63H)
      sub    ix, (xix-63H)
      sub    iy, (xix-63H)
      sub    iz, (xix-63H)
      sub    sp, (xix-63H)
      sbc    wa, (xix-63H)
      sbc    bc, (xix-63H)
      sbc    de, (xix-63H)
      sbc    hl, (xix-63H)
      sbc    ix, (xix-63H)
      sbc    iy, (xix-63H)
      sbc    iz, (xix-63H)
      sbc    sp, (xix-63H)
      and    wa, (xix-63H)
      and    bc, (xix-63H)
      and    de, (xix-63H)
      and    hl, (xix-63H)
      and    ix, (xix-63H)
      and    iy, (xix-63H)
      and    iz, (xix-63H)
      and    sp, (xix-63H)
      xor    wa, (xix-63H)
      xor    bc, (xix-63H)
      xor    de, (xix-63H)
      xor    hl, (xix-63H)
      xor    ix, (xix-63H)
      xor    iy, (xix-63H)
      xor    iz, (xix-63H)
      xor    sp, (xix-63H)
      or     wa, (xix-63H)
      or     bc, (xix-63H)
      or     de, (xix-63H)
      or     hl, (xix-63H)
      or     ix, (xix-63H)
      or     iy, (xix-63H)
      or     iz, (xix-63H)
      or     sp, (xix-63H)
      cp     wa, (xix-63H)
      cp     bc, (xix-63H)
      cp     de, (xix-63H)
      cp     hl, (xix-63H)
      cp     ix, (xix-63H)
      cp     iy, (xix-63H)
      cp     iz, (xix-63H)
      cp     sp, (xix-63H)
      ld     wa, (xix-63H)
      ld     bc, (xix-63H)
      ld     de, (xix-63H)
      ld     hl, (xix-63H)
      ld     ix, (xix-63H)
      ld     iy, (xix-63H)
      ld     iz, (xix-63H)
      ld     sp, (xix-63H)
      ex     wa, (xix-63H)
      ex     bc, (xix-63H)
      ex     de, (xix-63H)
      ex     hl, (xix-63H)
      ex     ix, (xix-63H)
      ex     iy, (xix-63H)
      ex     iz, (xix-63H)
      ex     sp, (xix-63H)
      mul    xix, (xix-63H)
      mul    xiy, (xix-63H)
      mul    xiz, (xix-63H)
      mul    xsp, (xix-63H)
      muls   xix, (xix-63H)
      muls   xiy, (xix-63H)
      muls   xiz, (xix-63H)
      muls   xsp, (xix-63H)
      div    xix, (xix-63H)
      div    xiy, (xix-63H)
      div    xiz, (xix-63H)
      div    xsp, (xix-63H)
      divs   xix, (xix-63H)
      divs   xiy, (xix-63H)
      divs   xiz, (xix-63H)
      divs   xsp, (xix-63H)
      add    wa, (xix-63H)
      add    bc, (xix-63H)
      add    de, (xix-63H)
      add    hl, (xix-63H)
      add    ix, (xix-63H)
      add    iy, (xix-63H)
      add    iz, (xix-63H)
      add    sp, (xix-63H)
      adc    wa, (xix-63H)
      adc    bc, (xix-63H)
      adc    de, (xix-63H)
      adc    hl, (xix-63H)
      adc    ix, (xix-63H)
      adc    iy, (xix-63H)
      adc    iz, (xix-63H)
      adc    sp, (xix-63H)
      ld     wa, (xix+0)
      ld     bc, (xix+0)
      ld     de, (xix+0)
      ld     hl, (xix+0)
      ld     ix, (xix+0)
      ld     iy, (xix+0)
      ld     iz, (xix+0)
      ld     sp, (xix+0)
      ex     wa, (xix+0)
      ex     bc, (xix+0)
      ex     de, (xix+0)
      ex     hl, (xix+0)
      ex     ix, (xix+0)
      ex     iy, (xix+0)
      ex     iz, (xix+0)
      ex     sp, (xix+0)
      mul    xix, (xix+0)
      mul    xiy, (xix+0)
      mul    xiz, (xix+0)
      mul    xsp, (xix+0)
      muls   xix, (xix+0)
      muls   xiy, (xix+0)
      muls   xiz, (xix+0)
      muls   xsp, (xix+0)
      div    xix, (xix+0)
      div    xiy, (xix+0)
      div    xiz, (xix+0)
      div    xsp, (xix+0)
      divs   xix, (xix+0)
      divs   xiy, (xix+0)
      divs   xiz, (xix+0)
      divs   xsp, (xix+0)
      add    wa, (xix+0)
      add    bc, (xix+0)
      add    de, (xix+0)
      add    hl, (xix+0)
      add    ix, (xix+0)
      add    iy, (xix+0)
      add    iz, (xix+0)
      add    sp, (xix+0)
      adc    wa, (xix+0)
      adc    bc, (xix+0)
      adc    de, (xix+0)
      adc    hl, (xix+0)
      adc    ix, (xix+0)
      adc    iy, (xix+0)
      adc    iz, (xix+0)
      adc    sp, (xix+0)
      sub    wa, (xix+0)
      sub    bc, (xix+0)
      sub    de, (xix+0)
      sub    hl, (xix+0)
      sub    ix, (xix+0)
      sub    iy, (xix+0)
      sub    iz, (xix+0)
      sub    sp, (xix+0)
      sbc    wa, (xix+0)
      sbc    bc, (xix+0)
      sbc    de, (xix+0)
      sbc    hl, (xix+0)
      sbc    ix, (xix+0)
      sbc    iy, (xix+0)
      sbc    iz, (xix+0)
      sbc    sp, (xix+0)
      and    wa, (xix+0)
      and    bc, (xix+0)
      and    de, (xix+0)
      and    hl, (xix+0)
      and    ix, (xix+0)
      and    iy, (xix+0)
      and    iz, (xix+0)
      and    sp, (xix+0)
      xor    wa, (xix+0)
      xor    bc, (xix+0)
      xor    de, (xix+0)
      xor    hl, (xix+0)
      xor    ix, (xix+0)
      xor    iy, (xix+0)
      xor    iz, (xix+0)
      xor    sp, (xix+0)
      or     wa, (xix+0)
      or     bc, (xix+0)
      or     de, (xix+0)
      or     hl, (xix+0)
      or     ix, (xix+0)
      or     iy, (xix+0)
      or     iz, (xix+0)
      or     sp, (xix+0)
      cp     wa, (xix+0)
      cp     bc, (xix+0)
      cp     de, (xix+0)
      cp     hl, (xix+0)
      cp     ix, (xix+0)
      cp     iy, (xix+0)
      cp     iz, (xix+0)
      cp     sp, (xix+0)
      sub    wa, (xiy-62H)
      sub    bc, (xiy-62H)
      sub    de, (xiy-62H)
      sub    hl, (xiy-62H)
      sub    ix, (xiy-62H)
      sub    iy, (xiy-62H)
      sub    iz, (xiy-62H)
      sub    sp, (xiy-62H)
      sbc    wa, (xiy-62H)
      sbc    bc, (xiy-62H)
      sbc    de, (xiy-62H)
      sbc    hl, (xiy-62H)
      sbc    ix, (xiy-62H)
      sbc    iy, (xiy-62H)
      sbc    iz, (xiy-62H)
      sbc    sp, (xiy-62H)
      and    wa, (xiy-62H)
      and    bc, (xiy-62H)
      and    de, (xiy-62H)
      and    hl, (xiy-62H)
      and    ix, (xiy-62H)
      and    iy, (xiy-62H)
      and    iz, (xiy-62H)
      and    sp, (xiy-62H)
      xor    wa, (xiy-62H)
      xor    bc, (xiy-62H)
      xor    de, (xiy-62H)
      xor    hl, (xiy-62H)
      xor    ix, (xiy-62H)
      xor    iy, (xiy-62H)
      xor    iz, (xiy-62H)
      xor    sp, (xiy-62H)
      or     wa, (xiy-62H)
      or     bc, (xiy-62H)
      or     de, (xiy-62H)
      or     hl, (xiy-62H)
      or     ix, (xiy-62H)
      or     iy, (xiy-62H)
      or     iz, (xiy-62H)
      or     sp, (xiy-62H)
      cp     wa, (xiy-62H)
      cp     bc, (xiy-62H)
      cp     de, (xiy-62H)
      cp     hl, (xiy-62H)
      cp     ix, (xiy-62H)
      cp     iy, (xiy-62H)
      cp     iz, (xiy-62H)
      cp     sp, (xiy-62H)
      ld     wa, (xiy-62H)
      ld     bc, (xiy-62H)
      ld     de, (xiy-62H)
      ld     hl, (xiy-62H)
      ld     ix, (xiy-62H)
      ld     iy, (xiy-62H)
      ld     iz, (xiy-62H)
      ld     sp, (xiy-62H)
      ex     wa, (xiy-62H)
      ex     bc, (xiy-62H)
      ex     de, (xiy-62H)
      ex     hl, (xiy-62H)
      ex     ix, (xiy-62H)
      ex     iy, (xiy-62H)
      ex     iz, (xiy-62H)
      ex     sp, (xiy-62H)
      mul    xix, (xiy-62H)
      mul    xiy, (xiy-62H)
      mul    xiz, (xiy-62H)
      mul    xsp, (xiy-62H)
      muls   xix, (xiy-62H)
      muls   xiy, (xiy-62H)
      muls   xiz, (xiy-62H)
      muls   xsp, (xiy-62H)
      div    xix, (xiy-62H)
      div    xiy, (xiy-62H)
      div    xiz, (xiy-62H)
      div    xsp, (xiy-62H)
      divs   xix, (xiy-62H)
      divs   xiy, (xiy-62H)
      divs   xiz, (xiy-62H)
      divs   xsp, (xiy-62H)
      add    wa, (xiy-62H)
      add    bc, (xiy-62H)
      add    de, (xiy-62H)
      add    hl, (xiy-62H)
      add    ix, (xiy-62H)
      add    iy, (xiy-62H)
      add    iz, (xiy-62H)
      add    sp, (xiy-62H)
      adc    wa, (xiy-62H)
      adc    bc, (xiy-62H)
      adc    de, (xiy-62H)
      adc    hl, (xiy-62H)
      adc    ix, (xiy-62H)
      adc    iy, (xiy-62H)
      adc    iz, (xiy-62H)
      adc    sp, (xiy-62H)
      ld     wa, (xiy+0)
      ld     bc, (xiy+0)
      ld     de, (xiy+0)
      ld     hl, (xiy+0)
      ld     ix, (xiy+0)
      ld     iy, (xiy+0)
      ld     iz, (xiy+0)
      ld     sp, (xiy+0)
      ex     wa, (xiy+0)
      ex     bc, (xiy+0)
      ex     de, (xiy+0)
      ex     hl, (xiy+0)
      ex     ix, (xiy+0)
      ex     iy, (xiy+0)
      ex     iz, (xiy+0)
      ex     sp, (xiy+0)
      mul    xix, (xiy+0)
      mul    xiy, (xiy+0)
      mul    xiz, (xiy+0)
      mul    xsp, (xiy+0)
      muls   xix, (xiy+0)
      muls   xiy, (xiy+0)
      muls   xiz, (xiy+0)
      muls   xsp, (xiy+0)
      div    xix, (xiy+0)
      div    xiy, (xiy+0)
      div    xiz, (xiy+0)
      div    xsp, (xiy+0)
      divs   xix, (xiy+0)
      divs   xiy, (xiy+0)
      divs   xiz, (xiy+0)
      divs   xsp, (xiy+0)
      add    wa, (xiy+0)
      add    bc, (xiy+0)
      add    de, (xiy+0)
      add    hl, (xiy+0)
      add    ix, (xiy+0)
      add    iy, (xiy+0)
      add    iz, (xiy+0)
      add    sp, (xiy+0)
      adc    wa, (xiy+0)
      adc    bc, (xiy+0)
      adc    de, (xiy+0)
      adc    hl, (xiy+0)
      adc    ix, (xiy+0)
      adc    iy, (xiy+0)
      adc    iz, (xiy+0)
      adc    sp, (xiy+0)
      sub    wa, (xiy+0)
      sub    bc, (xiy+0)
      sub    de, (xiy+0)
      sub    hl, (xiy+0)
      sub    ix, (xiy+0)
      sub    iy, (xiy+0)
      sub    iz, (xiy+0)
      sub    sp, (xiy+0)
      sbc    wa, (xiy+0)
      sbc    bc, (xiy+0)
      sbc    de, (xiy+0)
      sbc    hl, (xiy+0)
      sbc    ix, (xiy+0)
      sbc    iy, (xiy+0)
      sbc    iz, (xiy+0)
      sbc    sp, (xiy+0)
      and    wa, (xiy+0)
      and    bc, (xiy+0)
      and    de, (xiy+0)
      and    hl, (xiy+0)
      and    ix, (xiy+0)
      and    iy, (xiy+0)
      and    iz, (xiy+0)
      and    sp, (xiy+0)
      xor    wa, (xiy+0)
      xor    bc, (xiy+0)
      xor    de, (xiy+0)
      xor    hl, (xiy+0)
      xor    ix, (xiy+0)
      xor    iy, (xiy+0)
      xor    iz, (xiy+0)
      xor    sp, (xiy+0)
      or     wa, (xiy+0)
      or     bc, (xiy+0)
      or     de, (xiy+0)
      or     hl, (xiy+0)
      or     ix, (xiy+0)
      or     iy, (xiy+0)
      or     iz, (xiy+0)
      or     sp, (xiy+0)
      cp     wa, (xiy+0)
      cp     bc, (xiy+0)
      cp     de, (xiy+0)
      cp     hl, (xiy+0)
      cp     ix, (xiy+0)
      cp     iy, (xiy+0)
      cp     iz, (xiy+0)
      cp     sp, (xiy+0)
      sub    wa, (xiz-61H)
      sub    bc, (xiz-61H)
      sub    de, (xiz-61H)
      sub    hl, (xiz-61H)
      sub    ix, (xiz-61H)
      sub    iy, (xiz-61H)
      sub    iz, (xiz-61H)
      sub    sp, (xiz-61H)
      sbc    wa, (xiz-61H)
      sbc    bc, (xiz-61H)
      sbc    de, (xiz-61H)
      sbc    hl, (xiz-61H)
      sbc    ix, (xiz-61H)
      sbc    iy, (xiz-61H)
      sbc    iz, (xiz-61H)
      sbc    sp, (xiz-61H)
      and    wa, (xiz-61H)
      and    bc, (xiz-61H)
      and    de, (xiz-61H)
      and    hl, (xiz-61H)
      and    ix, (xiz-61H)
      and    iy, (xiz-61H)
      and    iz, (xiz-61H)
      and    sp, (xiz-61H)
      xor    wa, (xiz-61H)
      xor    bc, (xiz-61H)
      xor    de, (xiz-61H)
      xor    hl, (xiz-61H)
      xor    ix, (xiz-61H)
      xor    iy, (xiz-61H)
      xor    iz, (xiz-61H)
      xor    sp, (xiz-61H)
      or     wa, (xiz-61H)
      or     bc, (xiz-61H)
      or     de, (xiz-61H)
      or     hl, (xiz-61H)
      or     ix, (xiz-61H)
      or     iy, (xiz-61H)
      or     iz, (xiz-61H)
      or     sp, (xiz-61H)
      cp     wa, (xiz-61H)
      cp     bc, (xiz-61H)
      cp     de, (xiz-61H)
      cp     hl, (xiz-61H)
      cp     ix, (xiz-61H)
      cp     iy, (xiz-61H)
      cp     iz, (xiz-61H)
      cp     sp, (xiz-61H)
      ld     wa, (xiz-61H)
      ld     bc, (xiz-61H)
      ld     de, (xiz-61H)
      ld     hl, (xiz-61H)
      ld     ix, (xiz-61H)
      ld     iy, (xiz-61H)
      ld     iz, (xiz-61H)
      ld     sp, (xiz-61H)
      ex     wa, (xiz-61H)
      ex     bc, (xiz-61H)
      ex     de, (xiz-61H)
      ex     hl, (xiz-61H)
      ex     ix, (xiz-61H)
      ex     iy, (xiz-61H)
      ex     iz, (xiz-61H)
      ex     sp, (xiz-61H)
      mul    xix, (xiz-61H)
      mul    xiy, (xiz-61H)
      mul    xiz, (xiz-61H)
      mul    xsp, (xiz-61H)
      muls   xix, (xiz-61H)
      muls   xiy, (xiz-61H)
      muls   xiz, (xiz-61H)
      muls   xsp, (xiz-61H)
      div    xix, (xiz-61H)
      div    xiy, (xiz-61H)
      div    xiz, (xiz-61H)
      div    xsp, (xiz-61H)
      divs   xix, (xiz-61H)
      divs   xiy, (xiz-61H)
      divs   xiz, (xiz-61H)
      divs   xsp, (xiz-61H)
      add    wa, (xiz-61H)
      add    bc, (xiz-61H)
      add    de, (xiz-61H)
      add    hl, (xiz-61H)
      add    ix, (xiz-61H)
      add    iy, (xiz-61H)
      add    iz, (xiz-61H)
      add    sp, (xiz-61H)
      adc    wa, (xiz-61H)
      adc    bc, (xiz-61H)
      adc    de, (xiz-61H)
      adc    hl, (xiz-61H)
      adc    ix, (xiz-61H)
      adc    iy, (xiz-61H)
      adc    iz, (xiz-61H)
      adc    sp, (xiz-61H)
      ld     wa, (xiz+0)
      ld     bc, (xiz+0)
      ld     de, (xiz+0)
      ld     hl, (xiz+0)
      ld     ix, (xiz+0)
      ld     iy, (xiz+0)
      ld     iz, (xiz+0)
      ld     sp, (xiz+0)
      ex     wa, (xiz+0)
      ex     bc, (xiz+0)
      ex     de, (xiz+0)
      ex     hl, (xiz+0)
      ex     ix, (xiz+0)
      ex     iy, (xiz+0)
      ex     iz, (xiz+0)
      ex     sp, (xiz+0)
      mul    xix, (xiz+0)
      mul    xiy, (xiz+0)
      mul    xiz, (xiz+0)
      mul    xsp, (xiz+0)
      muls   xix, (xiz+0)
      muls   xiy, (xiz+0)
      muls   xiz, (xiz+0)
      muls   xsp, (xiz+0)
      div    xix, (xiz+0)
      div    xiy, (xiz+0)
      div    xiz, (xiz+0)
      div    xsp, (xiz+0)
      divs   xix, (xiz+0)
      divs   xiy, (xiz+0)
      divs   xiz, (xiz+0)
      divs   xsp, (xiz+0)
      add    wa, (xiz+0)
      add    bc, (xiz+0)
      add    de, (xiz+0)
      add    hl, (xiz+0)
      add    ix, (xiz+0)
      add    iy, (xiz+0)
      add    iz, (xiz+0)
      add    sp, (xiz+0)
      adc    wa, (xiz+0)
      adc    bc, (xiz+0)
      adc    de, (xiz+0)
      adc    hl, (xiz+0)
      adc    ix, (xiz+0)
      adc    iy, (xiz+0)
      adc    iz, (xiz+0)
      adc    sp, (xiz+0)
      sub    wa, (xiz+0)
      sub    bc, (xiz+0)
      sub    de, (xiz+0)
      sub    hl, (xiz+0)
      sub    ix, (xiz+0)
      sub    iy, (xiz+0)
      sub    iz, (xiz+0)
      sub    sp, (xiz+0)
      sbc    wa, (xiz+0)
      sbc    bc, (xiz+0)
      sbc    de, (xiz+0)
      sbc    hl, (xiz+0)
      sbc    ix, (xiz+0)
      sbc    iy, (xiz+0)
      sbc    iz, (xiz+0)
      sbc    sp, (xiz+0)
      and    wa, (xiz+0)
      and    bc, (xiz+0)
      and    de, (xiz+0)
      and    hl, (xiz+0)
      and    ix, (xiz+0)
      and    iy, (xiz+0)
      and    iz, (xiz+0)
      and    sp, (xiz+0)
      xor    wa, (xiz+0)
      xor    bc, (xiz+0)
      xor    de, (xiz+0)
      xor    hl, (xiz+0)
      xor    ix, (xiz+0)
      xor    iy, (xiz+0)
      xor    iz, (xiz+0)
      xor    sp, (xiz+0)
      or     wa, (xiz+0)
      or     bc, (xiz+0)
      or     de, (xiz+0)
      or     hl, (xiz+0)
      or     ix, (xiz+0)
      or     iy, (xiz+0)
      or     iz, (xiz+0)
      or     sp, (xiz+0)
      cp     wa, (xiz+0)
      cp     bc, (xiz+0)
      cp     de, (xiz+0)
      cp     hl, (xiz+0)
      cp     ix, (xiz+0)
      cp     iy, (xiz+0)
      cp     iz, (xiz+0)
      cp     sp, (xiz+0)
      sub    bc, (xsp-60H)
      sub    de, (xsp-60H)
      sub    hl, (xsp-60H)
      sub    ix, (xsp-60H)
      sub    iy, (xsp-60H)
      sub    iz, (xsp-60H)
      sub    sp, (xsp-60H)
      sbc    wa, (xsp-60H)
      sbc    bc, (xsp-60H)
      sbc    de, (xsp-60H)
      sbc    hl, (xsp-60H)
      sbc    ix, (xsp-60H)
      sbc    iy, (xsp-60H)
      sbc    iz, (xsp-60H)
      sbc    sp, (xsp-60H)
      and    wa, (xsp-60H)
      and    bc, (xsp-60H)
      and    de, (xsp-60H)
      and    hl, (xsp-60H)
      and    ix, (xsp-60H)
      and    iy, (xsp-60H)
      and    iz, (xsp-60H)
      and    sp, (xsp-60H)
      xor    wa, (xsp-60H)
      xor    bc, (xsp-60H)
      xor    de, (xsp-60H)
      xor    hl, (xsp-60H)
      xor    ix, (xsp-60H)
      xor    iy, (xsp-60H)
      xor    iz, (xsp-60H)
      xor    sp, (xsp-60H)
      or     wa, (xsp-60H)
      or     bc, (xsp-60H)
      or     de, (xsp-60H)
      or     hl, (xsp-60H)
      or     ix, (xsp-60H)
      or     iy, (xsp-60H)
      or     iz, (xsp-60H)
      or     sp, (xsp-60H)
      cp     wa, (xsp-60H)
      cp     bc, (xsp-60H)
      cp     de, (xsp-60H)
      cp     hl, (xsp-60H)
      cp     ix, (xsp-60H)
      cp     iy, (xsp-60H)
      cp     iz, (xsp-60H)
      cp     sp, (xsp-60H)
      ld     wa, (xsp-60H)
      ld     bc, (xsp-60H)
      ld     de, (xsp-60H)
      ld     hl, (xsp-60H)
      ld     ix, (xsp-60H)
      ld     iy, (xsp-60H)
      ld     iz, (xsp-60H)
      ld     sp, (xsp-60H)
      ex     wa, (xsp-60H)
      ex     bc, (xsp-60H)
      ex     de, (xsp-60H)
      ex     hl, (xsp-60H)
      ex     ix, (xsp-60H)
      ex     iy, (xsp-60H)
      ex     iz, (xsp-60H)
      ex     sp, (xsp-60H)
      mul    xix, (xsp-60H)
      mul    xiy, (xsp-60H)
      mul    xiz, (xsp-60H)
      mul    xsp, (xsp-60H)
      muls   xix, (xsp-60H)
      muls   xiy, (xsp-60H)
      muls   xiz, (xsp-60H)
      muls   xsp, (xsp-60H)
      div    xix, (xsp-60H)
      div    xiy, (xsp-60H)
      div    xiz, (xsp-60H)
      div    xsp, (xsp-60H)
      divs   xix, (xsp-60H)
      divs   xiy, (xsp-60H)
      divs   xiz, (xsp-60H)
      divs   xsp, (xsp-60H)
      add    wa, (xsp-60H)
      add    bc, (xsp-60H)
      add    de, (xsp-60H)
      add    hl, (xsp-60H)
      add    ix, (xsp-60H)
      add    iy, (xsp-60H)
      add    iz, (xsp-60H)
      add    sp, (xsp-60H)
      adc    wa, (xsp-60H)
      adc    bc, (xsp-60H)
      adc    de, (xsp-60H)
      adc    hl, (xsp-60H)
      adc    ix, (xsp-60H)
      adc    iy, (xsp-60H)
      adc    iz, (xsp-60H)
      adc    sp, (xsp-60H)
      sub    wa, (xsp-60H)
      ld     wa, (xsp+0)
      ld     bc, (xsp+0)
      ld     de, (xsp+0)
      ld     hl, (xsp+0)
      ld     ix, (xsp+0)
      ld     iy, (xsp+0)
      ld     iz, (xsp+0)
      ld     sp, (xsp+0)
      ex     wa, (xsp+0)
      ex     bc, (xsp+0)
      ex     de, (xsp+0)
      ex     hl, (xsp+0)
      ex     ix, (xsp+0)
      ex     iy, (xsp+0)
      ex     iz, (xsp+0)
      ex     sp, (xsp+0)
      mul    xix, (xsp+0)
      mul    xiy, (xsp+0)
      mul    xiz, (xsp+0)
      mul    xsp, (xsp+0)
      muls   xix, (xsp+0)
      muls   xiy, (xsp+0)
      muls   xiz, (xsp+0)
      muls   xsp, (xsp+0)
      div    xix, (xsp+0)
      div    xiy, (xsp+0)
      div    xiz, (xsp+0)
      div    xsp, (xsp+0)
      divs   xix, (xsp+0)
      divs   xiy, (xsp+0)
      divs   xiz, (xsp+0)
      divs   xsp, (xsp+0)
      add    wa, (xsp+0)
      add    bc, (xsp+0)
      add    de, (xsp+0)
      add    hl, (xsp+0)
      add    ix, (xsp+0)
      add    iy, (xsp+0)
      add    iz, (xsp+0)
      add    sp, (xsp+0)
      adc    wa, (xsp+0)
      adc    bc, (xsp+0)
      adc    de, (xsp+0)
      adc    hl, (xsp+0)
      adc    ix, (xsp+0)
      adc    iy, (xsp+0)
      adc    iz, (xsp+0)
      adc    sp, (xsp+0)
      sub    wa, (xsp+0)
      sub    bc, (xsp+0)
      sub    de, (xsp+0)
      sub    hl, (xsp+0)
      sub    ix, (xsp+0)
      sub    iy, (xsp+0)
      sub    iz, (xsp+0)
      sub    sp, (xsp+0)
      sbc    wa, (xsp+0)
      sbc    bc, (xsp+0)
      sbc    de, (xsp+0)
      sbc    hl, (xsp+0)
      sbc    ix, (xsp+0)
      sbc    iy, (xsp+0)
      sbc    iz, (xsp+0)
      sbc    sp, (xsp+0)
      and    wa, (xsp+0)
      and    bc, (xsp+0)
      and    de, (xsp+0)
      and    hl, (xsp+0)
      and    ix, (xsp+0)
      and    iy, (xsp+0)
      and    iz, (xsp+0)
      and    sp, (xsp+0)
      xor    wa, (xsp+0)
      xor    bc, (xsp+0)
      xor    de, (xsp+0)
      xor    hl, (xsp+0)
      xor    ix, (xsp+0)
      xor    iy, (xsp+0)
      xor    iz, (xsp+0)
      xor    sp, (xsp+0)
      or     wa, (xsp+0)
      or     bc, (xsp+0)
      or     de, (xsp+0)
      or     hl, (xsp+0)
      or     ix, (xsp+0)
      or     iy, (xsp+0)
      or     iz, (xsp+0)
      or     sp, (xsp+0)
      cp     wa, (xsp+0)
      cp     bc, (xsp+0)
      cp     de, (xsp+0)
      cp     hl, (xsp+0)
      cp     ix, (xsp+0)
      cp     iy, (xsp+0)
      cp     iz, (xsp+0)
      cp     sp, (xsp+0)
      sub    xiy, (xix)
      sub    xiz, (xix)
      sub    xsp, (xix)
      sbc    xix, (xix)
      sbc    xiy, (xix)
      sbc    xiz, (xix)
      sbc    xsp, (xix)
      and    xix, (xix)
      and    xiy, (xix)
      and    xiz, (xix)
      and    xsp, (xix)
      xor    xix, (xix)
      xor    xiy, (xix)
      xor    xiz, (xix)
      xor    xsp, (xix)
      or     xix, (xix)
      or     xiy, (xix)
      or     xiz, (xix)
      or     xsp, (xix)
      cp     xix, (xix)
      cp     xiy, (xix)
      cp     xiz, (xix)
      cp     xsp, (xix)
      ld     xix, (xix)
      ld     xiy, (xix)
      ld     xiz, (xix)
      ld     xsp, (xix)
      ex     xix, (xix)
      ex     xiy, (xix)
      ex     xiz, (xix)
      ex     xsp, (xix)
      add    xix, (xix)
      add    xiy, (xix)
      add    xiz, (xix)
      add    xsp, (xix)
      adc    xix, (xix)
      adc    xiy, (xix)
      adc    xiz, (xix)
      adc    xsp, (xix)
      sub    xix, (xix)
      sub    xiz, (xiy)
      sub    xsp, (xiy)
      sbc    xix, (xiy)
      sbc    xiy, (xiy)
      sbc    xiz, (xiy)
      sbc    xsp, (xiy)
      and    xix, (xiy)
      and    xiy, (xiy)
      and    xiz, (xiy)
      and    xsp, (xiy)
      xor    xix, (xiy)
      xor    xiy, (xiy)
      xor    xiz, (xiy)
      xor    xsp, (xiy)
      or     xix, (xiy)
      or     xiy, (xiy)
      or     xiz, (xiy)
      or     xsp, (xiy)
      cp     xix, (xiy)
      cp     xiy, (xiy)
      cp     xiz, (xiy)
      cp     xsp, (xiy)
      ld     xix, (xiy)
      ld     xiy, (xiy)
      ld     xiz, (xiy)
      ld     xsp, (xiy)
      ex     xix, (xiy)
      ex     xiy, (xiy)
      ex     xiz, (xiy)
      ex     xsp, (xiy)
      add    xix, (xiy)
      add    xiy, (xiy)
      add    xiz, (xiy)
      add    xsp, (xiy)
      adc    xix, (xiy)
      adc    xiy, (xiy)
      adc    xiz, (xiy)
      adc    xsp, (xiy)
      sub    xix, (xiy)
      sub    xiy, (xiy)
      sub    xsp, (xiz)
      sbc    xix, (xiz)
      sbc    xiy, (xiz)
      sbc    xiz, (xiz)
      sbc    xsp, (xiz)
      and    xix, (xiz)
      and    xiy, (xiz)
      and    xiz, (xiz)
      and    xsp, (xiz)
      xor    xix, (xiz)
      xor    xiy, (xiz)
      xor    xiz, (xiz)
      xor    xsp, (xiz)
      or     xix, (xiz)
      or     xiy, (xiz)
      or     xiz, (xiz)
      or     xsp, (xiz)
      cp     xix, (xiz)
      cp     xiy, (xiz)
      cp     xiz, (xiz)
      cp     xsp, (xiz)
      ld     xix, (xiz)
      ld     xiy, (xiz)
      ld     xiz, (xiz)
      ld     xsp, (xiz)
      ex     xix, (xiz)
      ex     xiy, (xiz)
      ex     xiz, (xiz)
      ex     xsp, (xiz)
      add    xix, (xiz)
      add    xiy, (xiz)
      add    xiz, (xiz)
      add    xsp, (xiz)
      adc    xix, (xiz)
      adc    xiy, (xiz)
      adc    xiz, (xiz)
      adc    xsp, (xiz)
      sub    xix, (xiz)
      sub    xiy, (xiz)
      sub    xiz, (xiz)
      sbc    xix, (xsp)
      sbc    xiy, (xsp)
      sbc    xiz, (xsp)
      sbc    xsp, (xsp)
      and    xix, (xsp)
      and    xiy, (xsp)
      and    xiz, (xsp)
      and    xsp, (xsp)
      xor    xix, (xsp)
      xor    xiy, (xsp)
      xor    xiz, (xsp)
      xor    xsp, (xsp)
      or     xix, (xsp)
      or     xiy, (xsp)
      or     xiz, (xsp)
      or     xsp, (xsp)
      cp     xix, (xsp)
      cp     xiy, (xsp)
      cp     xiz, (xsp)
      cp     xsp, (xsp)
      ld     xix, (xsp)
      ld     xiy, (xsp)
      ld     xiz, (xsp)
      ld     xsp, (xsp)
      ex     xix, (xsp)
      ex     xiy, (xsp)
      ex     xiz, (xsp)
      ex     xsp, (xsp)
      add    xix, (xsp)
      add    xiy, (xsp)
      add    xiz, (xsp)
      add    xsp, (xsp)
      adc    xix, (xsp)
      adc    xiy, (xsp)
      adc    xiz, (xsp)
      adc    xsp, (xsp)
      sub    xix, (xsp)
      sub    xiy, (xsp)
      sub    xiz, (xsp)
      sub    xsp, (xsp)
      sbc    xix, (xix-53H)
      sbc    xiy, (xix-53H)
      sbc    xiz, (xix-53H)
      sbc    xsp, (xix-53H)
      and    xix, (xix-53H)
      and    xiy, (xix-53H)
      and    xiz, (xix-53H)
      and    xsp, (xix-53H)
      xor    xix, (xix-53H)
      xor    xiy, (xix-53H)
      xor    xiz, (xix-53H)
      xor    xsp, (xix-53H)
      or     xix, (xix-53H)
      or     xiy, (xix-53H)
      or     xiz, (xix-53H)
      or     xsp, (xix-53H)
      cp     xix, (xix-17)
      cp     xiy, (xix-17)
      cp     xiz, (xix-17)
      cp     xsp, (xix-17)
      ld     xix, (xix-17)
      ld     xiy, (xix-17)
      ld     xiz, (xix-17)
      ld     xsp, (xix-17)
      ex     xix, (xix-17)
      ex     xiy, (xix-17)
      ex     xiz, (xix-17)
      ex     xsp, (xix-17)
      ld     xix, (xix+0)
      ld     xiy, (xix+0)
      ld     xiz, (xix+0)
      ld     xsp, (xix+0)
      ex     xix, (xix+0)
      ex     xiy, (xix+0)
      ex     xiz, (xix+0)
      ex     xsp, (xix+0)
      add    xix, (xix+3FH)
      add    xiy, (xix+3FH)
      add    xiz, (xix+3FH)
      add    xsp, (xix+3FH)
      adc    xix, (xix+3FH)
      adc    xiy, (xix+3FH)
      adc    xiz, (xix+3FH)
      adc    xsp, (xix+3FH)
      sub    xix, (xix+3FH)
      sub    xiy, (xix+3FH)
      sub    xiz, (xix+3FH)
      sub    xsp, (xix+3FH)
      sbc    xix, (xix+3FH)
      sbc    xiy, (xix+3FH)
      sbc    xiz, (xix+3FH)
      sbc    xsp, (xix+3FH)
      and    xix, (xix+3FH)
      and    xiy, (xix+3FH)
      and    xiz, (xix+3FH)
      and    xsp, (xix+3FH)
      xor    xix, (xix+3FH)
      xor    xiy, (xix+3FH)
      xor    xiz, (xix+3FH)
      xor    xsp, (xix+3FH)
      or     xix, (xix+3FH)
      or     xiy, (xix+3FH)
      or     xiz, (xix+3FH)
      or     xsp, (xix+3FH)
      add    xix, (xix-80H)
      add    xiy, (xix-80H)
      add    xiz, (xix-80H)
      add    xsp, (xix-80H)
      adc    xix, (xix-80H)
      adc    xiy, (xix-80H)
      adc    xiz, (xix-80H)
      adc    xsp, (xix-80H)
      sub    xix, (xix-80H)
      sub    xiy, (xix-80H)
      sub    xiz, (xix-80H)
      sub    xsp, (xix-80H)
      sbc    xix, (xiy-52H)
      sbc    xiy, (xiy-52H)
      sbc    xiz, (xiy-52H)
      sbc    xsp, (xiy-52H)
      and    xix, (xiy-52H)
      and    xiy, (xiy-52H)
      and    xiz, (xiy-52H)
      and    xsp, (xiy-52H)
      xor    xix, (xiy-52H)
      xor    xiy, (xiy-52H)
      xor    xiz, (xiy-52H)
      xor    xsp, (xiy-52H)
      or     xix, (xiy-52H)
      or     xiy, (xiy-52H)
      or     xiz, (xiy-52H)
      or     xsp, (xiy-52H)
      cp     xix, (xiy-17)
      cp     xiy, (xiy-17)
      cp     xiz, (xiy-17)
      cp     xsp, (xiy-17)
      ld     xix, (xiy-17)
      ld     xiy, (xiy-17)
      ld     xiz, (xiy-17)
      ld     xsp, (xiy-17)
      ex     xix, (xiy-17)
      ex     xiy, (xiy-17)
      ex     xiz, (xiy-17)
      ex     xsp, (xiy-17)
      ld     xix, (xiy+0)
      ld     xiy, (xiy+0)
      ld     xiz, (xiy+0)
      ld     xsp, (xiy+0)
      ex     xix, (xiy+0)
      ex     xiy, (xiy+0)
      ex     xiz, (xiy+0)
      ex     xsp, (xiy+0)
      add    xix, (xiy+3FH)
      add    xiy, (xiy+3FH)
      add    xiz, (xiy+3FH)
      add    xsp, (xiy+3FH)
      adc    xix, (xiy+3FH)
      adc    xiy, (xiy+3FH)
      adc    xiz, (xiy+3FH)
      adc    xsp, (xiy+3FH)
      sub    xix, (xiy+3FH)
      sub    xiy, (xiy+3FH)
      sub    xiz, (xiy+3FH)
      sub    xsp, (xiy+3FH)
      sbc    xix, (xiy+3FH)
      sbc    xiy, (xiy+3FH)
      sbc    xiz, (xiy+3FH)
      sbc    xsp, (xiy+3FH)
      and    xix, (xiy+3FH)
      and    xiy, (xiy+3FH)
      and    xiz, (xiy+3FH)
      and    xsp, (xiy+3FH)
      xor    xix, (xiy+3FH)
      xor    xiy, (xiy+3FH)
      xor    xiz, (xiy+3FH)
      xor    xsp, (xiy+3FH)
      or     xix, (xiy+3FH)
      or     xiy, (xiy+3FH)
      or     xiz, (xiy+3FH)
      or     xsp, (xiy+3FH)
      add    xix, (xiy-80H)
      add    xiy, (xiy-80H)
      add    xiz, (xiy-80H)
      add    xsp, (xiy-80H)
      adc    xix, (xiy-80H)
      adc    xiy, (xiy-80H)
      adc    xiz, (xiy-80H)
      adc    xsp, (xiy-80H)
      sub    xix, (xiy-80H)
      sub    xiy, (xiy-80H)
      sub    xiz, (xiy-80H)
      sub    xsp, (xiy-80H)
      sbc    xix, (xiz-51H)
      sbc    xiy, (xiz-51H)
      sbc    xiz, (xiz-51H)
      sbc    xsp, (xiz-51H)
      and    xix, (xiz-51H)
      and    xiy, (xiz-51H)
      and    xiz, (xiz-51H)
      and    xsp, (xiz-51H)
      xor    xix, (xiz-51H)
      xor    xiy, (xiz-51H)
      xor    xiz, (xiz-51H)
      xor    xsp, (xiz-51H)
      or     xix, (xiz-51H)
      or     xiy, (xiz-51H)
      or     xiz, (xiz-51H)
      or     xsp, (xiz-51H)
      cp     xix, (xiz-17)
      cp     xiy, (xiz-17)
      cp     xiz, (xiz-17)
      cp     xsp, (xiz-17)
      ld     xix, (xiz-17)
      ld     xiy, (xiz-17)
      ld     xiz, (xiz-17)
      ld     xsp, (xiz-17)
      ex     xix, (xiz-17)
      ex     xiy, (xiz-17)
      ex     xiz, (xiz-17)
      ex     xsp, (xiz-17)
      ld     xix, (xiz+0)
      ld     xiy, (xiz+0)
      ld     xiz, (xiz+0)
      ld     xsp, (xiz+0)
      ex     xix, (xiz+0)
      ex     xiy, (xiz+0)
      ex     xiz, (xiz+0)
      ex     xsp, (xiz+0)
      add    xix, (xiz+3FH)
      add    xiy, (xiz+3FH)
      add    xiz, (xiz+3FH)
      add    xsp, (xiz+3FH)
      adc    xix, (xiz+3FH)
      adc    xiy, (xiz+3FH)
      adc    xiz, (xiz+3FH)
      adc    xsp, (xiz+3FH)
      sub    xix, (xiz+3FH)
      sub    xiy, (xiz+3FH)
      sub    xiz, (xiz+3FH)
      sub    xsp, (xiz+3FH)
      sbc    xix, (xiz+3FH)
      sbc    xiy, (xiz+3FH)
      sbc    xiz, (xiz+3FH)
      sbc    xsp, (xiz+3FH)
      and    xix, (xiz+3FH)
      and    xiy, (xiz+3FH)
      and    xiz, (xiz+3FH)
      and    xsp, (xiz+3FH)
      xor    xix, (xiz+3FH)
      xor    xiy, (xiz+3FH)
      xor    xiz, (xiz+3FH)
      xor    xsp, (xiz+3FH)
      or     xix, (xiz+3FH)
      or     xiy, (xiz+3FH)
      or     xiz, (xiz+3FH)
      or     xsp, (xiz+3FH)
      add    xix, (xiz-80H)
      add    xiy, (xiz-80H)
      add    xiz, (xiz-80H)
      add    xsp, (xiz-80H)
      adc    xix, (xiz-80H)
      adc    xiy, (xiz-80H)
      adc    xiz, (xiz-80H)
      adc    xsp, (xiz-80H)
      sub    xix, (xiz-80H)
      sub    xiy, (xiz-80H)
      sub    xiz, (xiz-80H)
      sub    xsp, (xiz-80H)
      sbc    xix, (xsp-50H)
      sbc    xiy, (xsp-50H)
      sbc    xiz, (xsp-50H)
      sbc    xsp, (xsp-50H)
      and    xix, (xsp-50H)
      and    xiy, (xsp-50H)
      and    xiz, (xsp-50H)
      and    xsp, (xsp-50H)
      xor    xix, (xsp-50H)
      xor    xiy, (xsp-50H)
      xor    xiz, (xsp-50H)
      xor    xsp, (xsp-50H)
      or     xix, (xsp-50H)
      or     xiy, (xsp-50H)
      or     xiz, (xsp-50H)
      or     xsp, (xsp-50H)
      cp     xix, (xsp-17)
      cp     xiy, (xsp-17)
      cp     xiz, (xsp-17)
      cp     xsp, (xsp-17)
      ld     xix, (xsp-17)
      ld     xiy, (xsp-17)
      ld     xiz, (xsp-17)
      ld     xsp, (xsp-17)
      ex     xix, (xsp-17)
      ex     xiy, (xsp-17)
      ex     xiz, (xsp-17)
      ex     xsp, (xsp-17)
      ld     xix, (xsp+0)
      ld     xiy, (xsp+0)
      ld     xiz, (xsp+0)
      ld     xsp, (xsp+0)
      ex     xix, (xsp+0)
      ex     xiy, (xsp+0)
      ex     xiz, (xsp+0)
      ex     xsp, (xsp+0)
      add    xix, (xsp+3FH)
      add    xiy, (xsp+3FH)
      add    xiz, (xsp+3FH)
      add    xsp, (xsp+3FH)
      adc    xix, (xsp+3FH)
      adc    xiy, (xsp+3FH)
      adc    xiz, (xsp+3FH)
      adc    xsp, (xsp+3FH)
      sub    xix, (xsp+3FH)
      sub    xiy, (xsp+3FH)
      sub    xiz, (xsp+3FH)
      sub    xsp, (xsp+3FH)
      sbc    xix, (xsp+3FH)
      sbc    xiy, (xsp+3FH)
      sbc    xiz, (xsp+3FH)
      sbc    xsp, (xsp+3FH)
      and    xix, (xsp+3FH)
      and    xiy, (xsp+3FH)
      and    xiz, (xsp+3FH)
      and    xsp, (xsp+3FH)
      xor    xix, (xsp+3FH)
      xor    xiy, (xsp+3FH)
      xor    xiz, (xsp+3FH)
      xor    xsp, (xsp+3FH)
      or     xix, (xsp+3FH)
      or     xiy, (xsp+3FH)
      or     xiz, (xsp+3FH)
      or     xsp, (xsp+3FH)
      add    xix, (xsp-80H)
      add    xiy, (xsp-80H)
      add    xiz, (xsp-80H)
      add    xsp, (xsp-80H)
      adc    xix, (xsp-80H)
      adc    xiy, (xsp-80H)
      adc    xiz, (xsp-80H)
      adc    xsp, (xsp-80H)
      sub    xix, (xsp-80H)
      sub    xiy, (xsp-80H)
      sub    xiz, (xsp-80H)
      sub    xsp, (xsp-80H)
      ret    f
      ret    lt
      ret    le
      ret    ule
      ret    ov
      ret    mi
      ret    z
      ret    c
      ret    t
      ret    ge
      ret    gt
      ret    ugt
      ret    nov
      ret    pl
      ret    nz
      ret    nc
