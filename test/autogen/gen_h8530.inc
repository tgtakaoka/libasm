;;; AUTO GENERATED FILE
;;; generated by: gen_h8500 -i -u -C H8/530 -O maximum-mode=on -o gen_h8530.inc -l gen_h8530.lst
      NOP
      LDM      @SP+, (R0-R1)
      LDM      @SP+, (R2)
      LDM      @SP+, (R0,R2)
      LDM      @SP+, (R0-R1,R3)
      LDM      @SP+, (R0,R2-R3)
      LDM      @SP+, (R0,R2,R4)
      LDM      @SP+, (R0-R1,R3-R4)
      LDM      @SP+, (R0-R1,R3,R5)
      LDM      @SP+, (R0,R2-R3,R5)
      LDM      @SP+, (R0,R2,R4-R5)
      LDM      @SP+, (FP)
      LDM      @SP+, (R0,FP)
      LDM      @SP+, (R0-R1,FP)
      LDM      @SP+, (R0,R2,FP)
      LDM      @SP+, (R0-R1,R3,FP)
      LDM      @SP+, (R0,R2-R3,FP)
      LDM      @SP+, (R0,R2,R4,FP)
      LDM      @SP+, (R0-R1,R3-R4,FP)
      LDM      @SP+, (R5-FP)
      LDM      @SP+, (R0,R5-FP)
      LDM      @SP+, (R0-R1,R5-FP)
      LDM      @SP+, (R0,R2,R5-FP)
      LDM      @SP+, (R0-R1,R3,R5-FP)
      LDM      @SP+, (R0,R2-R3,R5-FP)
      LDM      @SP+, (R0,R2,R4,R7)
      LDM      @SP+, (R0-R1,R3-R4,R7)
      LDM      @SP+, (R0-R1,R3,R5,R7)
      LDM      @SP+, (R0,R2-R3,R5,R7)
      LDM      @SP+, (R0,R2,R4-R5,R7)
      LDM      @SP+, (FP-R7)
      LDM      @SP+, (R0,FP-R7)
      LDM      @SP+, (R0-R1,FP-R7)
      LDM      @SP+, (R0,R2,FP-R7)
      LDM      @SP+, (R0-R1,R3,FP-R7)
      LDM      @SP+, (R0,R2-R3,FP-R7)
      LDM      @SP+, (R0,R2,R4,FP-R7)
      LDM      @SP+, (R0-R1,R3-R4,FP-R7)
      LDM      @SP+, (R0-R1,R3,R5-R7)
      LDM      @SP+, (R0,R2-R3,R5-R7)
      PJSR     @0x040506:24
      ADD:G.B  #5, R0
      ADD:G.B  #5, FP
      ADDS.B   #5, R0
      ADDS.B   #5, FP
      SUB.B    #5, R0
      SUB.B    #5, FP
      SUBS.B   #5, R0
      SUBS.B   #5, FP
      OR.B     #5, R0
      OR.B     #5, FP
      ORC.B    #5, CCR
      ORC.B    #5, BR
      ORC.B    #5, EP
      ORC.B    #5, DP
      ORC.B    #5, TP
      AND.B    #5, R0
      AND.B    #5, FP
      ANDC.B   #5, CCR
      ANDC.B   #5, BR
      ANDC.B   #5, EP
      ANDC.B   #5, DP
      ANDC.B   #5, TP
      XOR.B    #5, R0
      XOR.B    #5, FP
      XORC.B   #5, CCR
      XORC.B   #5, BR
      XORC.B   #5, EP
      XORC.B   #5, DP
      XORC.B   #5, TP
      CMP:G.B  #5, R0
      CMP:G.B  #5, FP
      MOV:G.B  #5, R0
      MOV:G.B  #5, FP
      LDC      #5, CCR
      LDC      #5, BR
      LDC      #5, EP
      LDC      #5, DP
      LDC      #5, TP
      ADDX.B   #5, R0
      ADDX.B   #5, FP
      MULXU.B  #5, R0
      MULXU.B  #5, FP
      SUBX.B   #5, R0
      SUBX.B   #5, FP
      DIVXU.B  #5, R0
      DIVXU.B  #5, FP
      ADD:Q.B  #1, @0x06:8
      CLR.B    @0x06:8
      NEG.B    @0x06:8
      NOT.B    @0x06:8
      TST.B    @0x06:8
      TAS      @0x06:8
      SHAL.B   @0x06:8
      SHAR.B   @0x06:8
      SHLL.B   @0x06:8
      SHLR.B   @0x06:8
      ROTL.B   @0x06:8
      ROTR.B   @0x06:8
      ROTXL.B  @0x06:8
      ROTXR.B  @0x06:8
      ADD:G.B  @0x06:8, R0
      ADD:G.B  @0x06:8, FP
      ADDS.B   @0x06:8, R0
      ADDS.B   @0x06:8, FP
      SUB.B    @0x06:8, R0
      SUB.B    @0x06:8, FP
      SUBS.B   @0x06:8, R0
      SUBS.B   @0x06:8, FP
      OR.B     @0x06:8, R0
      OR.B     @0x06:8, FP
      BSET.B   R0, @0x06:8
      BSET.B   FP, @0x06:8
      AND.B    @0x06:8, R0
      AND.B    @0x06:8, FP
      BCLR.B   R0, @0x06:8
      BCLR.B   FP, @0x06:8
      XOR.B    @0x06:8, R0
      XOR.B    @0x06:8, FP
      BNOT.B   R0, @0x06:8
      BNOT.B   FP, @0x06:8
      CMP:G.B  @0x06:8, R0
      CMP:G.B  @0x06:8, FP
      BTST.B   R0, @0x06:8
      BTST.B   FP, @0x06:8
      MOV:G.B  @0x06:8, R0
      MOV:G.B  @0x06:8, FP
      LDC      @0x06:8, CCR
      LDC      @0x06:8, BR
      LDC      @0x06:8, EP
      LDC      @0x06:8, DP
      LDC      @0x06:8, TP
      MOV:G.B  R0, @0x06:8
      MOV:G.B  FP, @0x06:8
      STC      CCR, @0x06:8
      STC      BR, @0x06:8
      STC      EP, @0x06:8
      STC      DP, @0x06:8
      STC      TP, @0x06:8
      ADDX.B   @0x06:8, R0
      ADDX.B   @0x06:8, FP
      MULXU.B  @0x06:8, R0
      MULXU.B  @0x06:8, FP
      SUBX.B   @0x06:8, R0
      SUBX.B   @0x06:8, FP
      DIVXU.B  @0x06:8, R0
      DIVXU.B  @0x06:8, FP
      BSET.B   #0, @0x06:8
      BCLR.B   #0, @0x06:8
      BNOT.B   #0, @0x06:8
      BTST.B   #0, @0x06:8
      MOVFPE   @0x06:8, R0
      MOVFPE   @0x06:8, FP
      MOVTPE   R0, @0x06:8
      MOVTPE   FP, @0x06:8
      CMP:G.B  #5, @0x06:8
      MOV:G.B  #7, @0x06:8
      TRAP/VS
      RTE
      ADD:G.W  #0x0D0E, R0
      ADD:G.W  #0x0D0E, FP
      ADDS.W   #0x0D0E, R0
      ADDS.W   #0x0D0E, FP
      SUB.W    #0x0D0E, R0
      SUB.W    #0x0D0E, FP
      SUBS.W   #0x0D0E, R0
      SUBS.W   #0x0D0E, FP
      OR.W     #0x0D0E, R0
      OR.W     #0x0D0E, FP
      ORC.W    #0x0D0E, SR
      AND.W    #0x0D0E, R0
      AND.W    #0x0D0E, FP
      ANDC.W   #0x0D0E, SR
      XOR.W    #0x0D0E, R0
      XOR.W    #0x0D0E, FP
      XORC.W   #0x0D0E, SR
      CMP:G.W  #0x0D0E, R0
      CMP:G.W  #0x0D0E, FP
      MOV:G.W  #0x0D0E, R0
      MOV:G.W  #0x0D0E, FP
      LDC      #0x0D0E, SR
      ADDX.W   #0x0D0E, R0
      ADDX.W   #0x0D0E, FP
      MULXU.W  #0x0D0E, R0
      MULXU.W  #0x0D0E, FP
      SUBX.W   #0x0D0E, R0
      SUBX.W   #0x0D0E, FP
      DIVXU.W  #0x0D0E, R0
      DIVXU.W  #0x0D0E, FP
      CLR.W    @0x0E:8
      NEG.W    @0x0E:8
      NOT.W    @0x0E:8
      TST.W    @0x0E:8
      SHAL.W   @0x0E:8
      SHAR.W   @0x0E:8
      SHLL.W   @0x0E:8
      SHLR.W   @0x0E:8
      ROTL.W   @0x0E:8
      ROTR.W   @0x0E:8
      ROTXL.W  @0x0E:8
      ROTXR.W  @0x0E:8
      ADD:G.W  @0x0E:8, R0
      ADD:G.W  @0x0E:8, FP
      ADDS.W   @0x0E:8, R0
      ADDS.W   @0x0E:8, FP
      SUB.W    @0x0E:8, R0
      SUB.W    @0x0E:8, FP
      SUBS.W   @0x0E:8, R0
      SUBS.W   @0x0E:8, FP
      OR.W     @0x0E:8, R0
      OR.W     @0x0E:8, FP
      BSET.W   R0, @0x0E:8
      BSET.W   FP, @0x0E:8
      AND.W    @0x0E:8, R0
      AND.W    @0x0E:8, FP
      BCLR.W   R0, @0x0E:8
      BCLR.W   FP, @0x0E:8
      XOR.W    @0x0E:8, R0
      XOR.W    @0x0E:8, FP
      BNOT.W   R0, @0x0E:8
      BNOT.W   FP, @0x0E:8
      CMP:G.W  @0x0E:8, R0
      CMP:G.W  @0x0E:8, FP
      BTST.W   R0, @0x0E:8
      BTST.W   FP, @0x0E:8
      MOV:G.W  @0x0E:8, R0
      MOV:G.W  @0x0E:8, FP
      LDC      @0x0E:8, SR
      MOV:G.W  R0, @0x0E:8
      MOV:G.W  FP, @0x0E:8
      STC      SR, @0x0E:8
      ADDX.W   @0x0E:8, R0
      ADDX.W   @0x0E:8, FP
      MULXU.W  @0x0E:8, R0
      MULXU.W  @0x0E:8, FP
      SUBX.W   @0x0E:8, R0
      SUBX.W   @0x0E:8, FP
      DIVXU.W  @0x0E:8, R0
      DIVXU.W  @0x0E:8, FP
      BSET.W   #0, @0x0E:8
      BCLR.W   #0, @0x0E:8
      BNOT.W   #0, @0x0E:8
      BTST.W   #0, @0x0E:8
      CMP:G.W  #5, @0x0E:8
      CMP:G.W  #0x0607, @0x0E:8
      MOV:G.W  #7, @0x0E:8
      MOV:G.W  #0x0809, @0x0E:8
      ADD:Q.W  #1, @0x0E:8
      BSR      *+17
      UNLK     FP
      JMP      @0x1112:16
      PRTD     #21
      PRTS
      PRTD     #0x1D1E
      PRTD     #1:16
      PJMP     @R0
      PJMP     @FP
      PJSR     @R0
      PJSR     @FP
      JMP      @R0
      JMP      @FP
      JMP      @SP
      JSR      @R0
      JSR      @FP
      JSR      @SP
      JMP      @(-31,R0)
      JMP      @(-25,FP)
      JMP      @(-24,SP)
      JSR      @(-23,R0)
      JSR      @(-17,FP)
      JSR      @(-16,SP)
      JMP      @(-0x0E0E,R0)
      JMP      @(-0x0808,FP)
      JMP      @(-0x0707,SP)
      JSR      @(-0x0606,R0)
      JSR      @(-0x0100,FP)
      JSR      @(1,SP)
      STM      (R0-R1,R4), @-SP
      STM      (R2,R4), @-SP
      STM      (R0,R2,R4), @-SP
      STM      (R3-R4), @-SP
      STM      (R0,R3-R4), @-SP
      STM      (R0-R1,R3-R4), @-SP
      STM      (R5), @-SP
      STM      (R0-R1,R3,R5), @-SP
      STM      (R0,R2-R3,R5), @-SP
      STM      (R0,R2,R4-R5), @-SP
      STM      (FP), @-SP
      STM      (R0,FP), @-SP
      STM      (R0-R1,FP), @-SP
      STM      (R0,R2,FP), @-SP
      STM      (R0-R1,R3,FP), @-SP
      STM      (R0,R2-R3,FP), @-SP
      STM      (R0,R2,R4,FP), @-SP
      STM      (R0-R1,R3-R4,FP), @-SP
      STM      (R5-FP), @-SP
      STM      (R0,R5-FP), @-SP
      STM      (R0-R1,R5-FP), @-SP
      STM      (R0,R2,R5-FP), @-SP
      STM      (R0-R1,R3,R5-FP), @-SP
      STM      (R0,R2-R3,R5-FP), @-SP
      STM      (R0,R2,R4,R7), @-SP
      STM      (R0-R1,R3-R4,R7), @-SP
      STM      (R0-R1,R3,R5,R7), @-SP
      STM      (R0,R2-R3,R5,R7), @-SP
      STM      (R0,R2,R4-R5,R7), @-SP
      STM      (FP-R7), @-SP
      STM      (R0,FP-R7), @-SP
      STM      (R0-R1,FP-R7), @-SP
      STM      (R0,R2,FP-R7), @-SP
      STM      (R0-R1,R3,FP-R7), @-SP
      STM      (R0,R2-R3,FP-R7), @-SP
      STM      (R0,R2,R4,FP-R7), @-SP
      STM      (R0-R1,R3-R4,FP-R7), @-SP
      STM      (R0-R1,R3,R5-R7), @-SP
      STM      (R0,R2-R3,R5-R7), @-SP
      PJMP     @0x000102:24
      RTD      #21
      SHAL.B   @0x1617:16
      SHAR.B   @0x1617:16
      SHLL.B   @0x1617:16
      SHLR.B   @0x1617:16
      ROTL.B   @0x1617:16
      ROTR.B   @0x1617:16
      ROTXL.B  @0x1617:16
      ROTXR.B  @0x1617:16
      ADD:G.B  @0x1617:16, R0
      ADD:G.B  @0x1617:16, FP
      ADDS.B   @0x1617:16, R0
      ADDS.B   @0x1617:16, FP
      SUB.B    @0x1617:16, R0
      SUB.B    @0x1617:16, FP
      SUBS.B   @0x1617:16, R0
      SUBS.B   @0x1617:16, FP
      OR.B     @0x1617:16, R0
      OR.B     @0x1617:16, FP
      BSET.B   R0, @0x1617:16
      BSET.B   FP, @0x1617:16
      AND.B    @0x1617:16, R0
      AND.B    @0x1617:16, FP
      BCLR.B   R0, @0x1617:16
      BCLR.B   FP, @0x1617:16
      XOR.B    @0x1617:16, R0
      XOR.B    @0x1617:16, FP
      BNOT.B   R0, @0x1617:16
      BNOT.B   FP, @0x1617:16
      CMP:G.B  @0x1617:16, R0
      CMP:G.B  @0x1617:16, FP
      BTST.B   R0, @0x1617:16
      BTST.B   FP, @0x1617:16
      MOV:G.B  @0x1617:16, R0
      MOV:G.B  @0x1617:16, FP
      LDC      @0x1617:16, CCR
      LDC      @0x1617:16, BR
      LDC      @0x1617:16, EP
      LDC      @0x1617:16, DP
      LDC      @0x1617:16, TP
      MOV:G.B  R0, @0x1617:16
      MOV:G.B  FP, @0x1617:16
      STC      CCR, @0x1617:16
      STC      BR, @0x1617:16
      STC      EP, @0x1617:16
      STC      DP, @0x1617:16
      STC      TP, @0x1617:16
      ADDX.B   @0x1617:16, R0
      ADDX.B   @0x1617:16, FP
      MULXU.B  @0x1617:16, R0
      MULXU.B  @0x1617:16, FP
      SUBX.B   @0x1617:16, R0
      SUBX.B   @0x1617:16, FP
      DIVXU.B  @0x1617:16, R0
      DIVXU.B  @0x1617:16, FP
      BSET.B   #0, @0x1617:16
      BCLR.B   #0, @0x1617:16
      BNOT.B   #0, @0x1617:16
      BTST.B   #0, @0x1617:16
      MOVFPE   @0x1617:16, R0
      MOVFPE   @0x1617:16, FP
      MOVTPE   R0, @0x1617:16
      MOVTPE   FP, @0x1617:16
      CMP:G.B  #5, @0x1617:16
      MOV:G.B  #7, @0x1617:16
      ADD:Q.B  #1, @0x1617:16
      CLR.B    @0x1617:16
      NEG.B    @0x1617:16
      NOT.B    @0x1617:16
      TST.B    @0x1617:16
      TAS      @0x1617:16
      LINK     FP, #24
      JSR      @0x191A:16
      RTS
      SLEEP
      RTD      #0x1D1E
      RTD      #1:16
      ADD:G.W  @0x1E1F:16, R0
      ADD:G.W  @0x1E1F:16, FP
      ADDS.W   @0x1E1F:16, R0
      ADDS.W   @0x1E1F:16, FP
      SUB.W    @0x1E1F:16, R0
      SUB.W    @0x1E1F:16, FP
      SUBS.W   @0x1E1F:16, R0
      SUBS.W   @0x1E1F:16, FP
      OR.W     @0x1E1F:16, R0
      OR.W     @0x1E1F:16, FP
      BSET.W   R0, @0x1E1F:16
      BSET.W   FP, @0x1E1F:16
      AND.W    @0x1E1F:16, R0
      AND.W    @0x1E1F:16, FP
      BCLR.W   R0, @0x1E1F:16
      BCLR.W   FP, @0x1E1F:16
      XOR.W    @0x1E1F:16, R0
      XOR.W    @0x1E1F:16, FP
      BNOT.W   R0, @0x1E1F:16
      BNOT.W   FP, @0x1E1F:16
      CMP:G.W  @0x1E1F:16, R0
      CMP:G.W  @0x1E1F:16, FP
      BTST.W   R0, @0x1E1F:16
      BTST.W   FP, @0x1E1F:16
      MOV:G.W  @0x1E1F:16, R0
      MOV:G.W  @0x1E1F:16, FP
      LDC      @0x1E1F:16, SR
      MOV:G.W  R0, @0x1E1F:16
      MOV:G.W  FP, @0x1E1F:16
      STC      SR, @0x1E1F:16
      ADDX.W   @0x1E1F:16, R0
      ADDX.W   @0x1E1F:16, FP
      MULXU.W  @0x1E1F:16, R0
      MULXU.W  @0x1E1F:16, FP
      SUBX.W   @0x1E1F:16, R0
      SUBX.W   @0x1E1F:16, FP
      DIVXU.W  @0x1E1F:16, R0
      DIVXU.W  @0x1E1F:16, FP
      BSET.W   #0, @0x1E1F:16
      BCLR.W   #0, @0x1E1F:16
      BNOT.W   #0, @0x1E1F:16
      BTST.W   #0, @0x1E1F:16
      CMP:G.W  #0x0607, @0x0304:16
      MOV:G.W  #0x0809, @0x0506:16
      ADD:Q.W  #1, @0x0506:16
      CLR.W    @0x0506:16
      NEG.W    @0x0506:16
      NOT.W    @0x0506:16
      TST.W    @0x0506:16
      SHAL.W   @0x0506:16
      SHAR.W   @0x0506:16
      SHLL.W   @0x0506:16
      SHLR.W   @0x0506:16
      ROTL.W   @0x0506:16
      ROTR.W   @0x0506:16
      ROTXL.W  @0x0506:16
      ROTXR.W  @0x0506:16
      BSR      *+0x1F23
      LINK     FP, #0x2021
      LINK     FP, #1:16
      BRA      *+35
      BF       *+36
      BHI      *+37
      BLS      *+38
      BCC      *+39
      BCS      *+40
      BNE      *+41
      BEQ      *+42
      BVC      *+43
      BVS      *+44
      BPL      *+45
      BMI      *+46
      BGE      *+47
      BLT      *+48
      BGT      *+49
      BLE      *+50
      BRA      *+0x3135
      BF       *+0x3236
      BHI      *+0x3337
      BLS      *+0x3438
      BCC      *+0x3539
      BCS      *+0x363A
      BNE      *+0x373B
      BEQ      *+0x383C
      BVC      *+0x393D
      BVS      *+0x3A3E
      BPL      *+0x3B3F
      BMI      *+0x3C40
      BGE      *+0x3D41
      BLT      *+0x3E42
      BGT      *+0x3F43
      BLE      *+0x4044
      CMP:E    #0x41, R0
      CMP:E    #0x47, FP
      CMP:I    #0x494A, R0
      CMP:I    #0x4F50, FP
      MOV:E    #0x51, R0
      MOV:E    #0x57, FP
      MOV:I    #0x595A, R0
      MOV:I    #0x5F60, FP
      MOV:L.B  @0x61:8, R0
      MOV:L.B  @0x67:8, FP
      MOV:L.W  @0x69:8, R0
      MOV:L.W  @0x6F:8, FP
      MOV:S.B  R0, @0x71:8
      MOV:S.B  FP, @0x77:8
      MOV:S.W  R0, @0x79:8
      MOV:S.W  FP, @0x7F:8
      MOV:F.B  @(-0x7F,FP), R0
      MOV:F.B  @(-0x79,FP), FP
      MOV:F.W  @(-0x77,FP), R0
      MOV:F.W  @(-0x71,FP), FP
      MOV:F.B  R0, @(-0x6F,FP)
      MOV:F.B  FP, @(-0x69,FP)
      MOV:F.W  R0, @(-0x67,FP)
      MOV:F.W  FP, @(-0x61,FP)
      ADDX.B   R0, R1
      ADDX.B   R0, FP
      MULXU.B  R0, R0
      MULXU.B  R0, FP
      SUBX.B   R0, R0
      SUBX.B   R0, FP
      DIVXU.B  R0, R0
      DIVXU.B  R0, FP
      BSET.B   #0, R0
      BCLR.B   #0, R0
      BNOT.B   #0, R0
      BTST.B   #0, R0
      DADD     R0, R0
      DADD     R0, FP
      DSUB     R0, R0
      DSUB     R0, FP
      ADD:Q.B  #1, R0
      SWAP     R0
      EXTS     R0
      EXTU     R0
      CLR.B    R0
      NEG.B    R0
      NOT.B    R0
      TST.B    R0
      TAS      R0
      SHAL.B   R0
      SHAR.B   R0
      SHLL.B   R0
      SHLR.B   R0
      ROTL.B   R0
      ROTR.B   R0
      ROTXL.B  R0
      ROTXR.B  R0
      ADD:G.B  R0, R0
      ADD:G.B  R0, FP
      ADDS.B   R0, R0
      ADDS.B   R0, FP
      SUB.B    R0, R0
      SUB.B    R0, FP
      SUBS.B   R0, R0
      SUBS.B   R0, FP
      OR.B     R0, R0
      OR.B     R0, FP
      BSET.B   R0, R0
      BSET.B   FP, R0
      AND.B    R0, R0
      AND.B    R0, FP
      BCLR.B   R0, R0
      BCLR.B   FP, R0
      XOR.B    R0, R0
      XOR.B    R0, FP
      BNOT.B   R0, R0
      BNOT.B   FP, R0
      CMP:G.B  R0, R0
      CMP:G.B  R0, FP
      BTST.B   R0, R0
      BTST.B   FP, R0
      MOV:G.B  R0, R0
      MOV:G.B  R0, FP
      LDC      R0, CCR
      LDC      R0, BR
      LDC      R0, EP
      LDC      R0, DP
      LDC      R0, TP
      STC      CCR, R0
      STC      BR, R0
      STC      EP, R0
      STC      DP, R0
      STC      TP, R0
      ADDX.B   FP, R7
      MULXU.B  FP, R0
      MULXU.B  FP, FP
      SUBX.B   FP, R0
      SUBX.B   FP, FP
      DIVXU.B  FP, R0
      DIVXU.B  FP, FP
      BSET.B   #0, FP
      BCLR.B   #0, FP
      BNOT.B   #0, FP
      BTST.B   #0, FP
      DADD     FP, R0
      DADD     FP, FP
      DSUB     FP, R0
      DSUB     FP, FP
      ADD:Q.B  #1, FP
      SWAP     FP
      EXTS     FP
      EXTU     FP
      CLR.B    FP
      NEG.B    FP
      NOT.B    FP
      TST.B    FP
      TAS      FP
      SHAL.B   FP
      SHAR.B   FP
      SHLL.B   FP
      SHLR.B   FP
      ROTL.B   FP
      ROTR.B   FP
      ROTXL.B  FP
      ROTXR.B  FP
      ADD:G.B  FP, R0
      ADD:G.B  FP, FP
      ADDS.B   FP, R0
      ADDS.B   FP, FP
      SUB.B    FP, R0
      SUB.B    FP, FP
      SUBS.B   FP, R0
      SUBS.B   FP, FP
      OR.B     FP, R0
      OR.B     FP, FP
      BSET.B   R0, FP
      BSET.B   FP, FP
      AND.B    FP, R0
      AND.B    FP, FP
      BCLR.B   R0, FP
      BCLR.B   FP, FP
      XOR.B    FP, R0
      XOR.B    FP, FP
      BNOT.B   R0, FP
      BNOT.B   FP, FP
      CMP:G.B  FP, R0
      CMP:G.B  FP, FP
      BTST.B   R0, FP
      BTST.B   FP, FP
      MOV:G.B  FP, R0
      MOV:G.B  FP, FP
      LDC      FP, CCR
      LDC      FP, BR
      LDC      FP, EP
      LDC      FP, DP
      LDC      FP, TP
      STC      CCR, FP
      STC      BR, FP
      STC      EP, FP
      STC      DP, FP
      STC      TP, FP
      ADDX.B   FP, FP
      MULXU.W  R0, R2
      MULXU.W  R0, FP
      SUBX.W   R0, R0
      SUBX.W   R0, FP
      DIVXU.W  R0, R0
      DIVXU.W  R0, FP
      BSET.W   #0, R0
      BCLR.W   #0, R0
      BNOT.W   #0, R0
      BTST.W   #0, R0
      ADD:Q.W  #1, R0
      CLR.W    R0
      NEG.W    R0
      NOT.W    R0
      TST.W    R0
      SHAL.W   R0
      SHAR.W   R0
      SHLL.W   R0
      SHLR.W   R0
      ROTL.W   R0
      ROTR.W   R0
      ROTXL.W  R0
      ROTXR.W  R0
      ADD:G.W  R0, R0
      ADD:G.W  R0, FP
      ADDS.W   R0, R0
      ADDS.W   R0, FP
      SUB.W    R0, R0
      SUB.W    R0, FP
      SUBS.W   R0, R0
      SUBS.W   R0, FP
      OR.W     R0, R0
      OR.W     R0, FP
      BSET.W   R0, R0
      BSET.W   FP, R0
      AND.W    R0, R0
      AND.W    R0, FP
      BCLR.W   R0, R0
      BCLR.W   FP, R0
      XOR.W    R0, R0
      XOR.W    R0, FP
      BNOT.W   R0, R0
      BNOT.W   FP, R0
      CMP:G.W  R0, R0
      CMP:G.W  R0, FP
      BTST.W   R0, R0
      BTST.W   FP, R0
      MOV:G.W  R0, R0
      MOV:G.W  R0, FP
      LDC      R0, SR
      XCH      R0, R0
      XCH      R0, FP
      STC      SR, R0
      ADDX.W   R0, R0
      ADDX.W   R0, FP
      SUBX.W   FP, R0
      SUBX.W   FP, FP
      DIVXU.W  FP, R0
      DIVXU.W  FP, FP
      BSET.W   #0, FP
      BCLR.W   #0, FP
      BNOT.W   #0, FP
      BTST.W   #0, FP
      ADD:Q.W  #1, FP
      CLR.W    FP
      NEG.W    FP
      NOT.W    FP
      TST.W    FP
      SHAL.W   FP
      SHAR.W   FP
      SHLL.W   FP
      SHLR.W   FP
      ROTL.W   FP
      ROTR.W   FP
      ROTXL.W  FP
      ROTXR.W  FP
      ADD:G.W  FP, R0
      ADD:G.W  FP, FP
      ADDS.W   FP, R0
      ADDS.W   FP, FP
      SUB.W    FP, R0
      SUB.W    FP, FP
      SUBS.W   FP, R0
      SUBS.W   FP, FP
      OR.W     FP, R0
      OR.W     FP, FP
      BSET.W   R0, FP
      BSET.W   FP, FP
      AND.W    FP, R0
      AND.W    FP, FP
      BCLR.W   R0, FP
      BCLR.W   FP, FP
      XOR.W    FP, R0
      XOR.W    FP, FP
      BNOT.W   R0, FP
      BNOT.W   FP, FP
      CMP:G.W  FP, R0
      CMP:G.W  FP, FP
      BTST.W   R0, FP
      BTST.W   FP, FP
      MOV:G.W  FP, R0
      MOV:G.W  FP, FP
      LDC      FP, SR
      XCH      FP, R0
      XCH      FP, FP
      STC      SR, FP
      ADDX.W   FP, R0
      ADDX.W   FP, FP
      MULXU.W  FP, R0
      MULXU.W  FP, FP
      SUBX.B   @-R0, R1
      SUBX.B   @-R0, FP
      DIVXU.B  @-R0, R0
      DIVXU.B  @-R0, FP
      BSET.B   #0, @-R0
      BCLR.B   #0, @-R0
      BNOT.B   #0, @-R0
      BTST.B   #0, @-R0
      MOVFPE   @-R0, R0
      MOVFPE   @-R0, FP
      MOVTPE   R0, @-R0
      MOVTPE   FP, @-R0
      CMP:G.B  #5, @-R0
      MOV:G.B  #7, @-R0
      ADD:Q.B  #1, @-R0
      CLR.B    @-R0
      NEG.B    @-R0
      NOT.B    @-R0
      TST.B    @-R0
      TAS      @-R0
      SHAL.B   @-R0
      SHAR.B   @-R0
      SHLL.B   @-R0
      SHLR.B   @-R0
      ROTL.B   @-R0
      ROTR.B   @-R0
      ROTXL.B  @-R0
      ROTXR.B  @-R0
      ADD:G.B  @-R0, R0
      ADD:G.B  @-R0, FP
      ADDS.B   @-R0, R0
      ADDS.B   @-R0, FP
      SUB.B    @-R0, R0
      SUB.B    @-R0, FP
      SUBS.B   @-R0, R0
      SUBS.B   @-R0, FP
      OR.B     @-R0, R0
      OR.B     @-R0, FP
      BSET.B   R0, @-R0
      BSET.B   FP, @-R0
      AND.B    @-R0, R0
      AND.B    @-R0, FP
      BCLR.B   R0, @-R0
      BCLR.B   FP, @-R0
      XOR.B    @-R0, R0
      XOR.B    @-R0, FP
      BNOT.B   R0, @-R0
      BNOT.B   FP, @-R0
      CMP:G.B  @-R0, R0
      CMP:G.B  @-R0, FP
      BTST.B   R0, @-R0
      BTST.B   FP, @-R0
      MOV:G.B  @-R0, R0
      MOV:G.B  @-R0, FP
      LDC      @-R0, CCR
      LDC      @-R0, BR
      LDC      @-R0, EP
      LDC      @-R0, DP
      LDC      @-R0, TP
      MOV:G.B  R0, @-R0
      MOV:G.B  FP, @-R0
      STC      CCR, @-R0
      STC      BR, @-R0
      STC      EP, @-R0
      STC      DP, @-R0
      STC      TP, @-R0
      ADDX.B   @-R0, R0
      ADDX.B   @-R0, FP
      MULXU.B  @-R0, R0
      MULXU.B  @-R0, FP
      SUBX.B   @-FP, R7
      DIVXU.B  @-FP, R0
      DIVXU.B  @-FP, FP
      BSET.B   #0, @-FP
      BCLR.B   #0, @-FP
      BNOT.B   #0, @-FP
      BTST.B   #0, @-FP
      MOVFPE   @-FP, R0
      MOVFPE   @-FP, FP
      MOVTPE   R0, @-FP
      MOVTPE   FP, @-FP
      CMP:G.B  #5, @-FP
      MOV:G.B  #7, @-FP
      ADD:Q.B  #1, @-FP
      CLR.B    @-FP
      NEG.B    @-FP
      NOT.B    @-FP
      TST.B    @-FP
      TAS      @-FP
      SHAL.B   @-FP
      SHAR.B   @-FP
      SHLL.B   @-FP
      SHLR.B   @-FP
      ROTL.B   @-FP
      ROTR.B   @-FP
      ROTXL.B  @-FP
      ROTXR.B  @-FP
      ADD:G.B  @-FP, R0
      ADD:G.B  @-FP, FP
      ADDS.B   @-FP, R0
      ADDS.B   @-FP, FP
      SUB.B    @-FP, R0
      SUB.B    @-FP, FP
      SUBS.B   @-FP, R0
      SUBS.B   @-FP, FP
      OR.B     @-FP, R0
      OR.B     @-FP, FP
      BSET.B   R0, @-FP
      BSET.B   FP, @-FP
      AND.B    @-FP, R0
      AND.B    @-FP, FP
      BCLR.B   R0, @-FP
      BCLR.B   FP, @-FP
      XOR.B    @-FP, R0
      XOR.B    @-FP, FP
      BNOT.B   R0, @-FP
      BNOT.B   FP, @-FP
      CMP:G.B  @-FP, R0
      CMP:G.B  @-FP, FP
      BTST.B   R0, @-FP
      BTST.B   FP, @-FP
      MOV:G.B  @-FP, R0
      MOV:G.B  @-FP, FP
      LDC      @-FP, CCR
      LDC      @-FP, BR
      LDC      @-FP, EP
      LDC      @-FP, DP
      LDC      @-FP, TP
      MOV:G.B  R0, @-FP
      MOV:G.B  FP, @-FP
      STC      CCR, @-FP
      STC      BR, @-FP
      STC      EP, @-FP
      STC      DP, @-FP
      STC      TP, @-FP
      ADDX.B   @-FP, R0
      ADDX.B   @-FP, FP
      MULXU.B  @-FP, R0
      MULXU.B  @-FP, FP
      SUBX.B   @-FP, FP
      DIVXU.B  @-SP, R0
      DIVXU.B  @-SP, FP
      BSET.B   #0, @-SP
      BCLR.B   #0, @-SP
      BNOT.B   #0, @-SP
      BTST.B   #0, @-SP
      MOVFPE   @-SP, R0
      MOVFPE   @-SP, FP
      MOVTPE   R0, @-SP
      MOVTPE   FP, @-SP
      CMP:G.B  #5, @-SP
      MOV:G.B  #7, @-SP
      ADD:Q.B  #1, @-SP
      CLR.B    @-SP
      NEG.B    @-SP
      NOT.B    @-SP
      TST.B    @-SP
      TAS      @-SP
      SHAL.B   @-SP
      SHAR.B   @-SP
      SHLL.B   @-SP
      SHLR.B   @-SP
      ROTL.B   @-SP
      ROTR.B   @-SP
      ROTXL.B  @-SP
      ROTXR.B  @-SP
      ADD:G.B  @-SP, R0
      ADD:G.B  @-SP, FP
      ADDS.B   @-SP, R0
      ADDS.B   @-SP, FP
      SUB.B    @-SP, R0
      SUB.B    @-SP, FP
      SUBS.B   @-SP, R0
      SUBS.B   @-SP, FP
      OR.B     @-SP, R0
      OR.B     @-SP, FP
      BSET.B   R0, @-SP
      BSET.B   FP, @-SP
      AND.B    @-SP, R0
      AND.B    @-SP, FP
      BCLR.B   R0, @-SP
      BCLR.B   FP, @-SP
      XOR.B    @-SP, R0
      XOR.B    @-SP, FP
      BNOT.B   R0, @-SP
      BNOT.B   FP, @-SP
      CMP:G.B  @-SP, R0
      CMP:G.B  @-SP, FP
      BTST.B   R0, @-SP
      BTST.B   FP, @-SP
      MOV:G.B  @-SP, R0
      MOV:G.B  @-SP, FP
      LDC      @-SP, CCR
      LDC      @-SP, BR
      LDC      @-SP, EP
      LDC      @-SP, DP
      LDC      @-SP, TP
      MOV:G.B  R0, @-SP
      MOV:G.B  FP, @-SP
      STC      CCR, @-SP
      STC      BR, @-SP
      STC      EP, @-SP
      STC      DP, @-SP
      STC      TP, @-SP
      ADDX.B   @-SP, R0
      ADDX.B   @-SP, FP
      MULXU.B  @-SP, R0
      MULXU.B  @-SP, FP
      SUBX.B   @-SP, R0
      SUBX.B   @-SP, FP
      DIVXU.W  @-R0, R2
      DIVXU.W  @-R0, FP
      BSET.W   #0, @-R0
      BCLR.W   #0, @-R0
      BNOT.W   #0, @-R0
      BTST.W   #0, @-R0
      CMP:G.W  #5, @-R0
      CMP:G.W  #0x0607, @-R0
      MOV:G.W  #7, @-R0
      MOV:G.W  #0x0809, @-R0
      ADD:Q.W  #1, @-R0
      CLR.W    @-R0
      NEG.W    @-R0
      NOT.W    @-R0
      TST.W    @-R0
      SHAL.W   @-R0
      SHAR.W   @-R0
      SHLL.W   @-R0
      SHLR.W   @-R0
      ROTL.W   @-R0
      ROTR.W   @-R0
      ROTXL.W  @-R0
      ROTXR.W  @-R0
      ADD:G.W  @-R0, R0
      ADD:G.W  @-R0, FP
      ADDS.W   @-R0, R0
      ADDS.W   @-R0, FP
      SUB.W    @-R0, R0
      SUB.W    @-R0, FP
      SUBS.W   @-R0, R0
      SUBS.W   @-R0, FP
      OR.W     @-R0, R0
      OR.W     @-R0, FP
      BSET.W   R0, @-R0
      BSET.W   FP, @-R0
      AND.W    @-R0, R0
      AND.W    @-R0, FP
      BCLR.W   R0, @-R0
      BCLR.W   FP, @-R0
      XOR.W    @-R0, R0
      XOR.W    @-R0, FP
      BNOT.W   R0, @-R0
      BNOT.W   FP, @-R0
      CMP:G.W  @-R0, R0
      CMP:G.W  @-R0, FP
      BTST.W   R0, @-R0
      BTST.W   FP, @-R0
      MOV:G.W  @-R0, R0
      MOV:G.W  @-R0, FP
      LDC      @-R0, SR
      MOV:G.W  R0, @-R0
      MOV:G.W  FP, @-R0
      STC      SR, @-R0
      ADDX.W   @-R0, R0
      ADDX.W   @-R0, FP
      MULXU.W  @-R0, R0
      MULXU.W  @-R0, FP
      SUBX.W   @-R0, R0
      SUBX.W   @-R0, FP
      BSET.W   #0, @-FP
      BCLR.W   #0, @-FP
      BNOT.W   #0, @-FP
      BTST.W   #0, @-FP
      CMP:G.W  #5, @-FP
      CMP:G.W  #0x0607, @-FP
      MOV:G.W  #7, @-FP
      MOV:G.W  #0x0809, @-FP
      ADD:Q.W  #1, @-FP
      CLR.W    @-FP
      NEG.W    @-FP
      NOT.W    @-FP
      TST.W    @-FP
      SHAL.W   @-FP
      SHAR.W   @-FP
      SHLL.W   @-FP
      SHLR.W   @-FP
      ROTL.W   @-FP
      ROTR.W   @-FP
      ROTXL.W  @-FP
      ROTXR.W  @-FP
      ADD:G.W  @-FP, R0
      ADD:G.W  @-FP, FP
      ADDS.W   @-FP, R0
      ADDS.W   @-FP, FP
      SUB.W    @-FP, R0
      SUB.W    @-FP, FP
      SUBS.W   @-FP, R0
      SUBS.W   @-FP, FP
      OR.W     @-FP, R0
      OR.W     @-FP, FP
      BSET.W   R0, @-FP
      BSET.W   FP, @-FP
      AND.W    @-FP, R0
      AND.W    @-FP, FP
      BCLR.W   R0, @-FP
      BCLR.W   FP, @-FP
      XOR.W    @-FP, R0
      XOR.W    @-FP, FP
      BNOT.W   R0, @-FP
      BNOT.W   FP, @-FP
      CMP:G.W  @-FP, R0
      CMP:G.W  @-FP, FP
      BTST.W   R0, @-FP
      BTST.W   FP, @-FP
      MOV:G.W  @-FP, R0
      MOV:G.W  @-FP, FP
      LDC      @-FP, SR
      MOV:G.W  R0, @-FP
      MOV:G.W  FP, @-FP
      STC      SR, @-FP
      ADDX.W   @-FP, R0
      ADDX.W   @-FP, FP
      MULXU.W  @-FP, R0
      MULXU.W  @-FP, FP
      SUBX.W   @-FP, R0
      SUBX.W   @-FP, FP
      DIVXU.W  @-FP, R0
      DIVXU.W  @-FP, FP
      BSET.W   #0, @-SP
      BCLR.W   #0, @-SP
      BNOT.W   #0, @-SP
      BTST.W   #0, @-SP
      CMP:G.W  #5, @-SP
      CMP:G.W  #0x0607, @-SP
      MOV:G.W  #7, @-SP
      MOV:G.W  #0x0809, @-SP
      ADD:Q.W  #1, @-SP
      CLR.W    @-SP
      NEG.W    @-SP
      NOT.W    @-SP
      TST.W    @-SP
      SHAL.W   @-SP
      SHAR.W   @-SP
      SHLL.W   @-SP
      SHLR.W   @-SP
      ROTL.W   @-SP
      ROTR.W   @-SP
      ROTXL.W  @-SP
      ROTXR.W  @-SP
      ADD:G.W  @-SP, R0
      ADD:G.W  @-SP, FP
      ADDS.W   @-SP, R0
      ADDS.W   @-SP, FP
      SUB.W    @-SP, R0
      SUB.W    @-SP, FP
      SUBS.W   @-SP, R0
      SUBS.W   @-SP, FP
      OR.W     @-SP, R0
      OR.W     @-SP, FP
      BSET.W   R0, @-SP
      BSET.W   FP, @-SP
      AND.W    @-SP, R0
      AND.W    @-SP, FP
      BCLR.W   R0, @-SP
      BCLR.W   FP, @-SP
      XOR.W    @-SP, R0
      XOR.W    @-SP, FP
      BNOT.W   R0, @-SP
      BNOT.W   FP, @-SP
      CMP:G.W  @-SP, R0
      CMP:G.W  @-SP, FP
      BTST.W   R0, @-SP
      BTST.W   FP, @-SP
      MOV:G.W  @-SP, R0
      MOV:G.W  @-SP, FP
      LDC      @-SP, SR
      MOV:G.W  R0, @-SP
      MOV:G.W  FP, @-SP
      STC      SR, @-SP
      ADDX.W   @-SP, R0
      ADDX.W   @-SP, FP
      MULXU.W  @-SP, R0
      MULXU.W  @-SP, FP
      SUBX.W   @-SP, R0
      SUBX.W   @-SP, FP
      DIVXU.W  @-SP, R0
      DIVXU.W  @-SP, FP
      BSET.B   #1, @R0+
      BCLR.B   #0, @R0+
      BNOT.B   #0, @R0+
      BTST.B   #0, @R0+
      MOVFPE   @R0+, R0
      MOVFPE   @R0+, FP
      MOVTPE   R0, @R0+
      MOVTPE   FP, @R0+
      CMP:G.B  #5, @R0+
      MOV:G.B  #7, @R0+
      ADD:Q.B  #1, @R0+
      CLR.B    @R0+
      NEG.B    @R0+
      NOT.B    @R0+
      TST.B    @R0+
      TAS      @R0+
      SHAL.B   @R0+
      SHAR.B   @R0+
      SHLL.B   @R0+
      SHLR.B   @R0+
      ROTL.B   @R0+
      ROTR.B   @R0+
      ROTXL.B  @R0+
      ROTXR.B  @R0+
      ADD:G.B  @R0+, R0
      ADD:G.B  @R0+, FP
      ADDS.B   @R0+, R0
      ADDS.B   @R0+, FP
      SUB.B    @R0+, R0
      SUB.B    @R0+, FP
      SUBS.B   @R0+, R0
      SUBS.B   @R0+, FP
      OR.B     @R0+, R0
      OR.B     @R0+, FP
      BSET.B   R0, @R0+
      BSET.B   FP, @R0+
      AND.B    @R0+, R0
      AND.B    @R0+, FP
      BCLR.B   R0, @R0+
      BCLR.B   FP, @R0+
      XOR.B    @R0+, R0
      XOR.B    @R0+, FP
      BNOT.B   R0, @R0+
      BNOT.B   FP, @R0+
      CMP:G.B  @R0+, R0
      CMP:G.B  @R0+, FP
      BTST.B   R0, @R0+
      BTST.B   FP, @R0+
      MOV:G.B  @R0+, R0
      MOV:G.B  @R0+, FP
      LDC      @R0+, CCR
      LDC      @R0+, BR
      LDC      @R0+, EP
      LDC      @R0+, DP
      LDC      @R0+, TP
      MOV:G.B  R0, @R0+
      MOV:G.B  FP, @R0+
      STC      CCR, @R0+
      STC      BR, @R0+
      STC      EP, @R0+
      STC      DP, @R0+
      STC      TP, @R0+
      ADDX.B   @R0+, R0
      ADDX.B   @R0+, FP
      MULXU.B  @R0+, R0
      MULXU.B  @R0+, FP
      SUBX.B   @R0+, R0
      SUBX.B   @R0+, FP
      DIVXU.B  @R0+, R0
      DIVXU.B  @R0+, FP
      BSET.B   #7, @FP+
      BCLR.B   #0, @FP+
      BNOT.B   #0, @FP+
      BTST.B   #0, @FP+
      MOVFPE   @FP+, R0
      MOVFPE   @FP+, FP
      MOVTPE   R0, @FP+
      MOVTPE   FP, @FP+
      CMP:G.B  #5, @FP+
      MOV:G.B  #7, @FP+
      ADD:Q.B  #1, @FP+
      CLR.B    @FP+
      NEG.B    @FP+
      NOT.B    @FP+
      TST.B    @FP+
      TAS      @FP+
      SHAL.B   @FP+
      SHAR.B   @FP+
      SHLL.B   @FP+
      SHLR.B   @FP+
      ROTL.B   @FP+
      ROTR.B   @FP+
      ROTXL.B  @FP+
      ROTXR.B  @FP+
      ADD:G.B  @FP+, R0
      ADD:G.B  @FP+, FP
      ADDS.B   @FP+, R0
      ADDS.B   @FP+, FP
      SUB.B    @FP+, R0
      SUB.B    @FP+, FP
      SUBS.B   @FP+, R0
      SUBS.B   @FP+, FP
      OR.B     @FP+, R0
      OR.B     @FP+, FP
      BSET.B   R0, @FP+
      BSET.B   FP, @FP+
      AND.B    @FP+, R0
      AND.B    @FP+, FP
      BCLR.B   R0, @FP+
      BCLR.B   FP, @FP+
      XOR.B    @FP+, R0
      XOR.B    @FP+, FP
      BNOT.B   R0, @FP+
      BNOT.B   FP, @FP+
      CMP:G.B  @FP+, R0
      CMP:G.B  @FP+, FP
      BTST.B   R0, @FP+
      BTST.B   FP, @FP+
      MOV:G.B  @FP+, R0
      MOV:G.B  @FP+, FP
      LDC      @FP+, CCR
      LDC      @FP+, BR
      LDC      @FP+, EP
      LDC      @FP+, DP
      LDC      @FP+, TP
      MOV:G.B  R0, @FP+
      MOV:G.B  FP, @FP+
      STC      CCR, @FP+
      STC      BR, @FP+
      STC      EP, @FP+
      STC      DP, @FP+
      STC      TP, @FP+
      ADDX.B   @FP+, R0
      ADDX.B   @FP+, FP
      MULXU.B  @FP+, R0
      MULXU.B  @FP+, FP
      SUBX.B   @FP+, R0
      SUBX.B   @FP+, FP
      DIVXU.B  @FP+, R0
      DIVXU.B  @FP+, FP
      BCLR.B   #0, @SP+
      BNOT.B   #0, @SP+
      BTST.B   #0, @SP+
      MOVFPE   @SP+, R0
      MOVFPE   @SP+, FP
      MOVTPE   R0, @SP+
      MOVTPE   FP, @SP+
      CMP:G.B  #5, @SP+
      MOV:G.B  #7, @SP+
      ADD:Q.B  #1, @SP+
      CLR.B    @SP+
      NEG.B    @SP+
      NOT.B    @SP+
      TST.B    @SP+
      TAS      @SP+
      SHAL.B   @SP+
      SHAR.B   @SP+
      SHLL.B   @SP+
      SHLR.B   @SP+
      ROTL.B   @SP+
      ROTR.B   @SP+
      ROTXL.B  @SP+
      ROTXR.B  @SP+
      ADD:G.B  @SP+, R0
      ADD:G.B  @SP+, FP
      ADDS.B   @SP+, R0
      ADDS.B   @SP+, FP
      SUB.B    @SP+, R0
      SUB.B    @SP+, FP
      SUBS.B   @SP+, R0
      SUBS.B   @SP+, FP
      OR.B     @SP+, R0
      OR.B     @SP+, FP
      BSET.B   R0, @SP+
      BSET.B   FP, @SP+
      AND.B    @SP+, R0
      AND.B    @SP+, FP
      BCLR.B   R0, @SP+
      BCLR.B   FP, @SP+
      XOR.B    @SP+, R0
      XOR.B    @SP+, FP
      BNOT.B   R0, @SP+
      BNOT.B   FP, @SP+
      CMP:G.B  @SP+, R0
      CMP:G.B  @SP+, FP
      BTST.B   R0, @SP+
      BTST.B   FP, @SP+
      MOV:G.B  @SP+, R0
      MOV:G.B  @SP+, FP
      LDC      @SP+, CCR
      LDC      @SP+, BR
      LDC      @SP+, EP
      LDC      @SP+, DP
      LDC      @SP+, TP
      MOV:G.B  R0, @SP+
      MOV:G.B  FP, @SP+
      STC      CCR, @SP+
      STC      BR, @SP+
      STC      EP, @SP+
      STC      DP, @SP+
      STC      TP, @SP+
      ADDX.B   @SP+, R0
      ADDX.B   @SP+, FP
      MULXU.B  @SP+, R0
      MULXU.B  @SP+, FP
      SUBX.B   @SP+, R0
      SUBX.B   @SP+, FP
      DIVXU.B  @SP+, R0
      DIVXU.B  @SP+, FP
      BSET.B   #0, @SP+
      BSET.W   #9, @R0+
      BCLR.W   #0, @R0+
      BNOT.W   #0, @R0+
      BTST.W   #0, @R0+
      CMP:G.W  #5, @R0+
      CMP:G.W  #0x0607, @R0+
      MOV:G.W  #7, @R0+
      MOV:G.W  #0x0809, @R0+
      ADD:Q.W  #1, @R0+
      CLR.W    @R0+
      NEG.W    @R0+
      NOT.W    @R0+
      TST.W    @R0+
      SHAL.W   @R0+
      SHAR.W   @R0+
      SHLL.W   @R0+
      SHLR.W   @R0+
      ROTL.W   @R0+
      ROTR.W   @R0+
      ROTXL.W  @R0+
      ROTXR.W  @R0+
      ADD:G.W  @R0+, R0
      ADD:G.W  @R0+, FP
      ADDS.W   @R0+, R0
      ADDS.W   @R0+, FP
      SUB.W    @R0+, R0
      SUB.W    @R0+, FP
      SUBS.W   @R0+, R0
      SUBS.W   @R0+, FP
      OR.W     @R0+, R0
      OR.W     @R0+, FP
      BSET.W   R0, @R0+
      BSET.W   FP, @R0+
      AND.W    @R0+, R0
      AND.W    @R0+, FP
      BCLR.W   R0, @R0+
      BCLR.W   FP, @R0+
      XOR.W    @R0+, R0
      XOR.W    @R0+, FP
      BNOT.W   R0, @R0+
      BNOT.W   FP, @R0+
      CMP:G.W  @R0+, R0
      CMP:G.W  @R0+, FP
      BTST.W   R0, @R0+
      BTST.W   FP, @R0+
      MOV:G.W  @R0+, R0
      MOV:G.W  @R0+, FP
      LDC      @R0+, SR
      MOV:G.W  R0, @R0+
      MOV:G.W  FP, @R0+
      STC      SR, @R0+
      ADDX.W   @R0+, R0
      ADDX.W   @R0+, FP
      MULXU.W  @R0+, R0
      MULXU.W  @R0+, FP
      SUBX.W   @R0+, R0
      SUBX.W   @R0+, FP
      DIVXU.W  @R0+, R0
      DIVXU.W  @R0+, FP
      BSET.W   #15, @FP+
      BCLR.W   #0, @FP+
      BNOT.W   #0, @FP+
      BTST.W   #0, @FP+
      CMP:G.W  #5, @FP+
      CMP:G.W  #0x0607, @FP+
      MOV:G.W  #7, @FP+
      MOV:G.W  #0x0809, @FP+
      ADD:Q.W  #1, @FP+
      CLR.W    @FP+
      NEG.W    @FP+
      NOT.W    @FP+
      TST.W    @FP+
      SHAL.W   @FP+
      SHAR.W   @FP+
      SHLL.W   @FP+
      SHLR.W   @FP+
      ROTL.W   @FP+
      ROTR.W   @FP+
      ROTXL.W  @FP+
      ROTXR.W  @FP+
      ADD:G.W  @FP+, R0
      ADD:G.W  @FP+, FP
      ADDS.W   @FP+, R0
      ADDS.W   @FP+, FP
      SUB.W    @FP+, R0
      SUB.W    @FP+, FP
      SUBS.W   @FP+, R0
      SUBS.W   @FP+, FP
      OR.W     @FP+, R0
      OR.W     @FP+, FP
      BSET.W   R0, @FP+
      BSET.W   FP, @FP+
      AND.W    @FP+, R0
      AND.W    @FP+, FP
      BCLR.W   R0, @FP+
      BCLR.W   FP, @FP+
      XOR.W    @FP+, R0
      XOR.W    @FP+, FP
      BNOT.W   R0, @FP+
      BNOT.W   FP, @FP+
      CMP:G.W  @FP+, R0
      CMP:G.W  @FP+, FP
      BTST.W   R0, @FP+
      BTST.W   FP, @FP+
      MOV:G.W  @FP+, R0
      MOV:G.W  @FP+, FP
      LDC      @FP+, SR
      MOV:G.W  R0, @FP+
      MOV:G.W  FP, @FP+
      STC      SR, @FP+
      ADDX.W   @FP+, R0
      ADDX.W   @FP+, FP
      MULXU.W  @FP+, R0
      MULXU.W  @FP+, FP
      SUBX.W   @FP+, R0
      SUBX.W   @FP+, FP
      DIVXU.W  @FP+, R0
      DIVXU.W  @FP+, FP
      BCLR.W   #0, @SP+
      BNOT.W   #0, @SP+
      BTST.W   #0, @SP+
      CMP:G.W  #5, @SP+
      CMP:G.W  #0x0607, @SP+
      MOV:G.W  #7, @SP+
      MOV:G.W  #0x0809, @SP+
      ADD:Q.W  #1, @SP+
      CLR.W    @SP+
      NEG.W    @SP+
      NOT.W    @SP+
      TST.W    @SP+
      SHAL.W   @SP+
      SHAR.W   @SP+
      SHLL.W   @SP+
      SHLR.W   @SP+
      ROTL.W   @SP+
      ROTR.W   @SP+
      ROTXL.W  @SP+
      ROTXR.W  @SP+
      ADD:G.W  @SP+, R0
      ADD:G.W  @SP+, FP
      ADDS.W   @SP+, R0
      ADDS.W   @SP+, FP
      SUB.W    @SP+, R0
      SUB.W    @SP+, FP
      SUBS.W   @SP+, R0
      SUBS.W   @SP+, FP
      OR.W     @SP+, R0
      OR.W     @SP+, FP
      BSET.W   R0, @SP+
      BSET.W   FP, @SP+
      AND.W    @SP+, R0
      AND.W    @SP+, FP
      BCLR.W   R0, @SP+
      BCLR.W   FP, @SP+
      XOR.W    @SP+, R0
      XOR.W    @SP+, FP
      BNOT.W   R0, @SP+
      BNOT.W   FP, @SP+
      CMP:G.W  @SP+, R0
      CMP:G.W  @SP+, FP
      BTST.W   R0, @SP+
      BTST.W   FP, @SP+
      MOV:G.W  @SP+, R0
      MOV:G.W  @SP+, FP
      LDC      @SP+, SR
      MOV:G.W  R0, @SP+
      MOV:G.W  FP, @SP+
      STC      SR, @SP+
      ADDX.W   @SP+, R0
      ADDX.W   @SP+, FP
      MULXU.W  @SP+, R0
      MULXU.W  @SP+, FP
      SUBX.W   @SP+, R0
      SUBX.W   @SP+, FP
      DIVXU.W  @SP+, R0
      DIVXU.W  @SP+, FP
      BSET.W   #0, @SP+
      BCLR.B   #1, @R0
      BNOT.B   #0, @R0
      BTST.B   #0, @R0
      MOVFPE   @R0, R0
      MOVFPE   @R0, FP
      MOVTPE   R0, @R0
      MOVTPE   FP, @R0
      CMP:G.B  #5, @R0
      MOV:G.B  #7, @R0
      ADD:Q.B  #1, @R0
      CLR.B    @R0
      NEG.B    @R0
      NOT.B    @R0
      TST.B    @R0
      TAS      @R0
      SHAL.B   @R0
      SHAR.B   @R0
      SHLL.B   @R0
      SHLR.B   @R0
      ROTL.B   @R0
      ROTR.B   @R0
      ROTXL.B  @R0
      ROTXR.B  @R0
      ADD:G.B  @R0, R0
      ADD:G.B  @R0, FP
      ADDS.B   @R0, R0
      ADDS.B   @R0, FP
      SUB.B    @R0, R0
      SUB.B    @R0, FP
      SUBS.B   @R0, R0
      SUBS.B   @R0, FP
      OR.B     @R0, R0
      OR.B     @R0, FP
      BSET.B   R0, @R0
      BSET.B   FP, @R0
      AND.B    @R0, R0
      AND.B    @R0, FP
      BCLR.B   R0, @R0
      BCLR.B   FP, @R0
      XOR.B    @R0, R0
      XOR.B    @R0, FP
      BNOT.B   R0, @R0
      BNOT.B   FP, @R0
      CMP:G.B  @R0, R0
      CMP:G.B  @R0, FP
      BTST.B   R0, @R0
      BTST.B   FP, @R0
      MOV:G.B  @R0, R0
      MOV:G.B  @R0, FP
      LDC      @R0, CCR
      LDC      @R0, BR
      LDC      @R0, EP
      LDC      @R0, DP
      LDC      @R0, TP
      MOV:G.B  R0, @R0
      MOV:G.B  FP, @R0
      STC      CCR, @R0
      STC      BR, @R0
      STC      EP, @R0
      STC      DP, @R0
      STC      TP, @R0
      ADDX.B   @R0, R0
      ADDX.B   @R0, FP
      MULXU.B  @R0, R0
      MULXU.B  @R0, FP
      SUBX.B   @R0, R0
      SUBX.B   @R0, FP
      DIVXU.B  @R0, R0
      DIVXU.B  @R0, FP
      BSET.B   #0, @R0
      BCLR.B   #7, @FP
      BNOT.B   #0, @FP
      BTST.B   #0, @FP
      MOVFPE   @FP, R0
      MOVFPE   @FP, FP
      MOVTPE   R0, @FP
      MOVTPE   FP, @FP
      CMP:G.B  #5, @FP
      MOV:G.B  #7, @FP
      ADD:Q.B  #1, @FP
      CLR.B    @FP
      NEG.B    @FP
      NOT.B    @FP
      TST.B    @FP
      TAS      @FP
      SHAL.B   @FP
      SHAR.B   @FP
      SHLL.B   @FP
      SHLR.B   @FP
      ROTL.B   @FP
      ROTR.B   @FP
      ROTXL.B  @FP
      ROTXR.B  @FP
      ADD:G.B  @FP, R0
      ADD:G.B  @FP, FP
      ADDS.B   @FP, R0
      ADDS.B   @FP, FP
      SUB.B    @FP, R0
      SUB.B    @FP, FP
      SUBS.B   @FP, R0
      SUBS.B   @FP, FP
      OR.B     @FP, R0
      OR.B     @FP, FP
      BSET.B   R0, @FP
      BSET.B   FP, @FP
      AND.B    @FP, R0
      AND.B    @FP, FP
      BCLR.B   R0, @FP
      BCLR.B   FP, @FP
      XOR.B    @FP, R0
      XOR.B    @FP, FP
      BNOT.B   R0, @FP
      BNOT.B   FP, @FP
      CMP:G.B  @FP, R0
      CMP:G.B  @FP, FP
      BTST.B   R0, @FP
      BTST.B   FP, @FP
      MOV:G.B  @FP, R0
      MOV:G.B  @FP, FP
      LDC      @FP, CCR
      LDC      @FP, BR
      LDC      @FP, EP
      LDC      @FP, DP
      LDC      @FP, TP
      MOV:G.B  R0, @FP
      MOV:G.B  FP, @FP
      STC      CCR, @FP
      STC      BR, @FP
      STC      EP, @FP
      STC      DP, @FP
      STC      TP, @FP
      ADDX.B   @FP, R0
      ADDX.B   @FP, FP
      MULXU.B  @FP, R0
      MULXU.B  @FP, FP
      SUBX.B   @FP, R0
      SUBX.B   @FP, FP
      DIVXU.B  @FP, R0
      DIVXU.B  @FP, FP
      BSET.B   #0, @FP
      BNOT.B   #0, @SP
      BTST.B   #0, @SP
      MOVFPE   @SP, R0
      MOVFPE   @SP, FP
      MOVTPE   R0, @SP
      MOVTPE   FP, @SP
      CMP:G.B  #5, @SP
      MOV:G.B  #7, @SP
      ADD:Q.B  #1, @SP
      CLR.B    @SP
      NEG.B    @SP
      NOT.B    @SP
      TST.B    @SP
      TAS      @SP
      SHAL.B   @SP
      SHAR.B   @SP
      SHLL.B   @SP
      SHLR.B   @SP
      ROTL.B   @SP
      ROTR.B   @SP
      ROTXL.B  @SP
      ROTXR.B  @SP
      ADD:G.B  @SP, R0
      ADD:G.B  @SP, FP
      ADDS.B   @SP, R0
      ADDS.B   @SP, FP
      SUB.B    @SP, R0
      SUB.B    @SP, FP
      SUBS.B   @SP, R0
      SUBS.B   @SP, FP
      OR.B     @SP, R0
      OR.B     @SP, FP
      BSET.B   R0, @SP
      BSET.B   FP, @SP
      AND.B    @SP, R0
      AND.B    @SP, FP
      BCLR.B   R0, @SP
      BCLR.B   FP, @SP
      XOR.B    @SP, R0
      XOR.B    @SP, FP
      BNOT.B   R0, @SP
      BNOT.B   FP, @SP
      CMP:G.B  @SP, R0
      CMP:G.B  @SP, FP
      BTST.B   R0, @SP
      BTST.B   FP, @SP
      MOV:G.B  @SP, R0
      MOV:G.B  @SP, FP
      LDC      @SP, CCR
      LDC      @SP, BR
      LDC      @SP, EP
      LDC      @SP, DP
      LDC      @SP, TP
      MOV:G.B  R0, @SP
      MOV:G.B  FP, @SP
      STC      CCR, @SP
      STC      BR, @SP
      STC      EP, @SP
      STC      DP, @SP
      STC      TP, @SP
      ADDX.B   @SP, R0
      ADDX.B   @SP, FP
      MULXU.B  @SP, R0
      MULXU.B  @SP, FP
      SUBX.B   @SP, R0
      SUBX.B   @SP, FP
      DIVXU.B  @SP, R0
      DIVXU.B  @SP, FP
      BSET.B   #0, @SP
      BCLR.B   #0, @SP
      BCLR.W   #9, @R0
      BNOT.W   #0, @R0
      BTST.W   #0, @R0
      CMP:G.W  #5, @R0
      CMP:G.W  #0x0607, @R0
      MOV:G.W  #7, @R0
      MOV:G.W  #0x0809, @R0
      ADD:Q.W  #1, @R0
      CLR.W    @R0
      NEG.W    @R0
      NOT.W    @R0
      TST.W    @R0
      SHAL.W   @R0
      SHAR.W   @R0
      SHLL.W   @R0
      SHLR.W   @R0
      ROTL.W   @R0
      ROTR.W   @R0
      ROTXL.W  @R0
      ROTXR.W  @R0
      ADD:G.W  @R0, R0
      ADD:G.W  @R0, FP
      ADDS.W   @R0, R0
      ADDS.W   @R0, FP
      SUB.W    @R0, R0
      SUB.W    @R0, FP
      SUBS.W   @R0, R0
      SUBS.W   @R0, FP
      OR.W     @R0, R0
      OR.W     @R0, FP
      BSET.W   R0, @R0
      BSET.W   FP, @R0
      AND.W    @R0, R0
      AND.W    @R0, FP
      BCLR.W   R0, @R0
      BCLR.W   FP, @R0
      XOR.W    @R0, R0
      XOR.W    @R0, FP
      BNOT.W   R0, @R0
      BNOT.W   FP, @R0
      CMP:G.W  @R0, R0
      CMP:G.W  @R0, FP
      BTST.W   R0, @R0
      BTST.W   FP, @R0
      MOV:G.W  @R0, R0
      MOV:G.W  @R0, FP
      LDC      @R0, SR
      MOV:G.W  R0, @R0
      MOV:G.W  FP, @R0
      STC      SR, @R0
      ADDX.W   @R0, R0
      ADDX.W   @R0, FP
      MULXU.W  @R0, R0
      MULXU.W  @R0, FP
      SUBX.W   @R0, R0
      SUBX.W   @R0, FP
      DIVXU.W  @R0, R0
      DIVXU.W  @R0, FP
      BSET.W   #0, @R0
      BCLR.W   #15, @FP
      BNOT.W   #0, @FP
      BTST.W   #0, @FP
      CMP:G.W  #5, @FP
      CMP:G.W  #0x0607, @FP
      MOV:G.W  #7, @FP
      MOV:G.W  #0x0809, @FP
      ADD:Q.W  #1, @FP
      CLR.W    @FP
      NEG.W    @FP
      NOT.W    @FP
      TST.W    @FP
      SHAL.W   @FP
      SHAR.W   @FP
      SHLL.W   @FP
      SHLR.W   @FP
      ROTL.W   @FP
      ROTR.W   @FP
      ROTXL.W  @FP
      ROTXR.W  @FP
      ADD:G.W  @FP, R0
      ADD:G.W  @FP, FP
      ADDS.W   @FP, R0
      ADDS.W   @FP, FP
      SUB.W    @FP, R0
      SUB.W    @FP, FP
      SUBS.W   @FP, R0
      SUBS.W   @FP, FP
      OR.W     @FP, R0
      OR.W     @FP, FP
      BSET.W   R0, @FP
      BSET.W   FP, @FP
      AND.W    @FP, R0
      AND.W    @FP, FP
      BCLR.W   R0, @FP
      BCLR.W   FP, @FP
      XOR.W    @FP, R0
      XOR.W    @FP, FP
      BNOT.W   R0, @FP
      BNOT.W   FP, @FP
      CMP:G.W  @FP, R0
      CMP:G.W  @FP, FP
      BTST.W   R0, @FP
      BTST.W   FP, @FP
      MOV:G.W  @FP, R0
      MOV:G.W  @FP, FP
      LDC      @FP, SR
      MOV:G.W  R0, @FP
      MOV:G.W  FP, @FP
      STC      SR, @FP
      ADDX.W   @FP, R0
      ADDX.W   @FP, FP
      MULXU.W  @FP, R0
      MULXU.W  @FP, FP
      SUBX.W   @FP, R0
      SUBX.W   @FP, FP
      DIVXU.W  @FP, R0
      DIVXU.W  @FP, FP
      BSET.W   #0, @FP
      BNOT.W   #0, @SP
      BTST.W   #0, @SP
      CMP:G.W  #5, @SP
      CMP:G.W  #0x0607, @SP
      MOV:G.W  #7, @SP
      MOV:G.W  #0x0809, @SP
      ADD:Q.W  #1, @SP
      CLR.W    @SP
      NEG.W    @SP
      NOT.W    @SP
      TST.W    @SP
      SHAL.W   @SP
      SHAR.W   @SP
      SHLL.W   @SP
      SHLR.W   @SP
      ROTL.W   @SP
      ROTR.W   @SP
      ROTXL.W  @SP
      ROTXR.W  @SP
      ADD:G.W  @SP, R0
      ADD:G.W  @SP, FP
      ADDS.W   @SP, R0
      ADDS.W   @SP, FP
      SUB.W    @SP, R0
      SUB.W    @SP, FP
      SUBS.W   @SP, R0
      SUBS.W   @SP, FP
      OR.W     @SP, R0
      OR.W     @SP, FP
      BSET.W   R0, @SP
      BSET.W   FP, @SP
      AND.W    @SP, R0
      AND.W    @SP, FP
      BCLR.W   R0, @SP
      BCLR.W   FP, @SP
      XOR.W    @SP, R0
      XOR.W    @SP, FP
      BNOT.W   R0, @SP
      BNOT.W   FP, @SP
      CMP:G.W  @SP, R0
      CMP:G.W  @SP, FP
      BTST.W   R0, @SP
      BTST.W   FP, @SP
      MOV:G.W  @SP, R0
      MOV:G.W  @SP, FP
      LDC      @SP, SR
      MOV:G.W  R0, @SP
      MOV:G.W  FP, @SP
      STC      SR, @SP
      ADDX.W   @SP, R0
      ADDX.W   @SP, FP
      MULXU.W  @SP, R0
      MULXU.W  @SP, FP
      SUBX.W   @SP, R0
      SUBX.W   @SP, FP
      DIVXU.W  @SP, R0
      DIVXU.W  @SP, FP
      BSET.W   #0, @SP
      BCLR.W   #0, @SP
      BNOT.B   #2, @(-31,R0)
      BTST.B   #0, @(-31,R0)
      MOVFPE   @(-31,R0), R0
      MOVFPE   @(-31,R0), FP
      MOVTPE   R0, @(-31,R0)
      MOVTPE   FP, @(-31,R0)
      CMP:G.B  #5, @(-31,R0)
      MOV:G.B  #7, @(-31,R0)
      ADD:Q.B  #1, @(-31,R0)
      CLR.B    @(-31,R0)
      NEG.B    @(-31,R0)
      NOT.B    @(-31,R0)
      TST.B    @(-31,R0)
      TAS      @(-31,R0)
      SHAL.B   @(-31,R0)
      SHAR.B   @(-31,R0)
      SHLL.B   @(-31,R0)
      SHLR.B   @(-31,R0)
      ROTL.B   @(-31,R0)
      ROTR.B   @(-31,R0)
      ROTXL.B  @(-31,R0)
      ROTXR.B  @(-31,R0)
      ADD:G.B  @(-31,R0), R0
      ADD:G.B  @(-31,R0), FP
      ADDS.B   @(-31,R0), R0
      ADDS.B   @(-31,R0), FP
      SUB.B    @(-31,R0), R0
      SUB.B    @(-31,R0), FP
      SUBS.B   @(-31,R0), R0
      SUBS.B   @(-31,R0), FP
      OR.B     @(-31,R0), R0
      OR.B     @(-31,R0), FP
      BSET.B   R0, @(-31,R0)
      BSET.B   FP, @(-31,R0)
      AND.B    @(-31,R0), R0
      AND.B    @(-31,R0), FP
      BCLR.B   R0, @(-31,R0)
      BCLR.B   FP, @(-31,R0)
      XOR.B    @(-31,R0), R0
      XOR.B    @(-31,R0), FP
      BNOT.B   R0, @(-31,R0)
      BNOT.B   FP, @(-31,R0)
      CMP:G.B  @(-31,R0), R0
      CMP:G.B  @(-31,R0), FP
      BTST.B   R0, @(-31,R0)
      BTST.B   FP, @(-31,R0)
      MOV:G.B  @(-31,R0), R0
      MOV:G.B  @(-31,R0), FP
      LDC      @(-31,R0), CCR
      LDC      @(-31,R0), BR
      LDC      @(-31,R0), EP
      LDC      @(-31,R0), DP
      LDC      @(-31,R0), TP
      MOV:G.B  R0, @(-31,R0)
      MOV:G.B  FP, @(-31,R0)
      STC      CCR, @(-31,R0)
      STC      BR, @(-31,R0)
      STC      EP, @(-31,R0)
      STC      DP, @(-31,R0)
      STC      TP, @(-31,R0)
      ADDX.B   @(-31,R0), R0
      ADDX.B   @(-31,R0), FP
      MULXU.B  @(-31,R0), R0
      MULXU.B  @(-31,R0), FP
      SUBX.B   @(-31,R0), R0
      SUBX.B   @(-31,R0), FP
      DIVXU.B  @(-31,R0), R0
      DIVXU.B  @(-31,R0), FP
      BSET.B   #0, @(-31,R0)
      BCLR.B   #0, @(-31,R0)
      BTST.B   #0, @(-25,FP)
      MOVFPE   @(-25,FP), R0
      MOVFPE   @(-25,FP), FP
      MOVTPE   R0, @(-25,FP)
      MOVTPE   FP, @(-25,FP)
      CMP:G.B  #5, @(-25,FP)
      MOV:G.B  #7, @(-25,FP)
      ADD:Q.B  #1, @(-25,FP)
      CLR.B    @(-25,FP)
      NEG.B    @(-25,FP)
      NOT.B    @(-25,FP)
      TST.B    @(-25,FP)
      TAS      @(-25,FP)
      SHAL.B   @(-25,FP)
      SHAR.B   @(-25,FP)
      SHLL.B   @(-25,FP)
      SHLR.B   @(-25,FP)
      ROTL.B   @(-25,FP)
      ROTR.B   @(-25,FP)
      ROTXL.B  @(-25,FP)
      ROTXR.B  @(-25,FP)
      ADD:G.B  @(-25,FP), R0
      ADD:G.B  @(-25,FP), FP
      ADDS.B   @(-25,FP), R0
      ADDS.B   @(-25,FP), FP
      SUB.B    @(-25,FP), R0
      SUB.B    @(-25,FP), FP
      SUBS.B   @(-25,FP), R0
      SUBS.B   @(-25,FP), FP
      OR.B     @(-25,FP), R0
      OR.B     @(-25,FP), FP
      BSET.B   R0, @(-25,FP)
      BSET.B   FP, @(-25,FP)
      AND.B    @(-25,FP), R0
      AND.B    @(-25,FP), FP
      BCLR.B   R0, @(-25,FP)
      BCLR.B   FP, @(-25,FP)
      XOR.B    @(-25,FP), R0
      XOR.B    @(-25,FP), FP
      BNOT.B   R0, @(-25,FP)
      BNOT.B   FP, @(-25,FP)
      CMP:G.B  @(-25,FP), R0
      CMP:G.B  @(-25,FP), FP
      BTST.B   R0, @(-25,FP)
      BTST.B   FP, @(-25,FP)
      MOV:G.B  @(-25,FP), R0
      MOV:G.B  @(-25,FP), FP
      LDC      @(-25,FP), CCR
      LDC      @(-25,FP), BR
      LDC      @(-25,FP), EP
      LDC      @(-25,FP), DP
      LDC      @(-25,FP), TP
      MOV:G.B  R0, @(-25,FP)
      MOV:G.B  FP, @(-25,FP)
      STC      CCR, @(-25,FP)
      STC      BR, @(-25,FP)
      STC      EP, @(-25,FP)
      STC      DP, @(-25,FP)
      STC      TP, @(-25,FP)
      ADDX.B   @(-25,FP), R0
      ADDX.B   @(-25,FP), FP
      MULXU.B  @(-25,FP), R0
      MULXU.B  @(-25,FP), FP
      SUBX.B   @(-25,FP), R0
      SUBX.B   @(-25,FP), FP
      DIVXU.B  @(-25,FP), R0
      DIVXU.B  @(-25,FP), FP
      BSET.B   #0, @(-25,FP)
      BCLR.B   #0, @(-25,FP)
      BNOT.B   #0, @(-25,FP)
      BTST.B   #0, @(-24,SP)
      MOVFPE   @(-24,SP), R0
      MOVFPE   @(-24,SP), FP
      MOVTPE   R0, @(-24,SP)
      MOVTPE   FP, @(-24,SP)
      CMP:G.B  #5, @(-24,SP)
      MOV:G.B  #7, @(-24,SP)
      ADD:Q.B  #1, @(-24,SP)
      CLR.B    @(-24,SP)
      NEG.B    @(-24,SP)
      NOT.B    @(-24,SP)
      TST.B    @(-24,SP)
      TAS      @(-24,SP)
      SHAL.B   @(-24,SP)
      SHAR.B   @(-24,SP)
      SHLL.B   @(-24,SP)
      SHLR.B   @(-24,SP)
      ROTL.B   @(-24,SP)
      ROTR.B   @(-24,SP)
      ROTXL.B  @(-24,SP)
      ROTXR.B  @(-24,SP)
      ADD:G.B  @(-24,SP), R0
      ADD:G.B  @(-24,SP), FP
      ADDS.B   @(-24,SP), R0
      ADDS.B   @(-24,SP), FP
      SUB.B    @(-24,SP), R0
      SUB.B    @(-24,SP), FP
      SUBS.B   @(-24,SP), R0
      SUBS.B   @(-24,SP), FP
      OR.B     @(-24,SP), R0
      OR.B     @(-24,SP), FP
      BSET.B   R0, @(-24,SP)
      BSET.B   FP, @(-24,SP)
      AND.B    @(-24,SP), R0
      AND.B    @(-24,SP), FP
      BCLR.B   R0, @(-24,SP)
      BCLR.B   FP, @(-24,SP)
      XOR.B    @(-24,SP), R0
      XOR.B    @(-24,SP), FP
      BNOT.B   R0, @(-24,SP)
      BNOT.B   FP, @(-24,SP)
      CMP:G.B  @(-24,SP), R0
      CMP:G.B  @(-24,SP), FP
      BTST.B   R0, @(-24,SP)
      BTST.B   FP, @(-24,SP)
      MOV:G.B  @(-24,SP), R0
      MOV:G.B  @(-24,SP), FP
      LDC      @(-24,SP), CCR
      LDC      @(-24,SP), BR
      LDC      @(-24,SP), EP
      LDC      @(-24,SP), DP
      LDC      @(-24,SP), TP
      MOV:G.B  R0, @(-24,SP)
      MOV:G.B  FP, @(-24,SP)
      STC      CCR, @(-24,SP)
      STC      BR, @(-24,SP)
      STC      EP, @(-24,SP)
      STC      DP, @(-24,SP)
      STC      TP, @(-24,SP)
      ADDX.B   @(-24,SP), R0
      ADDX.B   @(-24,SP), FP
      MULXU.B  @(-24,SP), R0
      MULXU.B  @(-24,SP), FP
      SUBX.B   @(-24,SP), R0
      SUBX.B   @(-24,SP), FP
      DIVXU.B  @(-24,SP), R0
      DIVXU.B  @(-24,SP), FP
      BSET.B   #0, @(-24,SP)
      BCLR.B   #0, @(-24,SP)
      BNOT.B   #0, @(-24,SP)
      BNOT.W   #10, @(-23,R0)
      BTST.W   #0, @(-23,R0)
      CMP:G.W  #5, @(-23,R0)
      CMP:G.W  #0x0607, @(-23,R0)
      MOV:G.W  #7, @(-23,R0)
      MOV:G.W  #0x0809, @(-23,R0)
      ADD:Q.W  #1, @(-23,R0)
      CLR.W    @(-23,R0)
      NEG.W    @(-23,R0)
      NOT.W    @(-23,R0)
      TST.W    @(-23,R0)
      SHAL.W   @(-23,R0)
      SHAR.W   @(-23,R0)
      SHLL.W   @(-23,R0)
      SHLR.W   @(-23,R0)
      ROTL.W   @(-23,R0)
      ROTR.W   @(-23,R0)
      ROTXL.W  @(-23,R0)
      ROTXR.W  @(-23,R0)
      ADD:G.W  @(-23,R0), R0
      ADD:G.W  @(-23,R0), FP
      ADDS.W   @(-23,R0), R0
      ADDS.W   @(-23,R0), FP
      SUB.W    @(-23,R0), R0
      SUB.W    @(-23,R0), FP
      SUBS.W   @(-23,R0), R0
      SUBS.W   @(-23,R0), FP
      OR.W     @(-23,R0), R0
      OR.W     @(-23,R0), FP
      BSET.W   R0, @(-23,R0)
      BSET.W   FP, @(-23,R0)
      AND.W    @(-23,R0), R0
      AND.W    @(-23,R0), FP
      BCLR.W   R0, @(-23,R0)
      BCLR.W   FP, @(-23,R0)
      XOR.W    @(-23,R0), R0
      XOR.W    @(-23,R0), FP
      BNOT.W   R0, @(-23,R0)
      BNOT.W   FP, @(-23,R0)
      CMP:G.W  @(-23,R0), R0
      CMP:G.W  @(-23,R0), FP
      BTST.W   R0, @(-23,R0)
      BTST.W   FP, @(-23,R0)
      MOV:G.W  @(-23,R0), R0
      MOV:G.W  @(-23,R0), FP
      LDC      @(-23,R0), SR
      MOV:G.W  R0, @(-23,R0)
      MOV:G.W  FP, @(-23,R0)
      STC      SR, @(-23,R0)
      ADDX.W   @(-23,R0), R0
      ADDX.W   @(-23,R0), FP
      MULXU.W  @(-23,R0), R0
      MULXU.W  @(-23,R0), FP
      SUBX.W   @(-23,R0), R0
      SUBX.W   @(-23,R0), FP
      DIVXU.W  @(-23,R0), R0
      DIVXU.W  @(-23,R0), FP
      BSET.W   #0, @(-23,R0)
      BCLR.W   #0, @(-23,R0)
      BTST.W   #0, @(-17,FP)
      CMP:G.W  #5, @(-17,FP)
      CMP:G.W  #0x0607, @(-17,FP)
      MOV:G.W  #7, @(-17,FP)
      MOV:G.W  #0x0809, @(-17,FP)
      ADD:Q.W  #1, @(-17,FP)
      CLR.W    @(-17,FP)
      NEG.W    @(-17,FP)
      NOT.W    @(-17,FP)
      TST.W    @(-17,FP)
      SHAL.W   @(-17,FP)
      SHAR.W   @(-17,FP)
      SHLL.W   @(-17,FP)
      SHLR.W   @(-17,FP)
      ROTL.W   @(-17,FP)
      ROTR.W   @(-17,FP)
      ROTXL.W  @(-17,FP)
      ROTXR.W  @(-17,FP)
      ADD:G.W  @(-17,FP), R0
      ADD:G.W  @(-17,FP), FP
      ADDS.W   @(-17,FP), R0
      ADDS.W   @(-17,FP), FP
      SUB.W    @(-17,FP), R0
      SUB.W    @(-17,FP), FP
      SUBS.W   @(-17,FP), R0
      SUBS.W   @(-17,FP), FP
      OR.W     @(-17,FP), R0
      OR.W     @(-17,FP), FP
      BSET.W   R0, @(-17,FP)
      BSET.W   FP, @(-17,FP)
      AND.W    @(-17,FP), R0
      AND.W    @(-17,FP), FP
      BCLR.W   R0, @(-17,FP)
      BCLR.W   FP, @(-17,FP)
      XOR.W    @(-17,FP), R0
      XOR.W    @(-17,FP), FP
      BNOT.W   R0, @(-17,FP)
      BNOT.W   FP, @(-17,FP)
      CMP:G.W  @(-17,FP), R0
      CMP:G.W  @(-17,FP), FP
      BTST.W   R0, @(-17,FP)
      BTST.W   FP, @(-17,FP)
      MOV:G.W  @(-17,FP), R0
      MOV:G.W  @(-17,FP), FP
      LDC      @(-17,FP), SR
      MOV:G.W  R0, @(-17,FP)
      MOV:G.W  FP, @(-17,FP)
      STC      SR, @(-17,FP)
      ADDX.W   @(-17,FP), R0
      ADDX.W   @(-17,FP), FP
      MULXU.W  @(-17,FP), R0
      MULXU.W  @(-17,FP), FP
      SUBX.W   @(-17,FP), R0
      SUBX.W   @(-17,FP), FP
      DIVXU.W  @(-17,FP), R0
      DIVXU.W  @(-17,FP), FP
      BSET.W   #0, @(-17,FP)
      BCLR.W   #0, @(-17,FP)
      BNOT.W   #0, @(-17,FP)
      BTST.W   #1, @(-16,SP)
      CMP:G.W  #5, @(-16,SP)
      CMP:G.W  #0x0607, @(-16,SP)
      MOV:G.W  #7, @(-16,SP)
      MOV:G.W  #0x0809, @(-16,SP)
      ADD:Q.W  #1, @(-16,SP)
      CLR.W    @(-16,SP)
      NEG.W    @(-16,SP)
      NOT.W    @(-16,SP)
      TST.W    @(-16,SP)
      SHAL.W   @(-16,SP)
      SHAR.W   @(-16,SP)
      SHLL.W   @(-16,SP)
      SHLR.W   @(-16,SP)
      ROTL.W   @(-16,SP)
      ROTR.W   @(-16,SP)
      ROTXL.W  @(-16,SP)
      ROTXR.W  @(-16,SP)
      ADD:G.W  @(-16,SP), R0
      ADD:G.W  @(-16,SP), FP
      ADDS.W   @(-16,SP), R0
      ADDS.W   @(-16,SP), FP
      SUB.W    @(-16,SP), R0
      SUB.W    @(-16,SP), FP
      SUBS.W   @(-16,SP), R0
      SUBS.W   @(-16,SP), FP
      OR.W     @(-16,SP), R0
      OR.W     @(-16,SP), FP
      BSET.W   R0, @(-16,SP)
      BSET.W   FP, @(-16,SP)
      AND.W    @(-16,SP), R0
      AND.W    @(-16,SP), FP
      BCLR.W   R0, @(-16,SP)
      BCLR.W   FP, @(-16,SP)
      XOR.W    @(-16,SP), R0
      XOR.W    @(-16,SP), FP
      BNOT.W   R0, @(-16,SP)
      BNOT.W   FP, @(-16,SP)
      CMP:G.W  @(-16,SP), R0
      CMP:G.W  @(-16,SP), FP
      BTST.W   R0, @(-16,SP)
      BTST.W   FP, @(-16,SP)
      MOV:G.W  @(-16,SP), R0
      MOV:G.W  @(-16,SP), FP
      LDC      @(-16,SP), SR
      MOV:G.W  R0, @(-16,SP)
      MOV:G.W  FP, @(-16,SP)
      STC      SR, @(-16,SP)
      ADDX.W   @(-16,SP), R0
      ADDX.W   @(-16,SP), FP
      MULXU.W  @(-16,SP), R0
      MULXU.W  @(-16,SP), FP
      SUBX.W   @(-16,SP), R0
      SUBX.W   @(-16,SP), FP
      DIVXU.W  @(-16,SP), R0
      DIVXU.W  @(-16,SP), FP
      BSET.W   #0, @(-16,SP)
      BCLR.W   #0, @(-16,SP)
      BNOT.W   #0, @(-16,SP)
      BTST.B   #3, @(-0x0E0E,R0)
      MOVFPE   @(-0x0E0E,R0), R0
      MOVFPE   @(-0x0E0E,R0), FP
      MOVTPE   R0, @(-0x0E0E,R0)
      MOVTPE   FP, @(-0x0E0E,R0)
      CMP:G.B  #5, @(-0x0E0E,R0)
      MOV:G.B  #7, @(-0x0E0E,R0)
      ADD:Q.B  #1, @(-0x0E0E,R0)
      CLR.B    @(-0x0E0E,R0)
      NEG.B    @(-0x0E0E,R0)
      NOT.B    @(-0x0E0E,R0)
      TST.B    @(-0x0E0E,R0)
      TAS      @(-0x0E0E,R0)
      SHAL.B   @(-0x0E0E,R0)
      SHAR.B   @(-0x0E0E,R0)
      SHLL.B   @(-0x0E0E,R0)
      SHLR.B   @(-0x0E0E,R0)
      ROTL.B   @(-0x0E0E,R0)
      ROTR.B   @(-0x0E0E,R0)
      ROTXL.B  @(-0x0E0E,R0)
      ROTXR.B  @(-0x0E0E,R0)
      ADD:G.B  @(-0x0E0E,R0), R0
      ADD:G.B  @(-0x0E0E,R0), FP
      ADDS.B   @(-0x0E0E,R0), R0
      ADDS.B   @(-0x0E0E,R0), FP
      SUB.B    @(-0x0E0E,R0), R0
      SUB.B    @(-0x0E0E,R0), FP
      SUBS.B   @(-0x0E0E,R0), R0
      SUBS.B   @(-0x0E0E,R0), FP
      OR.B     @(-0x0E0E,R0), R0
      OR.B     @(-0x0E0E,R0), FP
      BSET.B   R0, @(-0x0E0E,R0)
      BSET.B   FP, @(-0x0E0E,R0)
      AND.B    @(-0x0E0E,R0), R0
      AND.B    @(-0x0E0E,R0), FP
      BCLR.B   R0, @(-0x0E0E,R0)
      BCLR.B   FP, @(-0x0E0E,R0)
      XOR.B    @(-0x0E0E,R0), R0
      XOR.B    @(-0x0E0E,R0), FP
      BNOT.B   R0, @(-0x0E0E,R0)
      BNOT.B   FP, @(-0x0E0E,R0)
      CMP:G.B  @(-0x0E0E,R0), R0
      CMP:G.B  @(-0x0E0E,R0), FP
      BTST.B   R0, @(-0x0E0E,R0)
      BTST.B   FP, @(-0x0E0E,R0)
      MOV:G.B  @(-0x0E0E,R0), R0
      MOV:G.B  @(-0x0E0E,R0), FP
      LDC      @(-0x0E0E,R0), CCR
      LDC      @(-0x0E0E,R0), BR
      LDC      @(-0x0E0E,R0), EP
      LDC      @(-0x0E0E,R0), DP
      LDC      @(-0x0E0E,R0), TP
      MOV:G.B  R0, @(-0x0E0E,R0)
      MOV:G.B  FP, @(-0x0E0E,R0)
      STC      CCR, @(-0x0E0E,R0)
      STC      BR, @(-0x0E0E,R0)
      STC      EP, @(-0x0E0E,R0)
      STC      DP, @(-0x0E0E,R0)
      STC      TP, @(-0x0E0E,R0)
      ADDX.B   @(-0x0E0E,R0), R0
      ADDX.B   @(-0x0E0E,R0), FP
      MULXU.B  @(-0x0E0E,R0), R0
      MULXU.B  @(-0x0E0E,R0), FP
      SUBX.B   @(-0x0E0E,R0), R0
      SUBX.B   @(-0x0E0E,R0), FP
      DIVXU.B  @(-0x0E0E,R0), R0
      DIVXU.B  @(-0x0E0E,R0), FP
      BSET.B   #0, @(-0x0E0E,R0)
      BCLR.B   #0, @(-0x0E0E,R0)
      BNOT.B   #0, @(-0x0E0E,R0)
      MOVFPE   @(-0x0808,FP), R0
      MOVFPE   @(-0x0808,FP), FP
      MOVTPE   R0, @(-0x0808,FP)
      MOVTPE   FP, @(-0x0808,FP)
      CMP:G.B  #5, @(-0x0808,FP)
      MOV:G.B  #7, @(-0x0808,FP)
      ADD:Q.B  #1, @(-0x0808,FP)
      CLR.B    @(-0x0808,FP)
      NEG.B    @(-0x0808,FP)
      NOT.B    @(-0x0808,FP)
      TST.B    @(-0x0808,FP)
      TAS      @(-0x0808,FP)
      SHAL.B   @(-0x0808,FP)
      SHAR.B   @(-0x0808,FP)
      SHLL.B   @(-0x0808,FP)
      SHLR.B   @(-0x0808,FP)
      ROTL.B   @(-0x0808,FP)
      ROTR.B   @(-0x0808,FP)
      ROTXL.B  @(-0x0808,FP)
      ROTXR.B  @(-0x0808,FP)
      ADD:G.B  @(-0x0808,FP), R0
      ADD:G.B  @(-0x0808,FP), FP
      ADDS.B   @(-0x0808,FP), R0
      ADDS.B   @(-0x0808,FP), FP
      SUB.B    @(-0x0808,FP), R0
      SUB.B    @(-0x0808,FP), FP
      SUBS.B   @(-0x0808,FP), R0
      SUBS.B   @(-0x0808,FP), FP
      OR.B     @(-0x0808,FP), R0
      OR.B     @(-0x0808,FP), FP
      BSET.B   R0, @(-0x0808,FP)
      BSET.B   FP, @(-0x0808,FP)
      AND.B    @(-0x0808,FP), R0
      AND.B    @(-0x0808,FP), FP
      BCLR.B   R0, @(-0x0808,FP)
      BCLR.B   FP, @(-0x0808,FP)
      XOR.B    @(-0x0808,FP), R0
      XOR.B    @(-0x0808,FP), FP
      BNOT.B   R0, @(-0x0808,FP)
      BNOT.B   FP, @(-0x0808,FP)
      CMP:G.B  @(-0x0808,FP), R0
      CMP:G.B  @(-0x0808,FP), FP
      BTST.B   R0, @(-0x0808,FP)
      BTST.B   FP, @(-0x0808,FP)
      MOV:G.B  @(-0x0808,FP), R0
      MOV:G.B  @(-0x0808,FP), FP
      LDC      @(-0x0808,FP), CCR
      LDC      @(-0x0808,FP), BR
      LDC      @(-0x0808,FP), EP
      LDC      @(-0x0808,FP), DP
      LDC      @(-0x0808,FP), TP
      MOV:G.B  R0, @(-0x0808,FP)
      MOV:G.B  FP, @(-0x0808,FP)
      STC      CCR, @(-0x0808,FP)
      STC      BR, @(-0x0808,FP)
      STC      EP, @(-0x0808,FP)
      STC      DP, @(-0x0808,FP)
      STC      TP, @(-0x0808,FP)
      ADDX.B   @(-0x0808,FP), R0
      ADDX.B   @(-0x0808,FP), FP
      MULXU.B  @(-0x0808,FP), R0
      MULXU.B  @(-0x0808,FP), FP
      SUBX.B   @(-0x0808,FP), R0
      SUBX.B   @(-0x0808,FP), FP
      DIVXU.B  @(-0x0808,FP), R0
      DIVXU.B  @(-0x0808,FP), FP
      BSET.B   #0, @(-0x0808,FP)
      BCLR.B   #0, @(-0x0808,FP)
      BNOT.B   #0, @(-0x0808,FP)
      BTST.B   #0, @(-0x0808,FP)
      MOVFPE   @(-0x0707,SP), R0
      MOVFPE   @(-0x0707,SP), FP
      MOVTPE   R0, @(-0x0707,SP)
      MOVTPE   FP, @(-0x0707,SP)
      CMP:G.B  #5, @(-0x0707,SP)
      MOV:G.B  #7, @(-0x0707,SP)
      ADD:Q.B  #1, @(-0x0707,SP)
      CLR.B    @(-0x0707,SP)
      NEG.B    @(-0x0707,SP)
      NOT.B    @(-0x0707,SP)
      TST.B    @(-0x0707,SP)
      TAS      @(-0x0707,SP)
      SHAL.B   @(-0x0707,SP)
      SHAR.B   @(-0x0707,SP)
      SHLL.B   @(-0x0707,SP)
      SHLR.B   @(-0x0707,SP)
      ROTL.B   @(-0x0707,SP)
      ROTR.B   @(-0x0707,SP)
      ROTXL.B  @(-0x0707,SP)
      ROTXR.B  @(-0x0707,SP)
      ADD:G.B  @(-0x0707,SP), R0
      ADD:G.B  @(-0x0707,SP), FP
      ADDS.B   @(-0x0707,SP), R0
      ADDS.B   @(-0x0707,SP), FP
      SUB.B    @(-0x0707,SP), R0
      SUB.B    @(-0x0707,SP), FP
      SUBS.B   @(-0x0707,SP), R0
      SUBS.B   @(-0x0707,SP), FP
      OR.B     @(-0x0707,SP), R0
      OR.B     @(-0x0707,SP), FP
      BSET.B   R0, @(-0x0707,SP)
      BSET.B   FP, @(-0x0707,SP)
      AND.B    @(-0x0707,SP), R0
      AND.B    @(-0x0707,SP), FP
      BCLR.B   R0, @(-0x0707,SP)
      BCLR.B   FP, @(-0x0707,SP)
      XOR.B    @(-0x0707,SP), R0
      XOR.B    @(-0x0707,SP), FP
      BNOT.B   R0, @(-0x0707,SP)
      BNOT.B   FP, @(-0x0707,SP)
      CMP:G.B  @(-0x0707,SP), R0
      CMP:G.B  @(-0x0707,SP), FP
      BTST.B   R0, @(-0x0707,SP)
      BTST.B   FP, @(-0x0707,SP)
      MOV:G.B  @(-0x0707,SP), R0
      MOV:G.B  @(-0x0707,SP), FP
      LDC      @(-0x0707,SP), CCR
      LDC      @(-0x0707,SP), BR
      LDC      @(-0x0707,SP), EP
      LDC      @(-0x0707,SP), DP
      LDC      @(-0x0707,SP), TP
      MOV:G.B  R0, @(-0x0707,SP)
      MOV:G.B  FP, @(-0x0707,SP)
      STC      CCR, @(-0x0707,SP)
      STC      BR, @(-0x0707,SP)
      STC      EP, @(-0x0707,SP)
      STC      DP, @(-0x0707,SP)
      STC      TP, @(-0x0707,SP)
      ADDX.B   @(-0x0707,SP), R0
      ADDX.B   @(-0x0707,SP), FP
      MULXU.B  @(-0x0707,SP), R0
      MULXU.B  @(-0x0707,SP), FP
      SUBX.B   @(-0x0707,SP), R0
      SUBX.B   @(-0x0707,SP), FP
      DIVXU.B  @(-0x0707,SP), R0
      DIVXU.B  @(-0x0707,SP), FP
      BSET.B   #0, @(-0x0707,SP)
      BCLR.B   #0, @(-0x0707,SP)
      BNOT.B   #0, @(-0x0707,SP)
      BTST.B   #0, @(-0x0707,SP)
      BTST.W   #11, @(-0x0606,R0)
      CMP:G.W  #0x0607, @(0x0304,R0)
      MOV:G.W  #0x0809, @(0x0506,R0)
      ADD:Q.W  #1, @(0x0506,R0)
      CLR.W    @(0x0506,R0)
      NEG.W    @(0x0506,R0)
      NOT.W    @(0x0506,R0)
      TST.W    @(0x0506,R0)
      SHAL.W   @(0x0506,R0)
      SHAR.W   @(0x0506,R0)
      SHLL.W   @(0x0506,R0)
      SHLR.W   @(0x0506,R0)
      ROTL.W   @(0x0506,R0)
      ROTR.W   @(0x0506,R0)
      ROTXL.W  @(0x0506,R0)
      ROTXR.W  @(0x0506,R0)
      ADD:G.W  @(0x0506,R0), R0
      ADD:G.W  @(0x0506,R0), FP
      ADDS.W   @(0x0506,R0), R0
      ADDS.W   @(0x0506,R0), FP
      SUB.W    @(0x0506,R0), R0
      SUB.W    @(0x0506,R0), FP
      SUBS.W   @(0x0506,R0), R0
      SUBS.W   @(0x0506,R0), FP
      OR.W     @(0x0506,R0), R0
      OR.W     @(0x0506,R0), FP
      BSET.W   R0, @(0x0506,R0)
      BSET.W   FP, @(0x0506,R0)
      AND.W    @(0x0506,R0), R0
      AND.W    @(0x0506,R0), FP
      BCLR.W   R0, @(0x0506,R0)
      BCLR.W   FP, @(0x0506,R0)
      XOR.W    @(0x0506,R0), R0
      XOR.W    @(0x0506,R0), FP
      BNOT.W   R0, @(0x0506,R0)
      BNOT.W   FP, @(0x0506,R0)
      CMP:G.W  @(0x0506,R0), R0
      CMP:G.W  @(0x0506,R0), FP
      BTST.W   R0, @(0x0506,R0)
      BTST.W   FP, @(0x0506,R0)
      MOV:G.W  @(0x0506,R0), R0
      MOV:G.W  @(0x0506,R0), FP
      LDC      @(0x0506,R0), SR
      MOV:G.W  R0, @(0x0506,R0)
      MOV:G.W  FP, @(0x0506,R0)
      STC      SR, @(0x0506,R0)
      ADDX.W   @(0x0506,R0), R0
      ADDX.W   @(0x0506,R0), FP
      MULXU.W  @(0x0506,R0), R0
      MULXU.W  @(0x0506,R0), FP
      SUBX.W   @(0x0506,R0), R0
      SUBX.W   @(0x0506,R0), FP
      DIVXU.W  @(0x0506,R0), R0
      DIVXU.W  @(0x0506,R0), FP
      BSET.W   #0, @(0x0506,R0)
      BCLR.W   #0, @(0x0506,R0)
      BNOT.W   #0, @(0x0506,R0)
      CMP:G.W  #0x0607, @(0x0304,FP)
      MOV:G.W  #0x0809, @(0x0506,FP)
      ADD:Q.W  #1, @(0x0506,FP)
      CLR.W    @(0x0506,FP)
      NEG.W    @(0x0506,FP)
      NOT.W    @(0x0506,FP)
      TST.W    @(0x0506,FP)
      SHAL.W   @(0x0506,FP)
      SHAR.W   @(0x0506,FP)
      SHLL.W   @(0x0506,FP)
      SHLR.W   @(0x0506,FP)
      ROTL.W   @(0x0506,FP)
      ROTR.W   @(0x0506,FP)
      ROTXL.W  @(0x0506,FP)
      ROTXR.W  @(0x0506,FP)
      ADD:G.W  @(0x0506,FP), R0
      ADD:G.W  @(0x0506,FP), FP
      ADDS.W   @(0x0506,FP), R0
      ADDS.W   @(0x0506,FP), FP
      SUB.W    @(0x0506,FP), R0
      SUB.W    @(0x0506,FP), FP
      SUBS.W   @(0x0506,FP), R0
      SUBS.W   @(0x0506,FP), FP
      OR.W     @(0x0506,FP), R0
      OR.W     @(0x0506,FP), FP
      BSET.W   R0, @(0x0506,FP)
      BSET.W   FP, @(0x0506,FP)
      AND.W    @(0x0506,FP), R0
      AND.W    @(0x0506,FP), FP
      BCLR.W   R0, @(0x0506,FP)
      BCLR.W   FP, @(0x0506,FP)
      XOR.W    @(0x0506,FP), R0
      XOR.W    @(0x0506,FP), FP
      BNOT.W   R0, @(0x0506,FP)
      BNOT.W   FP, @(0x0506,FP)
      CMP:G.W  @(0x0506,FP), R0
      CMP:G.W  @(0x0506,FP), FP
      BTST.W   R0, @(0x0506,FP)
      BTST.W   FP, @(0x0506,FP)
      MOV:G.W  @(0x0506,FP), R0
      MOV:G.W  @(0x0506,FP), FP
      LDC      @(0x0506,FP), SR
      MOV:G.W  R0, @(0x0506,FP)
      MOV:G.W  FP, @(0x0506,FP)
      STC      SR, @(0x0506,FP)
      ADDX.W   @(0x0506,FP), R0
      ADDX.W   @(0x0506,FP), FP
      MULXU.W  @(0x0506,FP), R0
      MULXU.W  @(0x0506,FP), FP
      SUBX.W   @(0x0506,FP), R0
      SUBX.W   @(0x0506,FP), FP
      DIVXU.W  @(0x0506,FP), R0
      DIVXU.W  @(0x0506,FP), FP
      BSET.W   #0, @(0x0506,FP)
      BCLR.W   #0, @(0x0506,FP)
      BNOT.W   #0, @(0x0506,FP)
      BTST.W   #0, @(0x0506,FP)
      CMP:G.W  #0x0607, @(0x0304,SP)
      MOV:G.W  #0x0809, @(0x0506,SP)
      ADD:Q.W  #1, @(0x0506,SP)
      CLR.W    @(0x0506,SP)
      NEG.W    @(0x0506,SP)
      NOT.W    @(0x0506,SP)
      TST.W    @(0x0506,SP)
      SHAL.W   @(0x0506,SP)
      SHAR.W   @(0x0506,SP)
      SHLL.W   @(0x0506,SP)
      SHLR.W   @(0x0506,SP)
      ROTL.W   @(0x0506,SP)
      ROTR.W   @(0x0506,SP)
      ROTXL.W  @(0x0506,SP)
      ROTXR.W  @(0x0506,SP)
      ADD:G.W  @(0x0506,SP), R0
      ADD:G.W  @(0x0506,SP), FP
      ADDS.W   @(0x0506,SP), R0
      ADDS.W   @(0x0506,SP), FP
      SUB.W    @(0x0506,SP), R0
      SUB.W    @(0x0506,SP), FP
      SUBS.W   @(0x0506,SP), R0
      SUBS.W   @(0x0506,SP), FP
      OR.W     @(0x0506,SP), R0
      OR.W     @(0x0506,SP), FP
      BSET.W   R0, @(0x0506,SP)
      BSET.W   FP, @(0x0506,SP)
      AND.W    @(0x0506,SP), R0
      AND.W    @(0x0506,SP), FP
      BCLR.W   R0, @(0x0506,SP)
      BCLR.W   FP, @(0x0506,SP)
      XOR.W    @(0x0506,SP), R0
      XOR.W    @(0x0506,SP), FP
      BNOT.W   R0, @(0x0506,SP)
      BNOT.W   FP, @(0x0506,SP)
      CMP:G.W  @(0x0506,SP), R0
      CMP:G.W  @(0x0506,SP), FP
      BTST.W   R0, @(0x0506,SP)
      BTST.W   FP, @(0x0506,SP)
      MOV:G.W  @(0x0506,SP), R0
      MOV:G.W  @(0x0506,SP), FP
      LDC      @(0x0506,SP), SR
      MOV:G.W  R0, @(0x0506,SP)
      MOV:G.W  FP, @(0x0506,SP)
      STC      SR, @(0x0506,SP)
      ADDX.W   @(0x0506,SP), R0
      ADDX.W   @(0x0506,SP), FP
      MULXU.W  @(0x0506,SP), R0
      MULXU.W  @(0x0506,SP), FP
      SUBX.W   @(0x0506,SP), R0
      SUBX.W   @(0x0506,SP), FP
      DIVXU.W  @(0x0506,SP), R0
      DIVXU.W  @(0x0506,SP), FP
      BSET.W   #0, @(0x0506,SP)
      BCLR.W   #0, @(0x0506,SP)
      BNOT.W   #0, @(0x0506,SP)
      BTST.W   #0, @(0x0506,SP)
