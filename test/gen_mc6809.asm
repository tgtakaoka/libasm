;;; AUTO GENERATED FILE
;;; generated by: gen_mc6809 -u -C 6809 -o gen_mc6809.asm
      CPU 6809
      NEG   $01
      COM   $04
      LSR   $05
      ROR   $07
      ASR   $08
      ASL   $09
      ROL   $0A
      DEC   $0B
      INC   $0D
      TST   $0E
      JMP   $0F
      CLR   $10
      NOP
      SYNC
      LBRA  *+26
      LBSR  *+27
      DAA
      ORCC  #27
      ANDCC #29
      SEX
      EXG   Y,D
      EXG   Y,X
      EXG   Y,Y
      EXG   Y,U
      EXG   Y,S
      EXG   Y,PC
      EXG   U,D
      EXG   U,X
      EXG   U,Y
      EXG   U,U
      EXG   U,S
      EXG   U,PC
      EXG   S,D
      EXG   S,X
      EXG   S,Y
      EXG   S,U
      EXG   S,S
      EXG   S,PC
      EXG   PC,D
      EXG   PC,X
      EXG   PC,Y
      EXG   PC,U
      EXG   PC,S
      EXG   PC,PC
      EXG   A,A
      EXG   A,B
      EXG   A,CC
      EXG   A,DP
      EXG   B,A
      EXG   B,B
      EXG   B,CC
      EXG   B,DP
      EXG   CC,A
      EXG   CC,B
      EXG   CC,CC
      EXG   CC,DP
      EXG   DP,A
      EXG   DP,B
      EXG   DP,CC
      EXG   DP,DP
      EXG   D,D
      EXG   D,X
      EXG   D,Y
      EXG   D,U
      EXG   D,S
      EXG   D,PC
      EXG   X,D
      EXG   X,X
      EXG   X,Y
      EXG   X,U
      EXG   X,S
      EXG   X,PC
      TFR   Y,D
      TFR   Y,X
      TFR   Y,Y
      TFR   Y,U
      TFR   Y,S
      TFR   Y,PC
      TFR   U,D
      TFR   U,X
      TFR   U,Y
      TFR   U,U
      TFR   U,S
      TFR   U,PC
      TFR   S,D
      TFR   S,X
      TFR   S,Y
      TFR   S,U
      TFR   S,S
      TFR   S,PC
      TFR   PC,D
      TFR   PC,X
      TFR   PC,Y
      TFR   PC,U
      TFR   PC,S
      TFR   PC,PC
      TFR   A,A
      TFR   A,B
      TFR   A,CC
      TFR   A,DP
      TFR   B,A
      TFR   B,B
      TFR   B,CC
      TFR   B,DP
      TFR   CC,A
      TFR   CC,B
      TFR   CC,CC
      TFR   CC,DP
      TFR   DP,A
      TFR   DP,B
      TFR   DP,CC
      TFR   DP,DP
      TFR   D,D
      TFR   D,X
      TFR   D,Y
      TFR   D,U
      TFR   D,S
      TFR   D,PC
      TFR   X,D
      TFR   X,X
      TFR   X,Y
      TFR   X,U
      TFR   X,S
      TFR   X,PC
      BRA   *+35
      BRA   *-126
      BRA   *
      BRN   *+36
      BRN   *-126
      BRN   *
      BHI   *+37
      BHI   *-126
      BHI   *
      BLS   *+38
      BLS   *-126
      BLS   *
      BHS   *+39
      BHS   *-126
      BHS   *
      BLO   *+40
      BLO   *-126
      BLO   *
      BNE   *+41
      BNE   *-126
      BNE   *
      BEQ   *+42
      BEQ   *-126
      BEQ   *
      BVC   *+43
      BVC   *-126
      BVC   *
      BVS   *+44
      BVS   *-126
      BVS   *
      BPL   *+45
      BPL   *-126
      BPL   *
      BMI   *+46
      BMI   *-126
      BMI   *
      BGE   *+47
      BGE   *-126
      BGE   *
      BLT   *+48
      BLT   *-126
      BLT   *
      BGT   *+49
      BGT   *-126
      BGT   *
      BLE   *+50
      BLE   *-126
      BLE   *
      LEAX  -15,Y
      LEAX  <<0,U
      LEAX  1,U
      LEAX  -16,U
      LEAX  <<0,S
      LEAX  1,S
      LEAX  -16,S
      LEAX  ,X+
      LEAX  ,X++
      LEAX  ,-X
      LEAX  ,--X
      LEAX  ,X
      LEAX  B,X
      LEAX  A,X
      LEAX  -119,X
      LEAX  <-16,X
      LEAX  <0,X
      LEAX  16,X
      LEAX  $008A,X
      LEAX  D,X
      LEAX  *-112,PCR
      LEAX  *,PCR
      LEAX  *+1,PCR
      LEAX  *+$0092,PCR
      LEAX  [,X++]
      LEAX  [,--X]
      LEAX  [,X]
      LEAX  [B,X]
      LEAX  [A,X]
      LEAX  [-103,X]
      LEAX  [<0,X]
      LEAX  [1,X]
      LEAX  [$009A,X]
      LEAX  [D,X]
      LEAX  [*-96,PCR]
      LEAX  [*,PCR]
      LEAX  [*+1,PCR]
      LEAX  [*+$00A2,PCR]
      LEAX  [$00A0]
      LEAX  ,Y+
      LEAX  ,Y++
      LEAX  ,-Y
      LEAX  ,--Y
      LEAX  ,Y
      LEAX  B,Y
      LEAX  A,Y
      LEAX  -87,Y
      LEAX  <-16,Y
      LEAX  <0,Y
      LEAX  16,Y
      LEAX  $00AA,Y
      LEAX  D,Y
      LEAX  [,Y++]
      LEAX  [,--Y]
      LEAX  [,Y]
      LEAX  [B,Y]
      LEAX  [A,Y]
      LEAX  [-71,Y]
      LEAX  [<0,Y]
      LEAX  [1,Y]
      LEAX  [$00BA,Y]
      LEAX  [D,Y]
      LEAX  ,U+
      LEAX  ,U++
      LEAX  ,-U
      LEAX  ,--U
      LEAX  ,U
      LEAX  B,U
      LEAX  A,U
      LEAX  -55,U
      LEAX  <-16,U
      LEAX  <0,U
      LEAX  16,U
      LEAX  $00CA,U
      LEAX  D,U
      LEAX  [,U++]
      LEAX  [,--U]
      LEAX  [,U]
      LEAX  [B,U]
      LEAX  [A,U]
      LEAX  [-39,U]
      LEAX  [<0,U]
      LEAX  [1,U]
      LEAX  [$00DA,U]
      LEAX  [D,U]
      LEAX  ,S+
      LEAX  ,S++
      LEAX  ,-S
      LEAX  ,--S
      LEAX  ,S
      LEAX  B,S
      LEAX  A,S
      LEAX  -23,S
      LEAX  <-16,S
      LEAX  <0,S
      LEAX  16,S
      LEAX  $00EA,S
      LEAX  D,S
      LEAX  [,S++]
      LEAX  [,--S]
      LEAX  [,S]
      LEAX  [B,S]
      LEAX  [A,S]
      LEAX  [-7,S]
      LEAX  [<0,S]
      LEAX  [1,S]
      LEAX  [$00FA,S]
      LEAX  [D,S]
      LEAX  <<0,X
      LEAX  1,X
      LEAX  -16,X
      LEAX  <<0,Y
      LEAX  1,Y
      LEAY  -14,Y
      LEAY  <<0,U
      LEAY  1,U
      LEAY  -16,U
      LEAY  <<0,S
      LEAY  1,S
      LEAY  -16,S
      LEAY  ,X+
      LEAY  ,X++
      LEAY  ,-X
      LEAY  ,--X
      LEAY  ,X
      LEAY  B,X
      LEAY  A,X
      LEAY  -119,X
      LEAY  <-16,X
      LEAY  <0,X
      LEAY  16,X
      LEAY  $008A,X
      LEAY  D,X
      LEAY  *-112,PCR
      LEAY  *,PCR
      LEAY  *+1,PCR
      LEAY  *+$0092,PCR
      LEAY  [,X++]
      LEAY  [,--X]
      LEAY  [,X]
      LEAY  [B,X]
      LEAY  [A,X]
      LEAY  [-103,X]
      LEAY  [<0,X]
      LEAY  [1,X]
      LEAY  [$009A,X]
      LEAY  [D,X]
      LEAY  [*-96,PCR]
      LEAY  [*,PCR]
      LEAY  [*+1,PCR]
      LEAY  [*+$00A2,PCR]
      LEAY  [$00A0]
      LEAY  ,Y+
      LEAY  ,Y++
      LEAY  ,-Y
      LEAY  ,--Y
      LEAY  ,Y
      LEAY  B,Y
      LEAY  A,Y
      LEAY  -87,Y
      LEAY  <-16,Y
      LEAY  <0,Y
      LEAY  16,Y
      LEAY  $00AA,Y
      LEAY  D,Y
      LEAY  [,Y++]
      LEAY  [,--Y]
      LEAY  [,Y]
      LEAY  [B,Y]
      LEAY  [A,Y]
      LEAY  [-71,Y]
      LEAY  [<0,Y]
      LEAY  [1,Y]
      LEAY  [$00BA,Y]
      LEAY  [D,Y]
      LEAY  ,U+
      LEAY  ,U++
      LEAY  ,-U
      LEAY  ,--U
      LEAY  ,U
      LEAY  B,U
      LEAY  A,U
      LEAY  -55,U
      LEAY  <-16,U
      LEAY  <0,U
      LEAY  16,U
      LEAY  $00CA,U
      LEAY  D,U
      LEAY  [,U++]
      LEAY  [,--U]
      LEAY  [,U]
      LEAY  [B,U]
      LEAY  [A,U]
      LEAY  [-39,U]
      LEAY  [<0,U]
      LEAY  [1,U]
      LEAY  [$00DA,U]
      LEAY  [D,U]
      LEAY  ,S+
      LEAY  ,S++
      LEAY  ,-S
      LEAY  ,--S
      LEAY  ,S
      LEAY  B,S
      LEAY  A,S
      LEAY  -23,S
      LEAY  <-16,S
      LEAY  <0,S
      LEAY  16,S
      LEAY  $00EA,S
      LEAY  D,S
      LEAY  [,S++]
      LEAY  [,--S]
      LEAY  [,S]
      LEAY  [B,S]
      LEAY  [A,S]
      LEAY  [-7,S]
      LEAY  [<0,S]
      LEAY  [1,S]
      LEAY  [$00FA,S]
      LEAY  [D,S]
      LEAY  <<0,X
      LEAY  1,X
      LEAY  -16,X
      LEAY  <<0,Y
      LEAY  1,Y
      LEAS  -13,Y
      LEAS  <<0,U
      LEAS  1,U
      LEAS  -16,U
      LEAS  <<0,S
      LEAS  1,S
      LEAS  -16,S
      LEAS  ,X+
      LEAS  ,X++
      LEAS  ,-X
      LEAS  ,--X
      LEAS  ,X
      LEAS  B,X
      LEAS  A,X
      LEAS  -119,X
      LEAS  <-16,X
      LEAS  <0,X
      LEAS  16,X
      LEAS  $008A,X
      LEAS  D,X
      LEAS  *-112,PCR
      LEAS  *,PCR
      LEAS  *+1,PCR
      LEAS  *+$0092,PCR
      LEAS  [,X++]
      LEAS  [,--X]
      LEAS  [,X]
      LEAS  [B,X]
      LEAS  [A,X]
      LEAS  [-103,X]
      LEAS  [<0,X]
      LEAS  [1,X]
      LEAS  [$009A,X]
      LEAS  [D,X]
      LEAS  [*-96,PCR]
      LEAS  [*,PCR]
      LEAS  [*+1,PCR]
      LEAS  [*+$00A2,PCR]
      LEAS  [$00A0]
      LEAS  ,Y+
      LEAS  ,Y++
      LEAS  ,-Y
      LEAS  ,--Y
      LEAS  ,Y
      LEAS  B,Y
      LEAS  A,Y
      LEAS  -87,Y
      LEAS  <-16,Y
      LEAS  <0,Y
      LEAS  16,Y
      LEAS  $00AA,Y
      LEAS  D,Y
      LEAS  [,Y++]
      LEAS  [,--Y]
      LEAS  [,Y]
      LEAS  [B,Y]
      LEAS  [A,Y]
      LEAS  [-71,Y]
      LEAS  [<0,Y]
      LEAS  [1,Y]
      LEAS  [$00BA,Y]
      LEAS  [D,Y]
      LEAS  ,U+
      LEAS  ,U++
      LEAS  ,-U
      LEAS  ,--U
      LEAS  ,U
      LEAS  B,U
      LEAS  A,U
      LEAS  -55,U
      LEAS  <-16,U
      LEAS  <0,U
      LEAS  16,U
      LEAS  $00CA,U
      LEAS  D,U
      LEAS  [,U++]
      LEAS  [,--U]
      LEAS  [,U]
      LEAS  [B,U]
      LEAS  [A,U]
      LEAS  [-39,U]
      LEAS  [<0,U]
      LEAS  [1,U]
      LEAS  [$00DA,U]
      LEAS  [D,U]
      LEAS  ,S+
      LEAS  ,S++
      LEAS  ,-S
      LEAS  ,--S
      LEAS  ,S
      LEAS  B,S
      LEAS  A,S
      LEAS  -23,S
      LEAS  <-16,S
      LEAS  <0,S
      LEAS  16,S
      LEAS  $00EA,S
      LEAS  D,S
      LEAS  [,S++]
      LEAS  [,--S]
      LEAS  [,S]
      LEAS  [B,S]
      LEAS  [A,S]
      LEAS  [-7,S]
      LEAS  [<0,S]
      LEAS  [1,S]
      LEAS  [$00FA,S]
      LEAS  [D,S]
      LEAS  <<0,X
      LEAS  1,X
      LEAS  -16,X
      LEAS  <<0,Y
      LEAS  1,Y
      LEAU  -12,Y
      LEAU  <<0,U
      LEAU  1,U
      LEAU  -16,U
      LEAU  <<0,S
      LEAU  1,S
      LEAU  -16,S
      LEAU  ,X+
      LEAU  ,X++
      LEAU  ,-X
      LEAU  ,--X
      LEAU  ,X
      LEAU  B,X
      LEAU  A,X
      LEAU  -119,X
      LEAU  <-16,X
      LEAU  <0,X
      LEAU  16,X
      LEAU  $008A,X
      LEAU  D,X
      LEAU  *-112,PCR
      LEAU  *,PCR
      LEAU  *+1,PCR
      LEAU  *+$0092,PCR
      LEAU  [,X++]
      LEAU  [,--X]
      LEAU  [,X]
      LEAU  [B,X]
      LEAU  [A,X]
      LEAU  [-103,X]
      LEAU  [<0,X]
      LEAU  [1,X]
      LEAU  [$009A,X]
      LEAU  [D,X]
      LEAU  [*-96,PCR]
      LEAU  [*,PCR]
      LEAU  [*+1,PCR]
      LEAU  [*+$00A2,PCR]
      LEAU  [$00A0]
      LEAU  ,Y+
      LEAU  ,Y++
      LEAU  ,-Y
      LEAU  ,--Y
      LEAU  ,Y
      LEAU  B,Y
      LEAU  A,Y
      LEAU  -87,Y
      LEAU  <-16,Y
      LEAU  <0,Y
      LEAU  16,Y
      LEAU  $00AA,Y
      LEAU  D,Y
      LEAU  [,Y++]
      LEAU  [,--Y]
      LEAU  [,Y]
      LEAU  [B,Y]
      LEAU  [A,Y]
      LEAU  [-71,Y]
      LEAU  [<0,Y]
      LEAU  [1,Y]
      LEAU  [$00BA,Y]
      LEAU  [D,Y]
      LEAU  ,U+
      LEAU  ,U++
      LEAU  ,-U
      LEAU  ,--U
      LEAU  ,U
      LEAU  B,U
      LEAU  A,U
      LEAU  -55,U
      LEAU  <-16,U
      LEAU  <0,U
      LEAU  16,U
      LEAU  $00CA,U
      LEAU  D,U
      LEAU  [,U++]
      LEAU  [,--U]
      LEAU  [,U]
      LEAU  [B,U]
      LEAU  [A,U]
      LEAU  [-39,U]
      LEAU  [<0,U]
      LEAU  [1,U]
      LEAU  [$00DA,U]
      LEAU  [D,U]
      LEAU  ,S+
      LEAU  ,S++
      LEAU  ,-S
      LEAU  ,--S
      LEAU  ,S
      LEAU  B,S
      LEAU  A,S
      LEAU  -23,S
      LEAU  <-16,S
      LEAU  <0,S
      LEAU  16,S
      LEAU  $00EA,S
      LEAU  D,S
      LEAU  [,S++]
      LEAU  [,--S]
      LEAU  [,S]
      LEAU  [B,S]
      LEAU  [A,S]
      LEAU  [-7,S]
      LEAU  [<0,S]
      LEAU  [1,S]
      LEAU  [$00FA,S]
      LEAU  [D,S]
      LEAU  <<0,X
      LEAU  1,X
      LEAU  -16,X
      LEAU  <<0,Y
      LEAU  1,Y
      PSHS  Y,X,B,CC
      PSHS  Y,X,D
      PSHS  Y,X,D,CC
      PSHS  Y,X,DP
      PSHS  Y,X,DP,CC
      PSHS  Y,X,DP,A
      PSHS  Y,X,DP,A,CC
      PSHS  Y,X,DP,B
      PSHS  Y,X,DP,B,CC
      PSHS  Y,X,DP,D
      PSHS  Y,X,DP,D,CC
      PSHS  U
      PSHS  U,CC
      PSHS  U,A
      PSHS  U,A,CC
      PSHS  U,B
      PSHS  U,B,CC
      PSHS  U,D
      PSHS  U,D,CC
      PSHS  U,DP
      PSHS  U,DP,CC
      PSHS  U,DP,A
      PSHS  U,DP,A,CC
      PSHS  U,DP,B
      PSHS  U,DP,B,CC
      PSHS  U,DP,D
      PSHS  U,DP,D,CC
      PSHS  U,X
      PSHS  U,X,CC
      PSHS  U,X,A
      PSHS  U,X,A,CC
      PSHS  U,X,B
      PSHS  U,X,B,CC
      PSHS  U,X,D
      PSHS  U,X,D,CC
      PSHS  U,X,DP
      PSHS  U,X,DP,CC
      PSHS  U,X,DP,A
      PSHS  U,X,DP,A,CC
      PSHS  U,X,DP,B
      PSHS  U,X,DP,B,CC
      PSHS  U,X,DP,D
      PSHS  U,X,DP,D,CC
      PSHS  U,Y
      PSHS  U,Y,CC
      PSHS  U,Y,A
      PSHS  U,Y,A,CC
      PSHS  U,Y,B
      PSHS  U,Y,B,CC
      PSHS  U,Y,D
      PSHS  U,Y,D,CC
      PSHS  U,Y,DP
      PSHS  U,Y,DP,CC
      PSHS  U,Y,DP,A
      PSHS  U,Y,DP,A,CC
      PSHS  U,Y,DP,B
      PSHS  U,Y,DP,B,CC
      PSHS  U,Y,DP,D
      PSHS  U,Y,DP,D,CC
      PSHS  U,Y,X
      PSHS  U,Y,X,CC
      PSHS  U,Y,X,A
      PSHS  U,Y,X,A,CC
      PSHS  U,Y,X,B
      PSHS  U,Y,X,B,CC
      PSHS  U,Y,X,D
      PSHS  U,Y,X,D,CC
      PSHS  U,Y,X,DP
      PSHS  U,Y,X,DP,CC
      PSHS  U,Y,X,DP,A
      PSHS  U,Y,X,DP,A,CC
      PSHS  U,Y,X,DP,B
      PSHS  U,Y,X,DP,B,CC
      PSHS  U,Y,X,DP,D
      PSHS  U,Y,X,DP,D,CC
      PSHS  PC
      PSHS  PC,CC
      PSHS  PC,A
      PSHS  PC,A,CC
      PSHS  PC,B
      PSHS  PC,B,CC
      PSHS  PC,D
      PSHS  PC,D,CC
      PSHS  PC,DP
      PSHS  PC,DP,CC
      PSHS  PC,DP,A
      PSHS  PC,DP,A,CC
      PSHS  PC,DP,B
      PSHS  PC,DP,B,CC
      PSHS  PC,DP,D
      PSHS  PC,DP,D,CC
      PSHS  PC,X
      PSHS  PC,X,CC
      PSHS  PC,X,A
      PSHS  PC,X,A,CC
      PSHS  PC,X,B
      PSHS  PC,X,B,CC
      PSHS  PC,X,D
      PSHS  PC,X,D,CC
      PSHS  PC,X,DP
      PSHS  PC,X,DP,CC
      PSHS  PC,X,DP,A
      PSHS  PC,X,DP,A,CC
      PSHS  PC,X,DP,B
      PSHS  PC,X,DP,B,CC
      PSHS  PC,X,DP,D
      PSHS  PC,X,DP,D,CC
      PSHS  PC,Y
      PSHS  PC,Y,CC
      PSHS  PC,Y,A
      PSHS  PC,Y,A,CC
      PSHS  PC,Y,B
      PSHS  PC,Y,B,CC
      PSHS  PC,Y,D
      PSHS  PC,Y,D,CC
      PSHS  PC,Y,DP
      PSHS  PC,Y,DP,CC
      PSHS  PC,Y,DP,A
      PSHS  PC,Y,DP,A,CC
      PSHS  PC,Y,DP,B
      PSHS  PC,Y,DP,B,CC
      PSHS  PC,Y,DP,D
      PSHS  PC,Y,DP,D,CC
      PSHS  PC,Y,X
      PSHS  PC,Y,X,CC
      PSHS  PC,Y,X,A
      PSHS  PC,Y,X,A,CC
      PSHS  PC,Y,X,B
      PSHS  PC,Y,X,B,CC
      PSHS  PC,Y,X,D
      PSHS  PC,Y,X,D,CC
      PSHS  PC,Y,X,DP
      PSHS  PC,Y,X,DP,CC
      PSHS  PC,Y,X,DP,A
      PSHS  PC,Y,X,DP,A,CC
      PSHS  PC,Y,X,DP,B
      PSHS  PC,Y,X,DP,B,CC
      PSHS  PC,Y,X,DP,D
      PSHS  PC,Y,X,DP,D,CC
      PSHS  PC,U
      PSHS  PC,U,CC
      PSHS  PC,U,A
      PSHS  PC,U,A,CC
      PSHS  PC,U,B
      PSHS  PC,U,B,CC
      PSHS  PC,U,D
      PSHS  PC,U,D,CC
      PSHS  PC,U,DP
      PSHS  PC,U,DP,CC
      PSHS  PC,U,DP,A
      PSHS  PC,U,DP,A,CC
      PSHS  PC,U,DP,B
      PSHS  PC,U,DP,B,CC
      PSHS  PC,U,DP,D
      PSHS  PC,U,DP,D,CC
      PSHS  PC,U,X
      PSHS  PC,U,X,CC
      PSHS  PC,U,X,A
      PSHS  PC,U,X,A,CC
      PSHS  PC,U,X,B
      PSHS  PC,U,X,B,CC
      PSHS  PC,U,X,D
      PSHS  PC,U,X,D,CC
      PSHS  PC,U,X,DP
      PSHS  PC,U,X,DP,CC
      PSHS  PC,U,X,DP,A
      PSHS  PC,U,X,DP,A,CC
      PSHS  PC,U,X,DP,B
      PSHS  PC,U,X,DP,B,CC
      PSHS  PC,U,X,DP,D
      PSHS  PC,U,X,DP,D,CC
      PSHS  PC,U,Y
      PSHS  PC,U,Y,CC
      PSHS  PC,U,Y,A
      PSHS  PC,U,Y,A,CC
      PSHS  PC,U,Y,B
      PSHS  PC,U,Y,B,CC
      PSHS  PC,U,Y,D
      PSHS  PC,U,Y,D,CC
      PSHS  PC,U,Y,DP
      PSHS  PC,U,Y,DP,CC
      PSHS  PC,U,Y,DP,A
      PSHS  PC,U,Y,DP,A,CC
      PSHS  PC,U,Y,DP,B
      PSHS  PC,U,Y,DP,B,CC
      PSHS  PC,U,Y,DP,D
      PSHS  PC,U,Y,DP,D,CC
      PSHS  PC,U,Y,X
      PSHS  PC,U,Y,X,CC
      PSHS  PC,U,Y,X,A
      PSHS  PC,U,Y,X,A,CC
      PSHS  PC,U,Y,X,B
      PSHS  PC,U,Y,X,B,CC
      PSHS  PC,U,Y,X,D
      PSHS  PC,U,Y,X,D,CC
      PSHS  PC,U,Y,X,DP
      PSHS  PC,U,Y,X,DP,CC
      PSHS  PC,U,Y,X,DP,A
      PSHS  PC,U,Y,X,DP,A,CC
      PSHS  PC,U,Y,X,DP,B
      PSHS  PC,U,Y,X,DP,B,CC
      PSHS  PC,U,Y,X,DP,D
      PSHS  PC,U,Y,X,DP,D,CC
      PSHS
      PSHS  CC
      PSHS  A
      PSHS  A,CC
      PSHS  B
      PSHS  B,CC
      PSHS  D
      PSHS  D,CC
      PSHS  DP
      PSHS  DP,CC
      PSHS  DP,A
      PSHS  DP,A,CC
      PSHS  DP,B
      PSHS  DP,B,CC
      PSHS  DP,D
      PSHS  DP,D,CC
      PSHS  X
      PSHS  X,CC
      PSHS  X,A
      PSHS  X,A,CC
      PSHS  X,B
      PSHS  X,B,CC
      PSHS  X,D
      PSHS  X,D,CC
      PSHS  X,DP
      PSHS  X,DP,CC
      PSHS  X,DP,A
      PSHS  X,DP,A,CC
      PSHS  X,DP,B
      PSHS  X,DP,B,CC
      PSHS  X,DP,D
      PSHS  X,DP,D,CC
      PSHS  Y
      PSHS  Y,CC
      PSHS  Y,A
      PSHS  Y,A,CC
      PSHS  Y,B
      PSHS  Y,B,CC
      PSHS  Y,D
      PSHS  Y,D,CC
      PSHS  Y,DP
      PSHS  Y,DP,CC
      PSHS  Y,DP,A
      PSHS  Y,DP,A,CC
      PSHS  Y,DP,B
      PSHS  Y,DP,B,CC
      PSHS  Y,DP,D
      PSHS  Y,DP,D,CC
      PSHS  Y,X
      PSHS  Y,X,CC
      PSHS  Y,X,A
      PSHS  Y,X,A,CC
      PSHS  Y,X,B
      PULS  D,X,Y
      PULS  CC,D,X,Y
      PULS  DP,X,Y
      PULS  CC,DP,X,Y
      PULS  A,DP,X,Y
      PULS  CC,A,DP,X,Y
      PULS  B,DP,X,Y
      PULS  CC,B,DP,X,Y
      PULS  D,DP,X,Y
      PULS  CC,D,DP,X,Y
      PULS  U
      PULS  CC,U
      PULS  A,U
      PULS  CC,A,U
      PULS  B,U
      PULS  CC,B,U
      PULS  D,U
      PULS  CC,D,U
      PULS  DP,U
      PULS  CC,DP,U
      PULS  A,DP,U
      PULS  CC,A,DP,U
      PULS  B,DP,U
      PULS  CC,B,DP,U
      PULS  D,DP,U
      PULS  CC,D,DP,U
      PULS  X,U
      PULS  CC,X,U
      PULS  A,X,U
      PULS  CC,A,X,U
      PULS  B,X,U
      PULS  CC,B,X,U
      PULS  D,X,U
      PULS  CC,D,X,U
      PULS  DP,X,U
      PULS  CC,DP,X,U
      PULS  A,DP,X,U
      PULS  CC,A,DP,X,U
      PULS  B,DP,X,U
      PULS  CC,B,DP,X,U
      PULS  D,DP,X,U
      PULS  CC,D,DP,X,U
      PULS  Y,U
      PULS  CC,Y,U
      PULS  A,Y,U
      PULS  CC,A,Y,U
      PULS  B,Y,U
      PULS  CC,B,Y,U
      PULS  D,Y,U
      PULS  CC,D,Y,U
      PULS  DP,Y,U
      PULS  CC,DP,Y,U
      PULS  A,DP,Y,U
      PULS  CC,A,DP,Y,U
      PULS  B,DP,Y,U
      PULS  CC,B,DP,Y,U
      PULS  D,DP,Y,U
      PULS  CC,D,DP,Y,U
      PULS  X,Y,U
      PULS  CC,X,Y,U
      PULS  A,X,Y,U
      PULS  CC,A,X,Y,U
      PULS  B,X,Y,U
      PULS  CC,B,X,Y,U
      PULS  D,X,Y,U
      PULS  CC,D,X,Y,U
      PULS  DP,X,Y,U
      PULS  CC,DP,X,Y,U
      PULS  A,DP,X,Y,U
      PULS  CC,A,DP,X,Y,U
      PULS  B,DP,X,Y,U
      PULS  CC,B,DP,X,Y,U
      PULS  D,DP,X,Y,U
      PULS  CC,D,DP,X,Y,U
      PULS  PC
      PULS  CC,PC
      PULS  A,PC
      PULS  CC,A,PC
      PULS  B,PC
      PULS  CC,B,PC
      PULS  D,PC
      PULS  CC,D,PC
      PULS  DP,PC
      PULS  CC,DP,PC
      PULS  A,DP,PC
      PULS  CC,A,DP,PC
      PULS  B,DP,PC
      PULS  CC,B,DP,PC
      PULS  D,DP,PC
      PULS  CC,D,DP,PC
      PULS  X,PC
      PULS  CC,X,PC
      PULS  A,X,PC
      PULS  CC,A,X,PC
      PULS  B,X,PC
      PULS  CC,B,X,PC
      PULS  D,X,PC
      PULS  CC,D,X,PC
      PULS  DP,X,PC
      PULS  CC,DP,X,PC
      PULS  A,DP,X,PC
      PULS  CC,A,DP,X,PC
      PULS  B,DP,X,PC
      PULS  CC,B,DP,X,PC
      PULS  D,DP,X,PC
      PULS  CC,D,DP,X,PC
      PULS  Y,PC
      PULS  CC,Y,PC
      PULS  A,Y,PC
      PULS  CC,A,Y,PC
      PULS  B,Y,PC
      PULS  CC,B,Y,PC
      PULS  D,Y,PC
      PULS  CC,D,Y,PC
      PULS  DP,Y,PC
      PULS  CC,DP,Y,PC
      PULS  A,DP,Y,PC
      PULS  CC,A,DP,Y,PC
      PULS  B,DP,Y,PC
      PULS  CC,B,DP,Y,PC
      PULS  D,DP,Y,PC
      PULS  CC,D,DP,Y,PC
      PULS  X,Y,PC
      PULS  CC,X,Y,PC
      PULS  A,X,Y,PC
      PULS  CC,A,X,Y,PC
      PULS  B,X,Y,PC
      PULS  CC,B,X,Y,PC
      PULS  D,X,Y,PC
      PULS  CC,D,X,Y,PC
      PULS  DP,X,Y,PC
      PULS  CC,DP,X,Y,PC
      PULS  A,DP,X,Y,PC
      PULS  CC,A,DP,X,Y,PC
      PULS  B,DP,X,Y,PC
      PULS  CC,B,DP,X,Y,PC
      PULS  D,DP,X,Y,PC
      PULS  CC,D,DP,X,Y,PC
      PULS  U,PC
      PULS  CC,U,PC
      PULS  A,U,PC
      PULS  CC,A,U,PC
      PULS  B,U,PC
      PULS  CC,B,U,PC
      PULS  D,U,PC
      PULS  CC,D,U,PC
      PULS  DP,U,PC
      PULS  CC,DP,U,PC
      PULS  A,DP,U,PC
      PULS  CC,A,DP,U,PC
      PULS  B,DP,U,PC
      PULS  CC,B,DP,U,PC
      PULS  D,DP,U,PC
      PULS  CC,D,DP,U,PC
      PULS  X,U,PC
      PULS  CC,X,U,PC
      PULS  A,X,U,PC
      PULS  CC,A,X,U,PC
      PULS  B,X,U,PC
      PULS  CC,B,X,U,PC
      PULS  D,X,U,PC
      PULS  CC,D,X,U,PC
      PULS  DP,X,U,PC
      PULS  CC,DP,X,U,PC
      PULS  A,DP,X,U,PC
      PULS  CC,A,DP,X,U,PC
      PULS  B,DP,X,U,PC
      PULS  CC,B,DP,X,U,PC
      PULS  D,DP,X,U,PC
      PULS  CC,D,DP,X,U,PC
      PULS  Y,U,PC
      PULS  CC,Y,U,PC
      PULS  A,Y,U,PC
      PULS  CC,A,Y,U,PC
      PULS  B,Y,U,PC
      PULS  CC,B,Y,U,PC
      PULS  D,Y,U,PC
      PULS  CC,D,Y,U,PC
      PULS  DP,Y,U,PC
      PULS  CC,DP,Y,U,PC
      PULS  A,DP,Y,U,PC
      PULS  CC,A,DP,Y,U,PC
      PULS  B,DP,Y,U,PC
      PULS  CC,B,DP,Y,U,PC
      PULS  D,DP,Y,U,PC
      PULS  CC,D,DP,Y,U,PC
      PULS  X,Y,U,PC
      PULS  CC,X,Y,U,PC
      PULS  A,X,Y,U,PC
      PULS  CC,A,X,Y,U,PC
      PULS  B,X,Y,U,PC
      PULS  CC,B,X,Y,U,PC
      PULS  D,X,Y,U,PC
      PULS  CC,D,X,Y,U,PC
      PULS  DP,X,Y,U,PC
      PULS  CC,DP,X,Y,U,PC
      PULS  A,DP,X,Y,U,PC
      PULS  CC,A,DP,X,Y,U,PC
      PULS  B,DP,X,Y,U,PC
      PULS  CC,B,DP,X,Y,U,PC
      PULS  D,DP,X,Y,U,PC
      PULS  CC,D,DP,X,Y,U,PC
      PULS
      PULS  CC
      PULS  A
      PULS  CC,A
      PULS  B
      PULS  CC,B
      PULS  D
      PULS  CC,D
      PULS  DP
      PULS  CC,DP
      PULS  A,DP
      PULS  CC,A,DP
      PULS  B,DP
      PULS  CC,B,DP
      PULS  D,DP
      PULS  CC,D,DP
      PULS  X
      PULS  CC,X
      PULS  A,X
      PULS  CC,A,X
      PULS  B,X
      PULS  CC,B,X
      PULS  D,X
      PULS  CC,D,X
      PULS  DP,X
      PULS  CC,DP,X
      PULS  A,DP,X
      PULS  CC,A,DP,X
      PULS  B,DP,X
      PULS  CC,B,DP,X
      PULS  D,DP,X
      PULS  CC,D,DP,X
      PULS  Y
      PULS  CC,Y
      PULS  A,Y
      PULS  CC,A,Y
      PULS  B,Y
      PULS  CC,B,Y
      PULS  D,Y
      PULS  CC,D,Y
      PULS  DP,Y
      PULS  CC,DP,Y
      PULS  A,DP,Y
      PULS  CC,A,DP,Y
      PULS  B,DP,Y
      PULS  CC,B,DP,Y
      PULS  D,DP,Y
      PULS  CC,D,DP,Y
      PULS  X,Y
      PULS  CC,X,Y
      PULS  A,X,Y
      PULS  CC,A,X,Y
      PULS  B,X,Y
      PULS  CC,B,X,Y
      PSHU  Y,X,D,CC
      PSHU  Y,X,DP
      PSHU  Y,X,DP,CC
      PSHU  Y,X,DP,A
      PSHU  Y,X,DP,A,CC
      PSHU  Y,X,DP,B
      PSHU  Y,X,DP,B,CC
      PSHU  Y,X,DP,D
      PSHU  Y,X,DP,D,CC
      PSHU  S
      PSHU  S,CC
      PSHU  S,A
      PSHU  S,A,CC
      PSHU  S,B
      PSHU  S,B,CC
      PSHU  S,D
      PSHU  S,D,CC
      PSHU  S,DP
      PSHU  S,DP,CC
      PSHU  S,DP,A
      PSHU  S,DP,A,CC
      PSHU  S,DP,B
      PSHU  S,DP,B,CC
      PSHU  S,DP,D
      PSHU  S,DP,D,CC
      PSHU  S,X
      PSHU  S,X,CC
      PSHU  S,X,A
      PSHU  S,X,A,CC
      PSHU  S,X,B
      PSHU  S,X,B,CC
      PSHU  S,X,D
      PSHU  S,X,D,CC
      PSHU  S,X,DP
      PSHU  S,X,DP,CC
      PSHU  S,X,DP,A
      PSHU  S,X,DP,A,CC
      PSHU  S,X,DP,B
      PSHU  S,X,DP,B,CC
      PSHU  S,X,DP,D
      PSHU  S,X,DP,D,CC
      PSHU  S,Y
      PSHU  S,Y,CC
      PSHU  S,Y,A
      PSHU  S,Y,A,CC
      PSHU  S,Y,B
      PSHU  S,Y,B,CC
      PSHU  S,Y,D
      PSHU  S,Y,D,CC
      PSHU  S,Y,DP
      PSHU  S,Y,DP,CC
      PSHU  S,Y,DP,A
      PSHU  S,Y,DP,A,CC
      PSHU  S,Y,DP,B
      PSHU  S,Y,DP,B,CC
      PSHU  S,Y,DP,D
      PSHU  S,Y,DP,D,CC
      PSHU  S,Y,X
      PSHU  S,Y,X,CC
      PSHU  S,Y,X,A
      PSHU  S,Y,X,A,CC
      PSHU  S,Y,X,B
      PSHU  S,Y,X,B,CC
      PSHU  S,Y,X,D
      PSHU  S,Y,X,D,CC
      PSHU  S,Y,X,DP
      PSHU  S,Y,X,DP,CC
      PSHU  S,Y,X,DP,A
      PSHU  S,Y,X,DP,A,CC
      PSHU  S,Y,X,DP,B
      PSHU  S,Y,X,DP,B,CC
      PSHU  S,Y,X,DP,D
      PSHU  S,Y,X,DP,D,CC
      PSHU  PC
      PSHU  PC,CC
      PSHU  PC,A
      PSHU  PC,A,CC
      PSHU  PC,B
      PSHU  PC,B,CC
      PSHU  PC,D
      PSHU  PC,D,CC
      PSHU  PC,DP
      PSHU  PC,DP,CC
      PSHU  PC,DP,A
      PSHU  PC,DP,A,CC
      PSHU  PC,DP,B
      PSHU  PC,DP,B,CC
      PSHU  PC,DP,D
      PSHU  PC,DP,D,CC
      PSHU  PC,X
      PSHU  PC,X,CC
      PSHU  PC,X,A
      PSHU  PC,X,A,CC
      PSHU  PC,X,B
      PSHU  PC,X,B,CC
      PSHU  PC,X,D
      PSHU  PC,X,D,CC
      PSHU  PC,X,DP
      PSHU  PC,X,DP,CC
      PSHU  PC,X,DP,A
      PSHU  PC,X,DP,A,CC
      PSHU  PC,X,DP,B
      PSHU  PC,X,DP,B,CC
      PSHU  PC,X,DP,D
      PSHU  PC,X,DP,D,CC
      PSHU  PC,Y
      PSHU  PC,Y,CC
      PSHU  PC,Y,A
      PSHU  PC,Y,A,CC
      PSHU  PC,Y,B
      PSHU  PC,Y,B,CC
      PSHU  PC,Y,D
      PSHU  PC,Y,D,CC
      PSHU  PC,Y,DP
      PSHU  PC,Y,DP,CC
      PSHU  PC,Y,DP,A
      PSHU  PC,Y,DP,A,CC
      PSHU  PC,Y,DP,B
      PSHU  PC,Y,DP,B,CC
      PSHU  PC,Y,DP,D
      PSHU  PC,Y,DP,D,CC
      PSHU  PC,Y,X
      PSHU  PC,Y,X,CC
      PSHU  PC,Y,X,A
      PSHU  PC,Y,X,A,CC
      PSHU  PC,Y,X,B
      PSHU  PC,Y,X,B,CC
      PSHU  PC,Y,X,D
      PSHU  PC,Y,X,D,CC
      PSHU  PC,Y,X,DP
      PSHU  PC,Y,X,DP,CC
      PSHU  PC,Y,X,DP,A
      PSHU  PC,Y,X,DP,A,CC
      PSHU  PC,Y,X,DP,B
      PSHU  PC,Y,X,DP,B,CC
      PSHU  PC,Y,X,DP,D
      PSHU  PC,Y,X,DP,D,CC
      PSHU  PC,S
      PSHU  PC,S,CC
      PSHU  PC,S,A
      PSHU  PC,S,A,CC
      PSHU  PC,S,B
      PSHU  PC,S,B,CC
      PSHU  PC,S,D
      PSHU  PC,S,D,CC
      PSHU  PC,S,DP
      PSHU  PC,S,DP,CC
      PSHU  PC,S,DP,A
      PSHU  PC,S,DP,A,CC
      PSHU  PC,S,DP,B
      PSHU  PC,S,DP,B,CC
      PSHU  PC,S,DP,D
      PSHU  PC,S,DP,D,CC
      PSHU  PC,S,X
      PSHU  PC,S,X,CC
      PSHU  PC,S,X,A
      PSHU  PC,S,X,A,CC
      PSHU  PC,S,X,B
      PSHU  PC,S,X,B,CC
      PSHU  PC,S,X,D
      PSHU  PC,S,X,D,CC
      PSHU  PC,S,X,DP
      PSHU  PC,S,X,DP,CC
      PSHU  PC,S,X,DP,A
      PSHU  PC,S,X,DP,A,CC
      PSHU  PC,S,X,DP,B
      PSHU  PC,S,X,DP,B,CC
      PSHU  PC,S,X,DP,D
      PSHU  PC,S,X,DP,D,CC
      PSHU  PC,S,Y
      PSHU  PC,S,Y,CC
      PSHU  PC,S,Y,A
      PSHU  PC,S,Y,A,CC
      PSHU  PC,S,Y,B
      PSHU  PC,S,Y,B,CC
      PSHU  PC,S,Y,D
      PSHU  PC,S,Y,D,CC
      PSHU  PC,S,Y,DP
      PSHU  PC,S,Y,DP,CC
      PSHU  PC,S,Y,DP,A
      PSHU  PC,S,Y,DP,A,CC
      PSHU  PC,S,Y,DP,B
      PSHU  PC,S,Y,DP,B,CC
      PSHU  PC,S,Y,DP,D
      PSHU  PC,S,Y,DP,D,CC
      PSHU  PC,S,Y,X
      PSHU  PC,S,Y,X,CC
      PSHU  PC,S,Y,X,A
      PSHU  PC,S,Y,X,A,CC
      PSHU  PC,S,Y,X,B
      PSHU  PC,S,Y,X,B,CC
      PSHU  PC,S,Y,X,D
      PSHU  PC,S,Y,X,D,CC
      PSHU  PC,S,Y,X,DP
      PSHU  PC,S,Y,X,DP,CC
      PSHU  PC,S,Y,X,DP,A
      PSHU  PC,S,Y,X,DP,A,CC
      PSHU  PC,S,Y,X,DP,B
      PSHU  PC,S,Y,X,DP,B,CC
      PSHU  PC,S,Y,X,DP,D
      PSHU  PC,S,Y,X,DP,D,CC
      PSHU
      PSHU  CC
      PSHU  A
      PSHU  A,CC
      PSHU  B
      PSHU  B,CC
      PSHU  D
      PSHU  D,CC
      PSHU  DP
      PSHU  DP,CC
      PSHU  DP,A
      PSHU  DP,A,CC
      PSHU  DP,B
      PSHU  DP,B,CC
      PSHU  DP,D
      PSHU  DP,D,CC
      PSHU  X
      PSHU  X,CC
      PSHU  X,A
      PSHU  X,A,CC
      PSHU  X,B
      PSHU  X,B,CC
      PSHU  X,D
      PSHU  X,D,CC
      PSHU  X,DP
      PSHU  X,DP,CC
      PSHU  X,DP,A
      PSHU  X,DP,A,CC
      PSHU  X,DP,B
      PSHU  X,DP,B,CC
      PSHU  X,DP,D
      PSHU  X,DP,D,CC
      PSHU  Y
      PSHU  Y,CC
      PSHU  Y,A
      PSHU  Y,A,CC
      PSHU  Y,B
      PSHU  Y,B,CC
      PSHU  Y,D
      PSHU  Y,D,CC
      PSHU  Y,DP
      PSHU  Y,DP,CC
      PSHU  Y,DP,A
      PSHU  Y,DP,A,CC
      PSHU  Y,DP,B
      PSHU  Y,DP,B,CC
      PSHU  Y,DP,D
      PSHU  Y,DP,D,CC
      PSHU  Y,X
      PSHU  Y,X,CC
      PSHU  Y,X,A
      PSHU  Y,X,A,CC
      PSHU  Y,X,B
      PSHU  Y,X,B,CC
      PSHU  Y,X,D
      PULU  DP,X,Y
      PULU  CC,DP,X,Y
      PULU  A,DP,X,Y
      PULU  CC,A,DP,X,Y
      PULU  B,DP,X,Y
      PULU  CC,B,DP,X,Y
      PULU  D,DP,X,Y
      PULU  CC,D,DP,X,Y
      PULU  S
      PULU  CC,S
      PULU  A,S
      PULU  CC,A,S
      PULU  B,S
      PULU  CC,B,S
      PULU  D,S
      PULU  CC,D,S
      PULU  DP,S
      PULU  CC,DP,S
      PULU  A,DP,S
      PULU  CC,A,DP,S
      PULU  B,DP,S
      PULU  CC,B,DP,S
      PULU  D,DP,S
      PULU  CC,D,DP,S
      PULU  X,S
      PULU  CC,X,S
      PULU  A,X,S
      PULU  CC,A,X,S
      PULU  B,X,S
      PULU  CC,B,X,S
      PULU  D,X,S
      PULU  CC,D,X,S
      PULU  DP,X,S
      PULU  CC,DP,X,S
      PULU  A,DP,X,S
      PULU  CC,A,DP,X,S
      PULU  B,DP,X,S
      PULU  CC,B,DP,X,S
      PULU  D,DP,X,S
      PULU  CC,D,DP,X,S
      PULU  Y,S
      PULU  CC,Y,S
      PULU  A,Y,S
      PULU  CC,A,Y,S
      PULU  B,Y,S
      PULU  CC,B,Y,S
      PULU  D,Y,S
      PULU  CC,D,Y,S
      PULU  DP,Y,S
      PULU  CC,DP,Y,S
      PULU  A,DP,Y,S
      PULU  CC,A,DP,Y,S
      PULU  B,DP,Y,S
      PULU  CC,B,DP,Y,S
      PULU  D,DP,Y,S
      PULU  CC,D,DP,Y,S
      PULU  X,Y,S
      PULU  CC,X,Y,S
      PULU  A,X,Y,S
      PULU  CC,A,X,Y,S
      PULU  B,X,Y,S
      PULU  CC,B,X,Y,S
      PULU  D,X,Y,S
      PULU  CC,D,X,Y,S
      PULU  DP,X,Y,S
      PULU  CC,DP,X,Y,S
      PULU  A,DP,X,Y,S
      PULU  CC,A,DP,X,Y,S
      PULU  B,DP,X,Y,S
      PULU  CC,B,DP,X,Y,S
      PULU  D,DP,X,Y,S
      PULU  CC,D,DP,X,Y,S
      PULU  PC
      PULU  CC,PC
      PULU  A,PC
      PULU  CC,A,PC
      PULU  B,PC
      PULU  CC,B,PC
      PULU  D,PC
      PULU  CC,D,PC
      PULU  DP,PC
      PULU  CC,DP,PC
      PULU  A,DP,PC
      PULU  CC,A,DP,PC
      PULU  B,DP,PC
      PULU  CC,B,DP,PC
      PULU  D,DP,PC
      PULU  CC,D,DP,PC
      PULU  X,PC
      PULU  CC,X,PC
      PULU  A,X,PC
      PULU  CC,A,X,PC
      PULU  B,X,PC
      PULU  CC,B,X,PC
      PULU  D,X,PC
      PULU  CC,D,X,PC
      PULU  DP,X,PC
      PULU  CC,DP,X,PC
      PULU  A,DP,X,PC
      PULU  CC,A,DP,X,PC
      PULU  B,DP,X,PC
      PULU  CC,B,DP,X,PC
      PULU  D,DP,X,PC
      PULU  CC,D,DP,X,PC
      PULU  Y,PC
      PULU  CC,Y,PC
      PULU  A,Y,PC
      PULU  CC,A,Y,PC
      PULU  B,Y,PC
      PULU  CC,B,Y,PC
      PULU  D,Y,PC
      PULU  CC,D,Y,PC
      PULU  DP,Y,PC
      PULU  CC,DP,Y,PC
      PULU  A,DP,Y,PC
      PULU  CC,A,DP,Y,PC
      PULU  B,DP,Y,PC
      PULU  CC,B,DP,Y,PC
      PULU  D,DP,Y,PC
      PULU  CC,D,DP,Y,PC
      PULU  X,Y,PC
      PULU  CC,X,Y,PC
      PULU  A,X,Y,PC
      PULU  CC,A,X,Y,PC
      PULU  B,X,Y,PC
      PULU  CC,B,X,Y,PC
      PULU  D,X,Y,PC
      PULU  CC,D,X,Y,PC
      PULU  DP,X,Y,PC
      PULU  CC,DP,X,Y,PC
      PULU  A,DP,X,Y,PC
      PULU  CC,A,DP,X,Y,PC
      PULU  B,DP,X,Y,PC
      PULU  CC,B,DP,X,Y,PC
      PULU  D,DP,X,Y,PC
      PULU  CC,D,DP,X,Y,PC
      PULU  S,PC
      PULU  CC,S,PC
      PULU  A,S,PC
      PULU  CC,A,S,PC
      PULU  B,S,PC
      PULU  CC,B,S,PC
      PULU  D,S,PC
      PULU  CC,D,S,PC
      PULU  DP,S,PC
      PULU  CC,DP,S,PC
      PULU  A,DP,S,PC
      PULU  CC,A,DP,S,PC
      PULU  B,DP,S,PC
      PULU  CC,B,DP,S,PC
      PULU  D,DP,S,PC
      PULU  CC,D,DP,S,PC
      PULU  X,S,PC
      PULU  CC,X,S,PC
      PULU  A,X,S,PC
      PULU  CC,A,X,S,PC
      PULU  B,X,S,PC
      PULU  CC,B,X,S,PC
      PULU  D,X,S,PC
      PULU  CC,D,X,S,PC
      PULU  DP,X,S,PC
      PULU  CC,DP,X,S,PC
      PULU  A,DP,X,S,PC
      PULU  CC,A,DP,X,S,PC
      PULU  B,DP,X,S,PC
      PULU  CC,B,DP,X,S,PC
      PULU  D,DP,X,S,PC
      PULU  CC,D,DP,X,S,PC
      PULU  Y,S,PC
      PULU  CC,Y,S,PC
      PULU  A,Y,S,PC
      PULU  CC,A,Y,S,PC
      PULU  B,Y,S,PC
      PULU  CC,B,Y,S,PC
      PULU  D,Y,S,PC
      PULU  CC,D,Y,S,PC
      PULU  DP,Y,S,PC
      PULU  CC,DP,Y,S,PC
      PULU  A,DP,Y,S,PC
      PULU  CC,A,DP,Y,S,PC
      PULU  B,DP,Y,S,PC
      PULU  CC,B,DP,Y,S,PC
      PULU  D,DP,Y,S,PC
      PULU  CC,D,DP,Y,S,PC
      PULU  X,Y,S,PC
      PULU  CC,X,Y,S,PC
      PULU  A,X,Y,S,PC
      PULU  CC,A,X,Y,S,PC
      PULU  B,X,Y,S,PC
      PULU  CC,B,X,Y,S,PC
      PULU  D,X,Y,S,PC
      PULU  CC,D,X,Y,S,PC
      PULU  DP,X,Y,S,PC
      PULU  CC,DP,X,Y,S,PC
      PULU  A,DP,X,Y,S,PC
      PULU  CC,A,DP,X,Y,S,PC
      PULU  B,DP,X,Y,S,PC
      PULU  CC,B,DP,X,Y,S,PC
      PULU  D,DP,X,Y,S,PC
      PULU  CC,D,DP,X,Y,S,PC
      PULU
      PULU  CC
      PULU  A
      PULU  CC,A
      PULU  B
      PULU  CC,B
      PULU  D
      PULU  CC,D
      PULU  DP
      PULU  CC,DP
      PULU  A,DP
      PULU  CC,A,DP
      PULU  B,DP
      PULU  CC,B,DP
      PULU  D,DP
      PULU  CC,D,DP
      PULU  X
      PULU  CC,X
      PULU  A,X
      PULU  CC,A,X
      PULU  B,X
      PULU  CC,B,X
      PULU  D,X
      PULU  CC,D,X
      PULU  DP,X
      PULU  CC,DP,X
      PULU  A,DP,X
      PULU  CC,A,DP,X
      PULU  B,DP,X
      PULU  CC,B,DP,X
      PULU  D,DP,X
      PULU  CC,D,DP,X
      PULU  Y
      PULU  CC,Y
      PULU  A,Y
      PULU  CC,A,Y
      PULU  B,Y
      PULU  CC,B,Y
      PULU  D,Y
      PULU  CC,D,Y
      PULU  DP,Y
      PULU  CC,DP,Y
      PULU  A,DP,Y
      PULU  CC,A,DP,Y
      PULU  B,DP,Y
      PULU  CC,B,DP,Y
      PULU  D,DP,Y
      PULU  CC,D,DP,Y
      PULU  X,Y
      PULU  CC,X,Y
      PULU  A,X,Y
      PULU  CC,A,X,Y
      PULU  B,X,Y
      PULU  CC,B,X,Y
      PULU  D,X,Y
      PULU  CC,D,X,Y
      RTS
      ABX
      RTI
      CWAI  #$3D
      MUL
      SWI
      NEGA
      COMA
      LSRA
      RORA
      ASRA
      ASLA
      ROLA
      DECA
      INCA
      TSTA
      CLRA
      NEGB
      COMB
      LSRB
      RORB
      ASRB
      ASLB
      ROLB
      DECB
      INCB
      TSTB
      CLRB
      NEG   1,S
      NEG   -16,S
      NEG   ,X+
      NEG   ,X++
      NEG   ,-X
      NEG   ,--X
      NEG   ,X
      NEG   B,X
      NEG   A,X
      NEG   -119,X
      NEG   <-16,X
      NEG   <0,X
      NEG   16,X
      NEG   $008A,X
      NEG   D,X
      NEG   *-112,PCR
      NEG   *,PCR
      NEG   *+1,PCR
      NEG   *+$0092,PCR
      NEG   [,X++]
      NEG   [,--X]
      NEG   [,X]
      NEG   [B,X]
      NEG   [A,X]
      NEG   [-103,X]
      NEG   [<0,X]
      NEG   [1,X]
      NEG   [$009A,X]
      NEG   [D,X]
      NEG   [*-96,PCR]
      NEG   [*,PCR]
      NEG   [*+1,PCR]
      NEG   [*+$00A2,PCR]
      NEG   [$00A0]
      NEG   ,Y+
      NEG   ,Y++
      NEG   ,-Y
      NEG   ,--Y
      NEG   ,Y
      NEG   B,Y
      NEG   A,Y
      NEG   -87,Y
      NEG   <-16,Y
      NEG   <0,Y
      NEG   16,Y
      NEG   $00AA,Y
      NEG   D,Y
      NEG   [,Y++]
      NEG   [,--Y]
      NEG   [,Y]
      NEG   [B,Y]
      NEG   [A,Y]
      NEG   [-71,Y]
      NEG   [<0,Y]
      NEG   [1,Y]
      NEG   [$00BA,Y]
      NEG   [D,Y]
      NEG   ,U+
      NEG   ,U++
      NEG   ,-U
      NEG   ,--U
      NEG   ,U
      NEG   B,U
      NEG   A,U
      NEG   -55,U
      NEG   <-16,U
      NEG   <0,U
      NEG   16,U
      NEG   $00CA,U
      NEG   D,U
      NEG   [,U++]
      NEG   [,--U]
      NEG   [,U]
      NEG   [B,U]
      NEG   [A,U]
      NEG   [-39,U]
      NEG   [<0,U]
      NEG   [1,U]
      NEG   [$00DA,U]
      NEG   [D,U]
      NEG   ,S+
      NEG   ,S++
      NEG   ,-S
      NEG   ,--S
      NEG   ,S
      NEG   B,S
      NEG   A,S
      NEG   -23,S
      NEG   <-16,S
      NEG   <0,S
      NEG   16,S
      NEG   $00EA,S
      NEG   D,S
      NEG   [,S++]
      NEG   [,--S]
      NEG   [,S]
      NEG   [B,S]
      NEG   [A,S]
      NEG   [-7,S]
      NEG   [<0,S]
      NEG   [1,S]
      NEG   [$00FA,S]
      NEG   [D,S]
      NEG   <<0,X
      NEG   1,X
      NEG   -16,X
      NEG   <<0,Y
      NEG   1,Y
      NEG   -16,Y
      NEG   <<0,U
      NEG   1,U
      NEG   -16,U
      NEG   <<0,S
      COM   4,S
      COM   -16,S
      COM   ,X+
      COM   ,X++
      COM   ,-X
      COM   ,--X
      COM   ,X
      COM   B,X
      COM   A,X
      COM   -119,X
      COM   <-16,X
      COM   <0,X
      COM   16,X
      COM   $008A,X
      COM   D,X
      COM   *-112,PCR
      COM   *,PCR
      COM   *+1,PCR
      COM   *+$0092,PCR
      COM   [,X++]
      COM   [,--X]
      COM   [,X]
      COM   [B,X]
      COM   [A,X]
      COM   [-103,X]
      COM   [<0,X]
      COM   [1,X]
      COM   [$009A,X]
      COM   [D,X]
      COM   [*-96,PCR]
      COM   [*,PCR]
      COM   [*+1,PCR]
      COM   [*+$00A2,PCR]
      COM   [$00A0]
      COM   ,Y+
      COM   ,Y++
      COM   ,-Y
      COM   ,--Y
      COM   ,Y
      COM   B,Y
      COM   A,Y
      COM   -87,Y
      COM   <-16,Y
      COM   <0,Y
      COM   16,Y
      COM   $00AA,Y
      COM   D,Y
      COM   [,Y++]
      COM   [,--Y]
      COM   [,Y]
      COM   [B,Y]
      COM   [A,Y]
      COM   [-71,Y]
      COM   [<0,Y]
      COM   [1,Y]
      COM   [$00BA,Y]
      COM   [D,Y]
      COM   ,U+
      COM   ,U++
      COM   ,-U
      COM   ,--U
      COM   ,U
      COM   B,U
      COM   A,U
      COM   -55,U
      COM   <-16,U
      COM   <0,U
      COM   16,U
      COM   $00CA,U
      COM   D,U
      COM   [,U++]
      COM   [,--U]
      COM   [,U]
      COM   [B,U]
      COM   [A,U]
      COM   [-39,U]
      COM   [<0,U]
      COM   [1,U]
      COM   [$00DA,U]
      COM   [D,U]
      COM   ,S+
      COM   ,S++
      COM   ,-S
      COM   ,--S
      COM   ,S
      COM   B,S
      COM   A,S
      COM   -23,S
      COM   <-16,S
      COM   <0,S
      COM   16,S
      COM   $00EA,S
      COM   D,S
      COM   [,S++]
      COM   [,--S]
      COM   [,S]
      COM   [B,S]
      COM   [A,S]
      COM   [-7,S]
      COM   [<0,S]
      COM   [1,S]
      COM   [$00FA,S]
      COM   [D,S]
      COM   <<0,X
      COM   1,X
      COM   -16,X
      COM   <<0,Y
      COM   1,Y
      COM   -16,Y
      COM   <<0,U
      COM   1,U
      COM   -16,U
      COM   <<0,S
      LSR   5,S
      LSR   -16,S
      LSR   ,X+
      LSR   ,X++
      LSR   ,-X
      LSR   ,--X
      LSR   ,X
      LSR   B,X
      LSR   A,X
      LSR   -119,X
      LSR   <-16,X
      LSR   <0,X
      LSR   16,X
      LSR   $008A,X
      LSR   D,X
      LSR   *-112,PCR
      LSR   *,PCR
      LSR   *+1,PCR
      LSR   *+$0092,PCR
      LSR   [,X++]
      LSR   [,--X]
      LSR   [,X]
      LSR   [B,X]
      LSR   [A,X]
      LSR   [-103,X]
      LSR   [<0,X]
      LSR   [1,X]
      LSR   [$009A,X]
      LSR   [D,X]
      LSR   [*-96,PCR]
      LSR   [*,PCR]
      LSR   [*+1,PCR]
      LSR   [*+$00A2,PCR]
      LSR   [$00A0]
      LSR   ,Y+
      LSR   ,Y++
      LSR   ,-Y
      LSR   ,--Y
      LSR   ,Y
      LSR   B,Y
      LSR   A,Y
      LSR   -87,Y
      LSR   <-16,Y
      LSR   <0,Y
      LSR   16,Y
      LSR   $00AA,Y
      LSR   D,Y
      LSR   [,Y++]
      LSR   [,--Y]
      LSR   [,Y]
      LSR   [B,Y]
      LSR   [A,Y]
      LSR   [-71,Y]
      LSR   [<0,Y]
      LSR   [1,Y]
      LSR   [$00BA,Y]
      LSR   [D,Y]
      LSR   ,U+
      LSR   ,U++
      LSR   ,-U
      LSR   ,--U
      LSR   ,U
      LSR   B,U
      LSR   A,U
      LSR   -55,U
      LSR   <-16,U
      LSR   <0,U
      LSR   16,U
      LSR   $00CA,U
      LSR   D,U
      LSR   [,U++]
      LSR   [,--U]
      LSR   [,U]
      LSR   [B,U]
      LSR   [A,U]
      LSR   [-39,U]
      LSR   [<0,U]
      LSR   [1,U]
      LSR   [$00DA,U]
      LSR   [D,U]
      LSR   ,S+
      LSR   ,S++
      LSR   ,-S
      LSR   ,--S
      LSR   ,S
      LSR   B,S
      LSR   A,S
      LSR   -23,S
      LSR   <-16,S
      LSR   <0,S
      LSR   16,S
      LSR   $00EA,S
      LSR   D,S
      LSR   [,S++]
      LSR   [,--S]
      LSR   [,S]
      LSR   [B,S]
      LSR   [A,S]
      LSR   [-7,S]
      LSR   [<0,S]
      LSR   [1,S]
      LSR   [$00FA,S]
      LSR   [D,S]
      LSR   <<0,X
      LSR   1,X
      LSR   -16,X
      LSR   <<0,Y
      LSR   1,Y
      LSR   -16,Y
      LSR   <<0,U
      LSR   1,U
      LSR   -16,U
      LSR   <<0,S
      ROR   7,S
      ROR   -16,S
      ROR   ,X+
      ROR   ,X++
      ROR   ,-X
      ROR   ,--X
      ROR   ,X
      ROR   B,X
      ROR   A,X
      ROR   -119,X
      ROR   <-16,X
      ROR   <0,X
      ROR   16,X
      ROR   $008A,X
      ROR   D,X
      ROR   *-112,PCR
      ROR   *,PCR
      ROR   *+1,PCR
      ROR   *+$0092,PCR
      ROR   [,X++]
      ROR   [,--X]
      ROR   [,X]
      ROR   [B,X]
      ROR   [A,X]
      ROR   [-103,X]
      ROR   [<0,X]
      ROR   [1,X]
      ROR   [$009A,X]
      ROR   [D,X]
      ROR   [*-96,PCR]
      ROR   [*,PCR]
      ROR   [*+1,PCR]
      ROR   [*+$00A2,PCR]
      ROR   [$00A0]
      ROR   ,Y+
      ROR   ,Y++
      ROR   ,-Y
      ROR   ,--Y
      ROR   ,Y
      ROR   B,Y
      ROR   A,Y
      ROR   -87,Y
      ROR   <-16,Y
      ROR   <0,Y
      ROR   16,Y
      ROR   $00AA,Y
      ROR   D,Y
      ROR   [,Y++]
      ROR   [,--Y]
      ROR   [,Y]
      ROR   [B,Y]
      ROR   [A,Y]
      ROR   [-71,Y]
      ROR   [<0,Y]
      ROR   [1,Y]
      ROR   [$00BA,Y]
      ROR   [D,Y]
      ROR   ,U+
      ROR   ,U++
      ROR   ,-U
      ROR   ,--U
      ROR   ,U
      ROR   B,U
      ROR   A,U
      ROR   -55,U
      ROR   <-16,U
      ROR   <0,U
      ROR   16,U
      ROR   $00CA,U
      ROR   D,U
      ROR   [,U++]
      ROR   [,--U]
      ROR   [,U]
      ROR   [B,U]
      ROR   [A,U]
      ROR   [-39,U]
      ROR   [<0,U]
      ROR   [1,U]
      ROR   [$00DA,U]
      ROR   [D,U]
      ROR   ,S+
      ROR   ,S++
      ROR   ,-S
      ROR   ,--S
      ROR   ,S
      ROR   B,S
      ROR   A,S
      ROR   -23,S
      ROR   <-16,S
      ROR   <0,S
      ROR   16,S
      ROR   $00EA,S
      ROR   D,S
      ROR   [,S++]
      ROR   [,--S]
      ROR   [,S]
      ROR   [B,S]
      ROR   [A,S]
      ROR   [-7,S]
      ROR   [<0,S]
      ROR   [1,S]
      ROR   [$00FA,S]
      ROR   [D,S]
      ROR   <<0,X
      ROR   1,X
      ROR   -16,X
      ROR   <<0,Y
      ROR   1,Y
      ROR   -16,Y
      ROR   <<0,U
      ROR   1,U
      ROR   -16,U
      ROR   <<0,S
      ASR   8,S
      ASR   -16,S
      ASR   ,X+
      ASR   ,X++
      ASR   ,-X
      ASR   ,--X
      ASR   ,X
      ASR   B,X
      ASR   A,X
      ASR   -119,X
      ASR   <-16,X
      ASR   <0,X
      ASR   16,X
      ASR   $008A,X
      ASR   D,X
      ASR   *-112,PCR
      ASR   *,PCR
      ASR   *+1,PCR
      ASR   *+$0092,PCR
      ASR   [,X++]
      ASR   [,--X]
      ASR   [,X]
      ASR   [B,X]
      ASR   [A,X]
      ASR   [-103,X]
      ASR   [<0,X]
      ASR   [1,X]
      ASR   [$009A,X]
      ASR   [D,X]
      ASR   [*-96,PCR]
      ASR   [*,PCR]
      ASR   [*+1,PCR]
      ASR   [*+$00A2,PCR]
      ASR   [$00A0]
      ASR   ,Y+
      ASR   ,Y++
      ASR   ,-Y
      ASR   ,--Y
      ASR   ,Y
      ASR   B,Y
      ASR   A,Y
      ASR   -87,Y
      ASR   <-16,Y
      ASR   <0,Y
      ASR   16,Y
      ASR   $00AA,Y
      ASR   D,Y
      ASR   [,Y++]
      ASR   [,--Y]
      ASR   [,Y]
      ASR   [B,Y]
      ASR   [A,Y]
      ASR   [-71,Y]
      ASR   [<0,Y]
      ASR   [1,Y]
      ASR   [$00BA,Y]
      ASR   [D,Y]
      ASR   ,U+
      ASR   ,U++
      ASR   ,-U
      ASR   ,--U
      ASR   ,U
      ASR   B,U
      ASR   A,U
      ASR   -55,U
      ASR   <-16,U
      ASR   <0,U
      ASR   16,U
      ASR   $00CA,U
      ASR   D,U
      ASR   [,U++]
      ASR   [,--U]
      ASR   [,U]
      ASR   [B,U]
      ASR   [A,U]
      ASR   [-39,U]
      ASR   [<0,U]
      ASR   [1,U]
      ASR   [$00DA,U]
      ASR   [D,U]
      ASR   ,S+
      ASR   ,S++
      ASR   ,-S
      ASR   ,--S
      ASR   ,S
      ASR   B,S
      ASR   A,S
      ASR   -23,S
      ASR   <-16,S
      ASR   <0,S
      ASR   16,S
      ASR   $00EA,S
      ASR   D,S
      ASR   [,S++]
      ASR   [,--S]
      ASR   [,S]
      ASR   [B,S]
      ASR   [A,S]
      ASR   [-7,S]
      ASR   [<0,S]
      ASR   [1,S]
      ASR   [$00FA,S]
      ASR   [D,S]
      ASR   <<0,X
      ASR   1,X
      ASR   -16,X
      ASR   <<0,Y
      ASR   1,Y
      ASR   -16,Y
      ASR   <<0,U
      ASR   1,U
      ASR   -16,U
      ASR   <<0,S
      ASL   9,S
      ASL   -16,S
      ASL   ,X+
      ASL   ,X++
      ASL   ,-X
      ASL   ,--X
      ASL   ,X
      ASL   B,X
      ASL   A,X
      ASL   -119,X
      ASL   <-16,X
      ASL   <0,X
      ASL   16,X
      ASL   $008A,X
      ASL   D,X
      ASL   *-112,PCR
      ASL   *,PCR
      ASL   *+1,PCR
      ASL   *+$0092,PCR
      ASL   [,X++]
      ASL   [,--X]
      ASL   [,X]
      ASL   [B,X]
      ASL   [A,X]
      ASL   [-103,X]
      ASL   [<0,X]
      ASL   [1,X]
      ASL   [$009A,X]
      ASL   [D,X]
      ASL   [*-96,PCR]
      ASL   [*,PCR]
      ASL   [*+1,PCR]
      ASL   [*+$00A2,PCR]
      ASL   [$00A0]
      ASL   ,Y+
      ASL   ,Y++
      ASL   ,-Y
      ASL   ,--Y
      ASL   ,Y
      ASL   B,Y
      ASL   A,Y
      ASL   -87,Y
      ASL   <-16,Y
      ASL   <0,Y
      ASL   16,Y
      ASL   $00AA,Y
      ASL   D,Y
      ASL   [,Y++]
      ASL   [,--Y]
      ASL   [,Y]
      ASL   [B,Y]
      ASL   [A,Y]
      ASL   [-71,Y]
      ASL   [<0,Y]
      ASL   [1,Y]
      ASL   [$00BA,Y]
      ASL   [D,Y]
      ASL   ,U+
      ASL   ,U++
      ASL   ,-U
      ASL   ,--U
      ASL   ,U
      ASL   B,U
      ASL   A,U
      ASL   -55,U
      ASL   <-16,U
      ASL   <0,U
      ASL   16,U
      ASL   $00CA,U
      ASL   D,U
      ASL   [,U++]
      ASL   [,--U]
      ASL   [,U]
      ASL   [B,U]
      ASL   [A,U]
      ASL   [-39,U]
      ASL   [<0,U]
      ASL   [1,U]
      ASL   [$00DA,U]
      ASL   [D,U]
      ASL   ,S+
      ASL   ,S++
      ASL   ,-S
      ASL   ,--S
      ASL   ,S
      ASL   B,S
      ASL   A,S
      ASL   -23,S
      ASL   <-16,S
      ASL   <0,S
      ASL   16,S
      ASL   $00EA,S
      ASL   D,S
      ASL   [,S++]
      ASL   [,--S]
      ASL   [,S]
      ASL   [B,S]
      ASL   [A,S]
      ASL   [-7,S]
      ASL   [<0,S]
      ASL   [1,S]
      ASL   [$00FA,S]
      ASL   [D,S]
      ASL   <<0,X
      ASL   1,X
      ASL   -16,X
      ASL   <<0,Y
      ASL   1,Y
      ASL   -16,Y
      ASL   <<0,U
      ASL   1,U
      ASL   -16,U
      ASL   <<0,S
      ROL   10,S
      ROL   -16,S
      ROL   ,X+
      ROL   ,X++
      ROL   ,-X
      ROL   ,--X
      ROL   ,X
      ROL   B,X
      ROL   A,X
      ROL   -119,X
      ROL   <-16,X
      ROL   <0,X
      ROL   16,X
      ROL   $008A,X
      ROL   D,X
      ROL   *-112,PCR
      ROL   *,PCR
      ROL   *+1,PCR
      ROL   *+$0092,PCR
      ROL   [,X++]
      ROL   [,--X]
      ROL   [,X]
      ROL   [B,X]
      ROL   [A,X]
      ROL   [-103,X]
      ROL   [<0,X]
      ROL   [1,X]
      ROL   [$009A,X]
      ROL   [D,X]
      ROL   [*-96,PCR]
      ROL   [*,PCR]
      ROL   [*+1,PCR]
      ROL   [*+$00A2,PCR]
      ROL   [$00A0]
      ROL   ,Y+
      ROL   ,Y++
      ROL   ,-Y
      ROL   ,--Y
      ROL   ,Y
      ROL   B,Y
      ROL   A,Y
      ROL   -87,Y
      ROL   <-16,Y
      ROL   <0,Y
      ROL   16,Y
      ROL   $00AA,Y
      ROL   D,Y
      ROL   [,Y++]
      ROL   [,--Y]
      ROL   [,Y]
      ROL   [B,Y]
      ROL   [A,Y]
      ROL   [-71,Y]
      ROL   [<0,Y]
      ROL   [1,Y]
      ROL   [$00BA,Y]
      ROL   [D,Y]
      ROL   ,U+
      ROL   ,U++
      ROL   ,-U
      ROL   ,--U
      ROL   ,U
      ROL   B,U
      ROL   A,U
      ROL   -55,U
      ROL   <-16,U
      ROL   <0,U
      ROL   16,U
      ROL   $00CA,U
      ROL   D,U
      ROL   [,U++]
      ROL   [,--U]
      ROL   [,U]
      ROL   [B,U]
      ROL   [A,U]
      ROL   [-39,U]
      ROL   [<0,U]
      ROL   [1,U]
      ROL   [$00DA,U]
      ROL   [D,U]
      ROL   ,S+
      ROL   ,S++
      ROL   ,-S
      ROL   ,--S
      ROL   ,S
      ROL   B,S
      ROL   A,S
      ROL   -23,S
      ROL   <-16,S
      ROL   <0,S
      ROL   16,S
      ROL   $00EA,S
      ROL   D,S
      ROL   [,S++]
      ROL   [,--S]
      ROL   [,S]
      ROL   [B,S]
      ROL   [A,S]
      ROL   [-7,S]
      ROL   [<0,S]
      ROL   [1,S]
      ROL   [$00FA,S]
      ROL   [D,S]
      ROL   <<0,X
      ROL   1,X
      ROL   -16,X
      ROL   <<0,Y
      ROL   1,Y
      ROL   -16,Y
      ROL   <<0,U
      ROL   1,U
      ROL   -16,U
      ROL   <<0,S
      DEC   11,S
      DEC   -16,S
      DEC   ,X+
      DEC   ,X++
      DEC   ,-X
      DEC   ,--X
      DEC   ,X
      DEC   B,X
      DEC   A,X
      DEC   -119,X
      DEC   <-16,X
      DEC   <0,X
      DEC   16,X
      DEC   $008A,X
      DEC   D,X
      DEC   *-112,PCR
      DEC   *,PCR
      DEC   *+1,PCR
      DEC   *+$0092,PCR
      DEC   [,X++]
      DEC   [,--X]
      DEC   [,X]
      DEC   [B,X]
      DEC   [A,X]
      DEC   [-103,X]
      DEC   [<0,X]
      DEC   [1,X]
      DEC   [$009A,X]
      DEC   [D,X]
      DEC   [*-96,PCR]
      DEC   [*,PCR]
      DEC   [*+1,PCR]
      DEC   [*+$00A2,PCR]
      DEC   [$00A0]
      DEC   ,Y+
      DEC   ,Y++
      DEC   ,-Y
      DEC   ,--Y
      DEC   ,Y
      DEC   B,Y
      DEC   A,Y
      DEC   -87,Y
      DEC   <-16,Y
      DEC   <0,Y
      DEC   16,Y
      DEC   $00AA,Y
      DEC   D,Y
      DEC   [,Y++]
      DEC   [,--Y]
      DEC   [,Y]
      DEC   [B,Y]
      DEC   [A,Y]
      DEC   [-71,Y]
      DEC   [<0,Y]
      DEC   [1,Y]
      DEC   [$00BA,Y]
      DEC   [D,Y]
      DEC   ,U+
      DEC   ,U++
      DEC   ,-U
      DEC   ,--U
      DEC   ,U
      DEC   B,U
      DEC   A,U
      DEC   -55,U
      DEC   <-16,U
      DEC   <0,U
      DEC   16,U
      DEC   $00CA,U
      DEC   D,U
      DEC   [,U++]
      DEC   [,--U]
      DEC   [,U]
      DEC   [B,U]
      DEC   [A,U]
      DEC   [-39,U]
      DEC   [<0,U]
      DEC   [1,U]
      DEC   [$00DA,U]
      DEC   [D,U]
      DEC   ,S+
      DEC   ,S++
      DEC   ,-S
      DEC   ,--S
      DEC   ,S
      DEC   B,S
      DEC   A,S
      DEC   -23,S
      DEC   <-16,S
      DEC   <0,S
      DEC   16,S
      DEC   $00EA,S
      DEC   D,S
      DEC   [,S++]
      DEC   [,--S]
      DEC   [,S]
      DEC   [B,S]
      DEC   [A,S]
      DEC   [-7,S]
      DEC   [<0,S]
      DEC   [1,S]
      DEC   [$00FA,S]
      DEC   [D,S]
      DEC   <<0,X
      DEC   1,X
      DEC   -16,X
      DEC   <<0,Y
      DEC   1,Y
      DEC   -16,Y
      DEC   <<0,U
      DEC   1,U
      DEC   -16,U
      DEC   <<0,S
      INC   13,S
      INC   -16,S
      INC   ,X+
      INC   ,X++
      INC   ,-X
      INC   ,--X
      INC   ,X
      INC   B,X
      INC   A,X
      INC   -119,X
      INC   <-16,X
      INC   <0,X
      INC   16,X
      INC   $008A,X
      INC   D,X
      INC   *-112,PCR
      INC   *,PCR
      INC   *+1,PCR
      INC   *+$0092,PCR
      INC   [,X++]
      INC   [,--X]
      INC   [,X]
      INC   [B,X]
      INC   [A,X]
      INC   [-103,X]
      INC   [<0,X]
      INC   [1,X]
      INC   [$009A,X]
      INC   [D,X]
      INC   [*-96,PCR]
      INC   [*,PCR]
      INC   [*+1,PCR]
      INC   [*+$00A2,PCR]
      INC   [$00A0]
      INC   ,Y+
      INC   ,Y++
      INC   ,-Y
      INC   ,--Y
      INC   ,Y
      INC   B,Y
      INC   A,Y
      INC   -87,Y
      INC   <-16,Y
      INC   <0,Y
      INC   16,Y
      INC   $00AA,Y
      INC   D,Y
      INC   [,Y++]
      INC   [,--Y]
      INC   [,Y]
      INC   [B,Y]
      INC   [A,Y]
      INC   [-71,Y]
      INC   [<0,Y]
      INC   [1,Y]
      INC   [$00BA,Y]
      INC   [D,Y]
      INC   ,U+
      INC   ,U++
      INC   ,-U
      INC   ,--U
      INC   ,U
      INC   B,U
      INC   A,U
      INC   -55,U
      INC   <-16,U
      INC   <0,U
      INC   16,U
      INC   $00CA,U
      INC   D,U
      INC   [,U++]
      INC   [,--U]
      INC   [,U]
      INC   [B,U]
      INC   [A,U]
      INC   [-39,U]
      INC   [<0,U]
      INC   [1,U]
      INC   [$00DA,U]
      INC   [D,U]
      INC   ,S+
      INC   ,S++
      INC   ,-S
      INC   ,--S
      INC   ,S
      INC   B,S
      INC   A,S
      INC   -23,S
      INC   <-16,S
      INC   <0,S
      INC   16,S
      INC   $00EA,S
      INC   D,S
      INC   [,S++]
      INC   [,--S]
      INC   [,S]
      INC   [B,S]
      INC   [A,S]
      INC   [-7,S]
      INC   [<0,S]
      INC   [1,S]
      INC   [$00FA,S]
      INC   [D,S]
      INC   <<0,X
      INC   1,X
      INC   -16,X
      INC   <<0,Y
      INC   1,Y
      INC   -16,Y
      INC   <<0,U
      INC   1,U
      INC   -16,U
      INC   <<0,S
      TST   14,S
      TST   -16,S
      TST   ,X+
      TST   ,X++
      TST   ,-X
      TST   ,--X
      TST   ,X
      TST   B,X
      TST   A,X
      TST   -119,X
      TST   <-16,X
      TST   <0,X
      TST   16,X
      TST   $008A,X
      TST   D,X
      TST   *-112,PCR
      TST   *,PCR
      TST   *+1,PCR
      TST   *+$0092,PCR
      TST   [,X++]
      TST   [,--X]
      TST   [,X]
      TST   [B,X]
      TST   [A,X]
      TST   [-103,X]
      TST   [<0,X]
      TST   [1,X]
      TST   [$009A,X]
      TST   [D,X]
      TST   [*-96,PCR]
      TST   [*,PCR]
      TST   [*+1,PCR]
      TST   [*+$00A2,PCR]
      TST   [$00A0]
      TST   ,Y+
      TST   ,Y++
      TST   ,-Y
      TST   ,--Y
      TST   ,Y
      TST   B,Y
      TST   A,Y
      TST   -87,Y
      TST   <-16,Y
      TST   <0,Y
      TST   16,Y
      TST   $00AA,Y
      TST   D,Y
      TST   [,Y++]
      TST   [,--Y]
      TST   [,Y]
      TST   [B,Y]
      TST   [A,Y]
      TST   [-71,Y]
      TST   [<0,Y]
      TST   [1,Y]
      TST   [$00BA,Y]
      TST   [D,Y]
      TST   ,U+
      TST   ,U++
      TST   ,-U
      TST   ,--U
      TST   ,U
      TST   B,U
      TST   A,U
      TST   -55,U
      TST   <-16,U
      TST   <0,U
      TST   16,U
      TST   $00CA,U
      TST   D,U
      TST   [,U++]
      TST   [,--U]
      TST   [,U]
      TST   [B,U]
      TST   [A,U]
      TST   [-39,U]
      TST   [<0,U]
      TST   [1,U]
      TST   [$00DA,U]
      TST   [D,U]
      TST   ,S+
      TST   ,S++
      TST   ,-S
      TST   ,--S
      TST   ,S
      TST   B,S
      TST   A,S
      TST   -23,S
      TST   <-16,S
      TST   <0,S
      TST   16,S
      TST   $00EA,S
      TST   D,S
      TST   [,S++]
      TST   [,--S]
      TST   [,S]
      TST   [B,S]
      TST   [A,S]
      TST   [-7,S]
      TST   [<0,S]
      TST   [1,S]
      TST   [$00FA,S]
      TST   [D,S]
      TST   <<0,X
      TST   1,X
      TST   -16,X
      TST   <<0,Y
      TST   1,Y
      TST   -16,Y
      TST   <<0,U
      TST   1,U
      TST   -16,U
      TST   <<0,S
      JMP   15,S
      JMP   -16,S
      JMP   ,X+
      JMP   ,X++
      JMP   ,-X
      JMP   ,--X
      JMP   ,X
      JMP   B,X
      JMP   A,X
      JMP   -119,X
      JMP   <-16,X
      JMP   <0,X
      JMP   16,X
      JMP   $008A,X
      JMP   D,X
      JMP   *-112,PCR
      JMP   *,PCR
      JMP   *+1,PCR
      JMP   *+$0092,PCR
      JMP   [,X++]
      JMP   [,--X]
      JMP   [,X]
      JMP   [B,X]
      JMP   [A,X]
      JMP   [-103,X]
      JMP   [<0,X]
      JMP   [1,X]
      JMP   [$009A,X]
      JMP   [D,X]
      JMP   [*-96,PCR]
      JMP   [*,PCR]
      JMP   [*+1,PCR]
      JMP   [*+$00A2,PCR]
      JMP   [$00A0]
      JMP   ,Y+
      JMP   ,Y++
      JMP   ,-Y
      JMP   ,--Y
      JMP   ,Y
      JMP   B,Y
      JMP   A,Y
      JMP   -87,Y
      JMP   <-16,Y
      JMP   <0,Y
      JMP   16,Y
      JMP   $00AA,Y
      JMP   D,Y
      JMP   [,Y++]
      JMP   [,--Y]
      JMP   [,Y]
      JMP   [B,Y]
      JMP   [A,Y]
      JMP   [-71,Y]
      JMP   [<0,Y]
      JMP   [1,Y]
      JMP   [$00BA,Y]
      JMP   [D,Y]
      JMP   ,U+
      JMP   ,U++
      JMP   ,-U
      JMP   ,--U
      JMP   ,U
      JMP   B,U
      JMP   A,U
      JMP   -55,U
      JMP   <-16,U
      JMP   <0,U
      JMP   16,U
      JMP   $00CA,U
      JMP   D,U
      JMP   [,U++]
      JMP   [,--U]
      JMP   [,U]
      JMP   [B,U]
      JMP   [A,U]
      JMP   [-39,U]
      JMP   [<0,U]
      JMP   [1,U]
      JMP   [$00DA,U]
      JMP   [D,U]
      JMP   ,S+
      JMP   ,S++
      JMP   ,-S
      JMP   ,--S
      JMP   ,S
      JMP   B,S
      JMP   A,S
      JMP   -23,S
      JMP   <-16,S
      JMP   <0,S
      JMP   16,S
      JMP   $00EA,S
      JMP   D,S
      JMP   [,S++]
      JMP   [,--S]
      JMP   [,S]
      JMP   [B,S]
      JMP   [A,S]
      JMP   [-7,S]
      JMP   [<0,S]
      JMP   [1,S]
      JMP   [$00FA,S]
      JMP   [D,S]
      JMP   <<0,X
      JMP   1,X
      JMP   -16,X
      JMP   <<0,Y
      JMP   1,Y
      JMP   -16,Y
      JMP   <<0,U
      JMP   1,U
      JMP   -16,U
      JMP   <<0,S
      CLR   -16,S
      CLR   ,X+
      CLR   ,X++
      CLR   ,-X
      CLR   ,--X
      CLR   ,X
      CLR   B,X
      CLR   A,X
      CLR   -119,X
      CLR   <-16,X
      CLR   <0,X
      CLR   16,X
      CLR   $008A,X
      CLR   D,X
      CLR   *-112,PCR
      CLR   *,PCR
      CLR   *+1,PCR
      CLR   *+$0092,PCR
      CLR   [,X++]
      CLR   [,--X]
      CLR   [,X]
      CLR   [B,X]
      CLR   [A,X]
      CLR   [-103,X]
      CLR   [<0,X]
      CLR   [1,X]
      CLR   [$009A,X]
      CLR   [D,X]
      CLR   [*-96,PCR]
      CLR   [*,PCR]
      CLR   [*+1,PCR]
      CLR   [*+$00A2,PCR]
      CLR   [$00A0]
      CLR   ,Y+
      CLR   ,Y++
      CLR   ,-Y
      CLR   ,--Y
      CLR   ,Y
      CLR   B,Y
      CLR   A,Y
      CLR   -87,Y
      CLR   <-16,Y
      CLR   <0,Y
      CLR   16,Y
      CLR   $00AA,Y
      CLR   D,Y
      CLR   [,Y++]
      CLR   [,--Y]
      CLR   [,Y]
      CLR   [B,Y]
      CLR   [A,Y]
      CLR   [-71,Y]
      CLR   [<0,Y]
      CLR   [1,Y]
      CLR   [$00BA,Y]
      CLR   [D,Y]
      CLR   ,U+
      CLR   ,U++
      CLR   ,-U
      CLR   ,--U
      CLR   ,U
      CLR   B,U
      CLR   A,U
      CLR   -55,U
      CLR   <-16,U
      CLR   <0,U
      CLR   16,U
      CLR   $00CA,U
      CLR   D,U
      CLR   [,U++]
      CLR   [,--U]
      CLR   [,U]
      CLR   [B,U]
      CLR   [A,U]
      CLR   [-39,U]
      CLR   [<0,U]
      CLR   [1,U]
      CLR   [$00DA,U]
      CLR   [D,U]
      CLR   ,S+
      CLR   ,S++
      CLR   ,-S
      CLR   ,--S
      CLR   ,S
      CLR   B,S
      CLR   A,S
      CLR   -23,S
      CLR   <-16,S
      CLR   <0,S
      CLR   16,S
      CLR   $00EA,S
      CLR   D,S
      CLR   [,S++]
      CLR   [,--S]
      CLR   [,S]
      CLR   [B,S]
      CLR   [A,S]
      CLR   [-7,S]
      CLR   [<0,S]
      CLR   [1,S]
      CLR   [$00FA,S]
      CLR   [D,S]
      CLR   <<0,X
      CLR   1,X
      CLR   -16,X
      CLR   <<0,Y
      CLR   1,Y
      CLR   -16,Y
      CLR   <<0,U
      CLR   1,U
      CLR   -16,U
      CLR   <<0,S
      CLR   1,S
      NEG   >$0071
      NEG   $0100
      COM   >$0074
      COM   $0100
      LSR   >$0075
      LSR   $0100
      ROR   >$0077
      ROR   $0100
      ASR   >$0078
      ASR   $0100
      ASL   >$0079
      ASL   $0100
      ROL   >$007A
      ROL   $0100
      DEC   >$007B
      DEC   $0100
      INC   >$007D
      INC   $0100
      TST   >$007E
      TST   $0100
      JMP   >$007F
      JMP   $0100
      CLR   >$0080
      CLR   $0100
      SUBA  #$81
      CMPA  #$82
      SBCA  #$83
      SUBD  #$0084
      ANDA  #$85
      BITA  #$86
      LDA   #$87
      EORA  #$89
      ADCA  #$8A
      ORA   #$8B
      ADDA  #$8C
      CMPX  #$008D
      BSR   *-112
      BSR   *
      BSR   *+1
      LDX   #$008F
      SUBA  $91
      CMPA  $92
      SBCA  $93
      SUBD  $94
      ANDA  $95
      BITA  $96
      LDA   $97
      STA   $98
      EORA  $99
      ADCA  $9A
      ORA   $9B
      ADDA  $9C
      CMPX  $9D
      JSR   $9E
      LDX   $9F
      STX   $A0
      SUBA  ,Y++
      SUBA  ,-Y
      SUBA  ,--Y
      SUBA  ,Y
      SUBA  B,Y
      SUBA  A,Y
      SUBA  -87,Y
      SUBA  <-16,Y
      SUBA  <0,Y
      SUBA  16,Y
      SUBA  $00AA,Y
      SUBA  D,Y
      SUBA  *-80,PCR
      SUBA  *,PCR
      SUBA  *+1,PCR
      SUBA  *+$00B2,PCR
      SUBA  [,Y++]
      SUBA  [,--Y]
      SUBA  [,Y]
      SUBA  [B,Y]
      SUBA  [A,Y]
      SUBA  [-71,Y]
      SUBA  [<0,Y]
      SUBA  [1,Y]
      SUBA  [$00BA,Y]
      SUBA  [D,Y]
      SUBA  [*-64,PCR]
      SUBA  [*,PCR]
      SUBA  [*+1,PCR]
      SUBA  [*+$00C2,PCR]
      SUBA  ,U+
      SUBA  ,U++
      SUBA  ,-U
      SUBA  ,--U
      SUBA  ,U
      SUBA  B,U
      SUBA  A,U
      SUBA  -55,U
      SUBA  <-16,U
      SUBA  <0,U
      SUBA  16,U
      SUBA  $00CA,U
      SUBA  D,U
      SUBA  [,U++]
      SUBA  [,--U]
      SUBA  [,U]
      SUBA  [B,U]
      SUBA  [A,U]
      SUBA  [-39,U]
      SUBA  [<0,U]
      SUBA  [1,U]
      SUBA  [$00DA,U]
      SUBA  [D,U]
      SUBA  ,S+
      SUBA  ,S++
      SUBA  ,-S
      SUBA  ,--S
      SUBA  ,S
      SUBA  B,S
      SUBA  A,S
      SUBA  -23,S
      SUBA  <-16,S
      SUBA  <0,S
      SUBA  16,S
      SUBA  $00EA,S
      SUBA  D,S
      SUBA  [,S++]
      SUBA  [,--S]
      SUBA  [,S]
      SUBA  [B,S]
      SUBA  [A,S]
      SUBA  [-7,S]
      SUBA  [<0,S]
      SUBA  [1,S]
      SUBA  [$00FA,S]
      SUBA  [D,S]
      SUBA  <<0,X
      SUBA  1,X
      SUBA  -16,X
      SUBA  <<0,Y
      SUBA  1,Y
      SUBA  -16,Y
      SUBA  <<0,U
      SUBA  1,U
      SUBA  -16,U
      SUBA  <<0,S
      SUBA  1,S
      SUBA  -16,S
      SUBA  ,X+
      SUBA  ,X++
      SUBA  ,-X
      SUBA  ,--X
      SUBA  ,X
      SUBA  B,X
      SUBA  A,X
      SUBA  -119,X
      SUBA  <-16,X
      SUBA  <0,X
      SUBA  16,X
      SUBA  $018A,X
      SUBA  D,X
      SUBA  [,X++]
      SUBA  [,--X]
      SUBA  [,X]
      SUBA  [B,X]
      SUBA  [A,X]
      SUBA  [-103,X]
      SUBA  [<0,X]
      SUBA  [1,X]
      SUBA  [$019A,X]
      SUBA  [D,X]
      SUBA  [$01A0]
      SUBA  ,Y+
      CMPA  ,-Y
      CMPA  ,--Y
      CMPA  ,Y
      CMPA  B,Y
      CMPA  A,Y
      CMPA  -87,Y
      CMPA  <-16,Y
      CMPA  <0,Y
      CMPA  16,Y
      CMPA  $00AA,Y
      CMPA  D,Y
      CMPA  *-80,PCR
      CMPA  *,PCR
      CMPA  *+1,PCR
      CMPA  *+$00B2,PCR
      CMPA  [,Y++]
      CMPA  [,--Y]
      CMPA  [,Y]
      CMPA  [B,Y]
      CMPA  [A,Y]
      CMPA  [-71,Y]
      CMPA  [<0,Y]
      CMPA  [1,Y]
      CMPA  [$00BA,Y]
      CMPA  [D,Y]
      CMPA  [*-64,PCR]
      CMPA  [*,PCR]
      CMPA  [*+1,PCR]
      CMPA  [*+$00C2,PCR]
      CMPA  ,U+
      CMPA  ,U++
      CMPA  ,-U
      CMPA  ,--U
      CMPA  ,U
      CMPA  B,U
      CMPA  A,U
      CMPA  -55,U
      CMPA  <-16,U
      CMPA  <0,U
      CMPA  16,U
      CMPA  $00CA,U
      CMPA  D,U
      CMPA  [,U++]
      CMPA  [,--U]
      CMPA  [,U]
      CMPA  [B,U]
      CMPA  [A,U]
      CMPA  [-39,U]
      CMPA  [<0,U]
      CMPA  [1,U]
      CMPA  [$00DA,U]
      CMPA  [D,U]
      CMPA  ,S+
      CMPA  ,S++
      CMPA  ,-S
      CMPA  ,--S
      CMPA  ,S
      CMPA  B,S
      CMPA  A,S
      CMPA  -23,S
      CMPA  <-16,S
      CMPA  <0,S
      CMPA  16,S
      CMPA  $00EA,S
      CMPA  D,S
      CMPA  [,S++]
      CMPA  [,--S]
      CMPA  [,S]
      CMPA  [B,S]
      CMPA  [A,S]
      CMPA  [-7,S]
      CMPA  [<0,S]
      CMPA  [1,S]
      CMPA  [$00FA,S]
      CMPA  [D,S]
      CMPA  <<0,X
      CMPA  1,X
      CMPA  -16,X
      CMPA  <<0,Y
      CMPA  1,Y
      CMPA  -16,Y
      CMPA  <<0,U
      CMPA  1,U
      CMPA  -16,U
      CMPA  <<0,S
      CMPA  1,S
      CMPA  -16,S
      CMPA  ,X+
      CMPA  ,X++
      CMPA  ,-X
      CMPA  ,--X
      CMPA  ,X
      CMPA  B,X
      CMPA  A,X
      CMPA  -119,X
      CMPA  <-16,X
      CMPA  <0,X
      CMPA  16,X
      CMPA  $018A,X
      CMPA  D,X
      CMPA  [,X++]
      CMPA  [,--X]
      CMPA  [,X]
      CMPA  [B,X]
      CMPA  [A,X]
      CMPA  [-103,X]
      CMPA  [<0,X]
      CMPA  [1,X]
      CMPA  [$019A,X]
      CMPA  [D,X]
      CMPA  [$01A0]
      CMPA  ,Y+
      CMPA  ,Y++
      SBCA  ,--Y
      SBCA  ,Y
      SBCA  B,Y
      SBCA  A,Y
      SBCA  -87,Y
      SBCA  <-16,Y
      SBCA  <0,Y
      SBCA  16,Y
      SBCA  $00AA,Y
      SBCA  D,Y
      SBCA  *-80,PCR
      SBCA  *,PCR
      SBCA  *+1,PCR
      SBCA  *+$00B2,PCR
      SBCA  [,Y++]
      SBCA  [,--Y]
      SBCA  [,Y]
      SBCA  [B,Y]
      SBCA  [A,Y]
      SBCA  [-71,Y]
      SBCA  [<0,Y]
      SBCA  [1,Y]
      SBCA  [$00BA,Y]
      SBCA  [D,Y]
      SBCA  [*-64,PCR]
      SBCA  [*,PCR]
      SBCA  [*+1,PCR]
      SBCA  [*+$00C2,PCR]
      SBCA  ,U+
      SBCA  ,U++
      SBCA  ,-U
      SBCA  ,--U
      SBCA  ,U
      SBCA  B,U
      SBCA  A,U
      SBCA  -55,U
      SBCA  <-16,U
      SBCA  <0,U
      SBCA  16,U
      SBCA  $00CA,U
      SBCA  D,U
      SBCA  [,U++]
      SBCA  [,--U]
      SBCA  [,U]
      SBCA  [B,U]
      SBCA  [A,U]
      SBCA  [-39,U]
      SBCA  [<0,U]
      SBCA  [1,U]
      SBCA  [$00DA,U]
      SBCA  [D,U]
      SBCA  ,S+
      SBCA  ,S++
      SBCA  ,-S
      SBCA  ,--S
      SBCA  ,S
      SBCA  B,S
      SBCA  A,S
      SBCA  -23,S
      SBCA  <-16,S
      SBCA  <0,S
      SBCA  16,S
      SBCA  $00EA,S
      SBCA  D,S
      SBCA  [,S++]
      SBCA  [,--S]
      SBCA  [,S]
      SBCA  [B,S]
      SBCA  [A,S]
      SBCA  [-7,S]
      SBCA  [<0,S]
      SBCA  [1,S]
      SBCA  [$00FA,S]
      SBCA  [D,S]
      SBCA  <<0,X
      SBCA  1,X
      SBCA  -16,X
      SBCA  <<0,Y
      SBCA  1,Y
      SBCA  -16,Y
      SBCA  <<0,U
      SBCA  1,U
      SBCA  -16,U
      SBCA  <<0,S
      SBCA  1,S
      SBCA  -16,S
      SBCA  ,X+
      SBCA  ,X++
      SBCA  ,-X
      SBCA  ,--X
      SBCA  ,X
      SBCA  B,X
      SBCA  A,X
      SBCA  -119,X
      SBCA  <-16,X
      SBCA  <0,X
      SBCA  16,X
      SBCA  $018A,X
      SBCA  D,X
      SBCA  [,X++]
      SBCA  [,--X]
      SBCA  [,X]
      SBCA  [B,X]
      SBCA  [A,X]
      SBCA  [-103,X]
      SBCA  [<0,X]
      SBCA  [1,X]
      SBCA  [$019A,X]
      SBCA  [D,X]
      SBCA  [$01A0]
      SBCA  ,Y+
      SBCA  ,Y++
      SBCA  ,-Y
      SUBD  ,Y
      SUBD  B,Y
      SUBD  A,Y
      SUBD  -87,Y
      SUBD  <-16,Y
      SUBD  <0,Y
      SUBD  16,Y
      SUBD  $00AA,Y
      SUBD  D,Y
      SUBD  *-80,PCR
      SUBD  *,PCR
      SUBD  *+1,PCR
      SUBD  *+$00B2,PCR
      SUBD  [,Y++]
      SUBD  [,--Y]
      SUBD  [,Y]
      SUBD  [B,Y]
      SUBD  [A,Y]
      SUBD  [-71,Y]
      SUBD  [<0,Y]
      SUBD  [1,Y]
      SUBD  [$00BA,Y]
      SUBD  [D,Y]
      SUBD  [*-64,PCR]
      SUBD  [*,PCR]
      SUBD  [*+1,PCR]
      SUBD  [*+$00C2,PCR]
      SUBD  ,U+
      SUBD  ,U++
      SUBD  ,-U
      SUBD  ,--U
      SUBD  ,U
      SUBD  B,U
      SUBD  A,U
      SUBD  -55,U
      SUBD  <-16,U
      SUBD  <0,U
      SUBD  16,U
      SUBD  $00CA,U
      SUBD  D,U
      SUBD  [,U++]
      SUBD  [,--U]
      SUBD  [,U]
      SUBD  [B,U]
      SUBD  [A,U]
      SUBD  [-39,U]
      SUBD  [<0,U]
      SUBD  [1,U]
      SUBD  [$00DA,U]
      SUBD  [D,U]
      SUBD  ,S+
      SUBD  ,S++
      SUBD  ,-S
      SUBD  ,--S
      SUBD  ,S
      SUBD  B,S
      SUBD  A,S
      SUBD  -23,S
      SUBD  <-16,S
      SUBD  <0,S
      SUBD  16,S
      SUBD  $00EA,S
      SUBD  D,S
      SUBD  [,S++]
      SUBD  [,--S]
      SUBD  [,S]
      SUBD  [B,S]
      SUBD  [A,S]
      SUBD  [-7,S]
      SUBD  [<0,S]
      SUBD  [1,S]
      SUBD  [$00FA,S]
      SUBD  [D,S]
      SUBD  <<0,X
      SUBD  1,X
      SUBD  -16,X
      SUBD  <<0,Y
      SUBD  1,Y
      SUBD  -16,Y
      SUBD  <<0,U
      SUBD  1,U
      SUBD  -16,U
      SUBD  <<0,S
      SUBD  1,S
      SUBD  -16,S
      SUBD  ,X+
      SUBD  ,X++
      SUBD  ,-X
      SUBD  ,--X
      SUBD  ,X
      SUBD  B,X
      SUBD  A,X
      SUBD  -119,X
      SUBD  <-16,X
      SUBD  <0,X
      SUBD  16,X
      SUBD  $018A,X
      SUBD  D,X
      SUBD  [,X++]
      SUBD  [,--X]
      SUBD  [,X]
      SUBD  [B,X]
      SUBD  [A,X]
      SUBD  [-103,X]
      SUBD  [<0,X]
      SUBD  [1,X]
      SUBD  [$019A,X]
      SUBD  [D,X]
      SUBD  [$01A0]
      SUBD  ,Y+
      SUBD  ,Y++
      SUBD  ,-Y
      SUBD  ,--Y
      ANDA  B,Y
      ANDA  A,Y
      ANDA  -87,Y
      ANDA  <-16,Y
      ANDA  <0,Y
      ANDA  16,Y
      ANDA  $00AA,Y
      ANDA  D,Y
      ANDA  *-80,PCR
      ANDA  *,PCR
      ANDA  *+1,PCR
      ANDA  *+$00B2,PCR
      ANDA  [,Y++]
      ANDA  [,--Y]
      ANDA  [,Y]
      ANDA  [B,Y]
      ANDA  [A,Y]
      ANDA  [-71,Y]
      ANDA  [<0,Y]
      ANDA  [1,Y]
      ANDA  [$00BA,Y]
      ANDA  [D,Y]
      ANDA  [*-64,PCR]
      ANDA  [*,PCR]
      ANDA  [*+1,PCR]
      ANDA  [*+$00C2,PCR]
      ANDA  ,U+
      ANDA  ,U++
      ANDA  ,-U
      ANDA  ,--U
      ANDA  ,U
      ANDA  B,U
      ANDA  A,U
      ANDA  -55,U
      ANDA  <-16,U
      ANDA  <0,U
      ANDA  16,U
      ANDA  $00CA,U
      ANDA  D,U
      ANDA  [,U++]
      ANDA  [,--U]
      ANDA  [,U]
      ANDA  [B,U]
      ANDA  [A,U]
      ANDA  [-39,U]
      ANDA  [<0,U]
      ANDA  [1,U]
      ANDA  [$00DA,U]
      ANDA  [D,U]
      ANDA  ,S+
      ANDA  ,S++
      ANDA  ,-S
      ANDA  ,--S
      ANDA  ,S
      ANDA  B,S
      ANDA  A,S
      ANDA  -23,S
      ANDA  <-16,S
      ANDA  <0,S
      ANDA  16,S
      ANDA  $00EA,S
      ANDA  D,S
      ANDA  [,S++]
      ANDA  [,--S]
      ANDA  [,S]
      ANDA  [B,S]
      ANDA  [A,S]
      ANDA  [-7,S]
      ANDA  [<0,S]
      ANDA  [1,S]
      ANDA  [$00FA,S]
      ANDA  [D,S]
      ANDA  <<0,X
      ANDA  1,X
      ANDA  -16,X
      ANDA  <<0,Y
      ANDA  1,Y
      ANDA  -16,Y
      ANDA  <<0,U
      ANDA  1,U
      ANDA  -16,U
      ANDA  <<0,S
      ANDA  1,S
      ANDA  -16,S
      ANDA  ,X+
      ANDA  ,X++
      ANDA  ,-X
      ANDA  ,--X
      ANDA  ,X
      ANDA  B,X
      ANDA  A,X
      ANDA  -119,X
      ANDA  <-16,X
      ANDA  <0,X
      ANDA  16,X
      ANDA  $018A,X
      ANDA  D,X
      ANDA  [,X++]
      ANDA  [,--X]
      ANDA  [,X]
      ANDA  [B,X]
      ANDA  [A,X]
      ANDA  [-103,X]
      ANDA  [<0,X]
      ANDA  [1,X]
      ANDA  [$019A,X]
      ANDA  [D,X]
      ANDA  [$01A0]
      ANDA  ,Y+
      ANDA  ,Y++
      ANDA  ,-Y
      ANDA  ,--Y
      ANDA  ,Y
      BITA  A,Y
      BITA  -87,Y
      BITA  <-16,Y
      BITA  <0,Y
      BITA  16,Y
      BITA  $00AA,Y
      BITA  D,Y
      BITA  *-80,PCR
      BITA  *,PCR
      BITA  *+1,PCR
      BITA  *+$00B2,PCR
      BITA  [,Y++]
      BITA  [,--Y]
      BITA  [,Y]
      BITA  [B,Y]
      BITA  [A,Y]
      BITA  [-71,Y]
      BITA  [<0,Y]
      BITA  [1,Y]
      BITA  [$00BA,Y]
      BITA  [D,Y]
      BITA  [*-64,PCR]
      BITA  [*,PCR]
      BITA  [*+1,PCR]
      BITA  [*+$00C2,PCR]
      BITA  ,U+
      BITA  ,U++
      BITA  ,-U
      BITA  ,--U
      BITA  ,U
      BITA  B,U
      BITA  A,U
      BITA  -55,U
      BITA  <-16,U
      BITA  <0,U
      BITA  16,U
      BITA  $00CA,U
      BITA  D,U
      BITA  [,U++]
      BITA  [,--U]
      BITA  [,U]
      BITA  [B,U]
      BITA  [A,U]
      BITA  [-39,U]
      BITA  [<0,U]
      BITA  [1,U]
      BITA  [$00DA,U]
      BITA  [D,U]
      BITA  ,S+
      BITA  ,S++
      BITA  ,-S
      BITA  ,--S
      BITA  ,S
      BITA  B,S
      BITA  A,S
      BITA  -23,S
      BITA  <-16,S
      BITA  <0,S
      BITA  16,S
      BITA  $00EA,S
      BITA  D,S
      BITA  [,S++]
      BITA  [,--S]
      BITA  [,S]
      BITA  [B,S]
      BITA  [A,S]
      BITA  [-7,S]
      BITA  [<0,S]
      BITA  [1,S]
      BITA  [$00FA,S]
      BITA  [D,S]
      BITA  <<0,X
      BITA  1,X
      BITA  -16,X
      BITA  <<0,Y
      BITA  1,Y
      BITA  -16,Y
      BITA  <<0,U
      BITA  1,U
      BITA  -16,U
      BITA  <<0,S
      BITA  1,S
      BITA  -16,S
      BITA  ,X+
      BITA  ,X++
      BITA  ,-X
      BITA  ,--X
      BITA  ,X
      BITA  B,X
      BITA  A,X
      BITA  -119,X
      BITA  <-16,X
      BITA  <0,X
      BITA  16,X
      BITA  $018A,X
      BITA  D,X
      BITA  [,X++]
      BITA  [,--X]
      BITA  [,X]
      BITA  [B,X]
      BITA  [A,X]
      BITA  [-103,X]
      BITA  [<0,X]
      BITA  [1,X]
      BITA  [$019A,X]
      BITA  [D,X]
      BITA  [$01A0]
      BITA  ,Y+
      BITA  ,Y++
      BITA  ,-Y
      BITA  ,--Y
      BITA  ,Y
      BITA  B,Y
      LDA   -87,Y
      LDA   <-16,Y
      LDA   <0,Y
      LDA   16,Y
      LDA   $00AA,Y
      LDA   D,Y
      LDA   *-80,PCR
      LDA   *,PCR
      LDA   *+1,PCR
      LDA   *+$00B2,PCR
      LDA   [,Y++]
      LDA   [,--Y]
      LDA   [,Y]
      LDA   [B,Y]
      LDA   [A,Y]
      LDA   [-71,Y]
      LDA   [<0,Y]
      LDA   [1,Y]
      LDA   [$00BA,Y]
      LDA   [D,Y]
      LDA   [*-64,PCR]
      LDA   [*,PCR]
      LDA   [*+1,PCR]
      LDA   [*+$00C2,PCR]
      LDA   ,U+
      LDA   ,U++
      LDA   ,-U
      LDA   ,--U
      LDA   ,U
      LDA   B,U
      LDA   A,U
      LDA   -55,U
      LDA   <-16,U
      LDA   <0,U
      LDA   16,U
      LDA   $00CA,U
      LDA   D,U
      LDA   [,U++]
      LDA   [,--U]
      LDA   [,U]
      LDA   [B,U]
      LDA   [A,U]
      LDA   [-39,U]
      LDA   [<0,U]
      LDA   [1,U]
      LDA   [$00DA,U]
      LDA   [D,U]
      LDA   ,S+
      LDA   ,S++
      LDA   ,-S
      LDA   ,--S
      LDA   ,S
      LDA   B,S
      LDA   A,S
      LDA   -23,S
      LDA   <-16,S
      LDA   <0,S
      LDA   16,S
      LDA   $00EA,S
      LDA   D,S
      LDA   [,S++]
      LDA   [,--S]
      LDA   [,S]
      LDA   [B,S]
      LDA   [A,S]
      LDA   [-7,S]
      LDA   [<0,S]
      LDA   [1,S]
      LDA   [$00FA,S]
      LDA   [D,S]
      LDA   <<0,X
      LDA   1,X
      LDA   -16,X
      LDA   <<0,Y
      LDA   1,Y
      LDA   -16,Y
      LDA   <<0,U
      LDA   1,U
      LDA   -16,U
      LDA   <<0,S
      LDA   1,S
      LDA   -16,S
      LDA   ,X+
      LDA   ,X++
      LDA   ,-X
      LDA   ,--X
      LDA   ,X
      LDA   B,X
      LDA   A,X
      LDA   -119,X
      LDA   <-16,X
      LDA   <0,X
      LDA   16,X
      LDA   $018A,X
      LDA   D,X
      LDA   [,X++]
      LDA   [,--X]
      LDA   [,X]
      LDA   [B,X]
      LDA   [A,X]
      LDA   [-103,X]
      LDA   [<0,X]
      LDA   [1,X]
      LDA   [$019A,X]
      LDA   [D,X]
      LDA   [$01A0]
      LDA   ,Y+
      LDA   ,Y++
      LDA   ,-Y
      LDA   ,--Y
      LDA   ,Y
      LDA   B,Y
      LDA   A,Y
      STA   -87,Y
      STA   <-16,Y
      STA   <0,Y
      STA   16,Y
      STA   $00AA,Y
      STA   D,Y
      STA   *-80,PCR
      STA   *,PCR
      STA   *+1,PCR
      STA   *+$00B2,PCR
      STA   [,Y++]
      STA   [,--Y]
      STA   [,Y]
      STA   [B,Y]
      STA   [A,Y]
      STA   [-71,Y]
      STA   [<0,Y]
      STA   [1,Y]
      STA   [$00BA,Y]
      STA   [D,Y]
      STA   [*-64,PCR]
      STA   [*,PCR]
      STA   [*+1,PCR]
      STA   [*+$00C2,PCR]
      STA   ,U+
      STA   ,U++
      STA   ,-U
      STA   ,--U
      STA   ,U
      STA   B,U
      STA   A,U
      STA   -55,U
      STA   <-16,U
      STA   <0,U
      STA   16,U
      STA   $00CA,U
      STA   D,U
      STA   [,U++]
      STA   [,--U]
      STA   [,U]
      STA   [B,U]
      STA   [A,U]
      STA   [-39,U]
      STA   [<0,U]
      STA   [1,U]
      STA   [$00DA,U]
      STA   [D,U]
      STA   ,S+
      STA   ,S++
      STA   ,-S
      STA   ,--S
      STA   ,S
      STA   B,S
      STA   A,S
      STA   -23,S
      STA   <-16,S
      STA   <0,S
      STA   16,S
      STA   $00EA,S
      STA   D,S
      STA   [,S++]
      STA   [,--S]
      STA   [,S]
      STA   [B,S]
      STA   [A,S]
      STA   [-7,S]
      STA   [<0,S]
      STA   [1,S]
      STA   [$00FA,S]
      STA   [D,S]
      STA   <<0,X
      STA   1,X
      STA   -16,X
      STA   <<0,Y
      STA   1,Y
      STA   -16,Y
      STA   <<0,U
      STA   1,U
      STA   -16,U
      STA   <<0,S
      STA   1,S
      STA   -16,S
      STA   ,X+
      STA   ,X++
      STA   ,-X
      STA   ,--X
      STA   ,X
      STA   B,X
      STA   A,X
      STA   -119,X
      STA   <-16,X
      STA   <0,X
      STA   16,X
      STA   $018A,X
      STA   D,X
      STA   [,X++]
      STA   [,--X]
      STA   [,X]
      STA   [B,X]
      STA   [A,X]
      STA   [-103,X]
      STA   [<0,X]
      STA   [1,X]
      STA   [$019A,X]
      STA   [D,X]
      STA   [$01A0]
      STA   ,Y+
      STA   ,Y++
      STA   ,-Y
      STA   ,--Y
      STA   ,Y
      STA   B,Y
      STA   A,Y
      EORA  $00AA,Y
      EORA  D,Y
      EORA  *-80,PCR
      EORA  *,PCR
      EORA  *+1,PCR
      EORA  *+$00B2,PCR
      EORA  [,Y++]
      EORA  [,--Y]
      EORA  [,Y]
      EORA  [B,Y]
      EORA  [A,Y]
      EORA  [-71,Y]
      EORA  [<0,Y]
      EORA  [1,Y]
      EORA  [$00BA,Y]
      EORA  [D,Y]
      EORA  [*-64,PCR]
      EORA  [*,PCR]
      EORA  [*+1,PCR]
      EORA  [*+$00C2,PCR]
      EORA  ,U+
      EORA  ,U++
      EORA  ,-U
      EORA  ,--U
      EORA  ,U
      EORA  B,U
      EORA  A,U
      EORA  -55,U
      EORA  <-16,U
      EORA  <0,U
      EORA  16,U
      EORA  $00CA,U
      EORA  D,U
      EORA  [,U++]
      EORA  [,--U]
      EORA  [,U]
      EORA  [B,U]
      EORA  [A,U]
      EORA  [-39,U]
      EORA  [<0,U]
      EORA  [1,U]
      EORA  [$00DA,U]
      EORA  [D,U]
      EORA  ,S+
      EORA  ,S++
      EORA  ,-S
      EORA  ,--S
      EORA  ,S
      EORA  B,S
      EORA  A,S
      EORA  -23,S
      EORA  <-16,S
      EORA  <0,S
      EORA  16,S
      EORA  $00EA,S
      EORA  D,S
      EORA  [,S++]
      EORA  [,--S]
      EORA  [,S]
      EORA  [B,S]
      EORA  [A,S]
      EORA  [-7,S]
      EORA  [<0,S]
      EORA  [1,S]
      EORA  [$00FA,S]
      EORA  [D,S]
      EORA  <<0,X
      EORA  1,X
      EORA  -16,X
      EORA  <<0,Y
      EORA  1,Y
      EORA  -16,Y
      EORA  <<0,U
      EORA  1,U
      EORA  -16,U
      EORA  <<0,S
      EORA  1,S
      EORA  -16,S
      EORA  ,X+
      EORA  ,X++
      EORA  ,-X
      EORA  ,--X
      EORA  ,X
      EORA  B,X
      EORA  A,X
      EORA  -119,X
      EORA  <-16,X
      EORA  <0,X
      EORA  16,X
      EORA  $018A,X
      EORA  D,X
      EORA  [,X++]
      EORA  [,--X]
      EORA  [,X]
      EORA  [B,X]
      EORA  [A,X]
      EORA  [-103,X]
      EORA  [<0,X]
      EORA  [1,X]
      EORA  [$019A,X]
      EORA  [D,X]
      EORA  [$01A0]
      EORA  ,Y+
      EORA  ,Y++
      EORA  ,-Y
      EORA  ,--Y
      EORA  ,Y
      EORA  B,Y
      EORA  A,Y
      EORA  -87,Y
      EORA  <-16,Y
      EORA  <0,Y
      EORA  16,Y
      ADCA  D,Y
      ADCA  *-80,PCR
      ADCA  *,PCR
      ADCA  *+1,PCR
      ADCA  *+$00B2,PCR
      ADCA  [,Y++]
      ADCA  [,--Y]
      ADCA  [,Y]
      ADCA  [B,Y]
      ADCA  [A,Y]
      ADCA  [-71,Y]
      ADCA  [<0,Y]
      ADCA  [1,Y]
      ADCA  [$00BA,Y]
      ADCA  [D,Y]
      ADCA  [*-64,PCR]
      ADCA  [*,PCR]
      ADCA  [*+1,PCR]
      ADCA  [*+$00C2,PCR]
      ADCA  ,U+
      ADCA  ,U++
      ADCA  ,-U
      ADCA  ,--U
      ADCA  ,U
      ADCA  B,U
      ADCA  A,U
      ADCA  -55,U
      ADCA  <-16,U
      ADCA  <0,U
      ADCA  16,U
      ADCA  $00CA,U
      ADCA  D,U
      ADCA  [,U++]
      ADCA  [,--U]
      ADCA  [,U]
      ADCA  [B,U]
      ADCA  [A,U]
      ADCA  [-39,U]
      ADCA  [<0,U]
      ADCA  [1,U]
      ADCA  [$00DA,U]
      ADCA  [D,U]
      ADCA  ,S+
      ADCA  ,S++
      ADCA  ,-S
      ADCA  ,--S
      ADCA  ,S
      ADCA  B,S
      ADCA  A,S
      ADCA  -23,S
      ADCA  <-16,S
      ADCA  <0,S
      ADCA  16,S
      ADCA  $00EA,S
      ADCA  D,S
      ADCA  [,S++]
      ADCA  [,--S]
      ADCA  [,S]
      ADCA  [B,S]
      ADCA  [A,S]
      ADCA  [-7,S]
      ADCA  [<0,S]
      ADCA  [1,S]
      ADCA  [$00FA,S]
      ADCA  [D,S]
      ADCA  <<0,X
      ADCA  1,X
      ADCA  -16,X
      ADCA  <<0,Y
      ADCA  1,Y
      ADCA  -16,Y
      ADCA  <<0,U
      ADCA  1,U
      ADCA  -16,U
      ADCA  <<0,S
      ADCA  1,S
      ADCA  -16,S
      ADCA  ,X+
      ADCA  ,X++
      ADCA  ,-X
      ADCA  ,--X
      ADCA  ,X
      ADCA  B,X
      ADCA  A,X
      ADCA  -119,X
      ADCA  <-16,X
      ADCA  <0,X
      ADCA  16,X
      ADCA  $018A,X
      ADCA  D,X
      ADCA  [,X++]
      ADCA  [,--X]
      ADCA  [,X]
      ADCA  [B,X]
      ADCA  [A,X]
      ADCA  [-103,X]
      ADCA  [<0,X]
      ADCA  [1,X]
      ADCA  [$019A,X]
      ADCA  [D,X]
      ADCA  [$01A0]
      ADCA  ,Y+
      ADCA  ,Y++
      ADCA  ,-Y
      ADCA  ,--Y
      ADCA  ,Y
      ADCA  B,Y
      ADCA  A,Y
      ADCA  -87,Y
      ADCA  <-16,Y
      ADCA  <0,Y
      ADCA  16,Y
      ADCA  $01AA,Y
      ORA   D,Y
      ORA   *-80,PCR
      ORA   *,PCR
      ORA   *+1,PCR
      ORA   *+$00B2,PCR
      ORA   [,Y++]
      ORA   [,--Y]
      ORA   [,Y]
      ORA   [B,Y]
      ORA   [A,Y]
      ORA   [-71,Y]
      ORA   [<0,Y]
      ORA   [1,Y]
      ORA   [$00BA,Y]
      ORA   [D,Y]
      ORA   [*-64,PCR]
      ORA   [*,PCR]
      ORA   [*+1,PCR]
      ORA   [*+$00C2,PCR]
      ORA   ,U+
      ORA   ,U++
      ORA   ,-U
      ORA   ,--U
      ORA   ,U
      ORA   B,U
      ORA   A,U
      ORA   -55,U
      ORA   <-16,U
      ORA   <0,U
      ORA   16,U
      ORA   $00CA,U
      ORA   D,U
      ORA   [,U++]
      ORA   [,--U]
      ORA   [,U]
      ORA   [B,U]
      ORA   [A,U]
      ORA   [-39,U]
      ORA   [<0,U]
      ORA   [1,U]
      ORA   [$00DA,U]
      ORA   [D,U]
      ORA   ,S+
      ORA   ,S++
      ORA   ,-S
      ORA   ,--S
      ORA   ,S
      ORA   B,S
      ORA   A,S
      ORA   -23,S
      ORA   <-16,S
      ORA   <0,S
      ORA   16,S
      ORA   $00EA,S
      ORA   D,S
      ORA   [,S++]
      ORA   [,--S]
      ORA   [,S]
      ORA   [B,S]
      ORA   [A,S]
      ORA   [-7,S]
      ORA   [<0,S]
      ORA   [1,S]
      ORA   [$00FA,S]
      ORA   [D,S]
      ORA   <<0,X
      ORA   1,X
      ORA   -16,X
      ORA   <<0,Y
      ORA   1,Y
      ORA   -16,Y
      ORA   <<0,U
      ORA   1,U
      ORA   -16,U
      ORA   <<0,S
      ORA   1,S
      ORA   -16,S
      ORA   ,X+
      ORA   ,X++
      ORA   ,-X
      ORA   ,--X
      ORA   ,X
      ORA   B,X
      ORA   A,X
      ORA   -119,X
      ORA   <-16,X
      ORA   <0,X
      ORA   16,X
      ORA   $018A,X
      ORA   D,X
      ORA   [,X++]
      ORA   [,--X]
      ORA   [,X]
      ORA   [B,X]
      ORA   [A,X]
      ORA   [-103,X]
      ORA   [<0,X]
      ORA   [1,X]
      ORA   [$019A,X]
      ORA   [D,X]
      ORA   [$01A0]
      ORA   ,Y+
      ORA   ,Y++
      ORA   ,-Y
      ORA   ,--Y
      ORA   ,Y
      ORA   B,Y
      ORA   A,Y
      ORA   -87,Y
      ORA   <-16,Y
      ORA   <0,Y
      ORA   16,Y
      ORA   $01AA,Y
      ADDA  *-80,PCR
      ADDA  *,PCR
      ADDA  *+1,PCR
      ADDA  *+$00B2,PCR
      ADDA  [,Y++]
      ADDA  [,--Y]
      ADDA  [,Y]
      ADDA  [B,Y]
      ADDA  [A,Y]
      ADDA  [-71,Y]
      ADDA  [<0,Y]
      ADDA  [1,Y]
      ADDA  [$00BA,Y]
      ADDA  [D,Y]
      ADDA  [*-64,PCR]
      ADDA  [*,PCR]
      ADDA  [*+1,PCR]
      ADDA  [*+$00C2,PCR]
      ADDA  ,U+
      ADDA  ,U++
      ADDA  ,-U
      ADDA  ,--U
      ADDA  ,U
      ADDA  B,U
      ADDA  A,U
      ADDA  -55,U
      ADDA  <-16,U
      ADDA  <0,U
      ADDA  16,U
      ADDA  $00CA,U
      ADDA  D,U
      ADDA  [,U++]
      ADDA  [,--U]
      ADDA  [,U]
      ADDA  [B,U]
      ADDA  [A,U]
      ADDA  [-39,U]
      ADDA  [<0,U]
      ADDA  [1,U]
      ADDA  [$00DA,U]
      ADDA  [D,U]
      ADDA  ,S+
      ADDA  ,S++
      ADDA  ,-S
      ADDA  ,--S
      ADDA  ,S
      ADDA  B,S
      ADDA  A,S
      ADDA  -23,S
      ADDA  <-16,S
      ADDA  <0,S
      ADDA  16,S
      ADDA  $00EA,S
      ADDA  D,S
      ADDA  [,S++]
      ADDA  [,--S]
      ADDA  [,S]
      ADDA  [B,S]
      ADDA  [A,S]
      ADDA  [-7,S]
      ADDA  [<0,S]
      ADDA  [1,S]
      ADDA  [$00FA,S]
      ADDA  [D,S]
      ADDA  <<0,X
      ADDA  1,X
      ADDA  -16,X
      ADDA  <<0,Y
      ADDA  1,Y
      ADDA  -16,Y
      ADDA  <<0,U
      ADDA  1,U
      ADDA  -16,U
      ADDA  <<0,S
      ADDA  1,S
      ADDA  -16,S
      ADDA  ,X+
      ADDA  ,X++
      ADDA  ,-X
      ADDA  ,--X
      ADDA  ,X
      ADDA  B,X
      ADDA  A,X
      ADDA  -119,X
      ADDA  <-16,X
      ADDA  <0,X
      ADDA  16,X
      ADDA  $018A,X
      ADDA  D,X
      ADDA  [,X++]
      ADDA  [,--X]
      ADDA  [,X]
      ADDA  [B,X]
      ADDA  [A,X]
      ADDA  [-103,X]
      ADDA  [<0,X]
      ADDA  [1,X]
      ADDA  [$019A,X]
      ADDA  [D,X]
      ADDA  [$01A0]
      ADDA  ,Y+
      ADDA  ,Y++
      ADDA  ,-Y
      ADDA  ,--Y
      ADDA  ,Y
      ADDA  B,Y
      ADDA  A,Y
      ADDA  -87,Y
      ADDA  <-16,Y
      ADDA  <0,Y
      ADDA  16,Y
      ADDA  $01AA,Y
      ADDA  D,Y
      CMPX  *+$00B2,PCR
      CMPX  [,Y++]
      CMPX  [,--Y]
      CMPX  [,Y]
      CMPX  [B,Y]
      CMPX  [A,Y]
      CMPX  [-71,Y]
      CMPX  [<0,Y]
      CMPX  [1,Y]
      CMPX  [$00BA,Y]
      CMPX  [D,Y]
      CMPX  [*-64,PCR]
      CMPX  [*,PCR]
      CMPX  [*+1,PCR]
      CMPX  [*+$00C2,PCR]
      CMPX  ,U+
      CMPX  ,U++
      CMPX  ,-U
      CMPX  ,--U
      CMPX  ,U
      CMPX  B,U
      CMPX  A,U
      CMPX  -55,U
      CMPX  <-16,U
      CMPX  <0,U
      CMPX  16,U
      CMPX  $00CA,U
      CMPX  D,U
      CMPX  *-48,PCR
      CMPX  *,PCR
      CMPX  *+1,PCR
      CMPX  [,U++]
      CMPX  [,--U]
      CMPX  [,U]
      CMPX  [B,U]
      CMPX  [A,U]
      CMPX  [-39,U]
      CMPX  [<0,U]
      CMPX  [1,U]
      CMPX  [$00DA,U]
      CMPX  [D,U]
      CMPX  ,S+
      CMPX  ,S++
      CMPX  ,-S
      CMPX  ,--S
      CMPX  ,S
      CMPX  B,S
      CMPX  A,S
      CMPX  -23,S
      CMPX  <-16,S
      CMPX  <0,S
      CMPX  16,S
      CMPX  $00EA,S
      CMPX  D,S
      CMPX  [,S++]
      CMPX  [,--S]
      CMPX  [,S]
      CMPX  [B,S]
      CMPX  [A,S]
      CMPX  [-7,S]
      CMPX  [<0,S]
      CMPX  [1,S]
      CMPX  [$00FA,S]
      CMPX  [D,S]
      CMPX  <<0,X
      CMPX  1,X
      CMPX  -16,X
      CMPX  <<0,Y
      CMPX  1,Y
      CMPX  -16,Y
      CMPX  <<0,U
      CMPX  1,U
      CMPX  -16,U
      CMPX  <<0,S
      CMPX  1,S
      CMPX  -16,S
      CMPX  ,X+
      CMPX  ,X++
      CMPX  ,-X
      CMPX  ,--X
      CMPX  ,X
      CMPX  B,X
      CMPX  A,X
      CMPX  -119,X
      CMPX  <-16,X
      CMPX  <0,X
      CMPX  16,X
      CMPX  $018A,X
      CMPX  D,X
      CMPX  [,X++]
      CMPX  [,--X]
      CMPX  [,X]
      CMPX  [B,X]
      CMPX  [A,X]
      CMPX  [-103,X]
      CMPX  [<0,X]
      CMPX  [1,X]
      CMPX  [$019A,X]
      CMPX  [D,X]
      CMPX  [$01A0]
      CMPX  ,Y+
      CMPX  ,Y++
      CMPX  ,-Y
      CMPX  ,--Y
      CMPX  ,Y
      CMPX  B,Y
      CMPX  A,Y
      CMPX  -87,Y
      CMPX  <-16,Y
      CMPX  <0,Y
      CMPX  16,Y
      CMPX  $01AA,Y
      CMPX  D,Y
      JSR   [,Y++]
      JSR   [,--Y]
      JSR   [,Y]
      JSR   [B,Y]
      JSR   [A,Y]
      JSR   [-71,Y]
      JSR   [<0,Y]
      JSR   [1,Y]
      JSR   [$00BA,Y]
      JSR   [D,Y]
      JSR   [*-64,PCR]
      JSR   [*,PCR]
      JSR   [*+1,PCR]
      JSR   [*+$00C2,PCR]
      JSR   ,U+
      JSR   ,U++
      JSR   ,-U
      JSR   ,--U
      JSR   ,U
      JSR   B,U
      JSR   A,U
      JSR   -55,U
      JSR   <-16,U
      JSR   <0,U
      JSR   16,U
      JSR   $00CA,U
      JSR   D,U
      JSR   *-48,PCR
      JSR   *,PCR
      JSR   *+1,PCR
      JSR   *+$00D2,PCR
      JSR   [,U++]
      JSR   [,--U]
      JSR   [,U]
      JSR   [B,U]
      JSR   [A,U]
      JSR   [-39,U]
      JSR   [<0,U]
      JSR   [1,U]
      JSR   [$00DA,U]
      JSR   [D,U]
      JSR   ,S+
      JSR   ,S++
      JSR   ,-S
      JSR   ,--S
      JSR   ,S
      JSR   B,S
      JSR   A,S
      JSR   -23,S
      JSR   <-16,S
      JSR   <0,S
      JSR   16,S
      JSR   $00EA,S
      JSR   D,S
      JSR   [,S++]
      JSR   [,--S]
      JSR   [,S]
      JSR   [B,S]
      JSR   [A,S]
      JSR   [-7,S]
      JSR   [<0,S]
      JSR   [1,S]
      JSR   [$00FA,S]
      JSR   [D,S]
      JSR   <<0,X
      JSR   1,X
      JSR   -16,X
      JSR   <<0,Y
      JSR   1,Y
      JSR   -16,Y
      JSR   <<0,U
      JSR   1,U
      JSR   -16,U
      JSR   <<0,S
      JSR   1,S
      JSR   -16,S
      JSR   ,X+
      JSR   ,X++
      JSR   ,-X
      JSR   ,--X
      JSR   ,X
      JSR   B,X
      JSR   A,X
      JSR   -119,X
      JSR   <-16,X
      JSR   <0,X
      JSR   16,X
      JSR   $018A,X
      JSR   D,X
      JSR   [,X++]
      JSR   [,--X]
      JSR   [,X]
      JSR   [B,X]
      JSR   [A,X]
      JSR   [-103,X]
      JSR   [<0,X]
      JSR   [1,X]
      JSR   [$019A,X]
      JSR   [D,X]
      JSR   [$01A0]
      JSR   ,Y+
      JSR   ,Y++
      JSR   ,-Y
      JSR   ,--Y
      JSR   ,Y
      JSR   B,Y
      JSR   A,Y
      JSR   -87,Y
      JSR   <-16,Y
      JSR   <0,Y
      JSR   16,Y
      JSR   $01AA,Y
      JSR   D,Y
      LDX   [,Y++]
      LDX   [,--Y]
      LDX   [,Y]
      LDX   [B,Y]
      LDX   [A,Y]
      LDX   [-71,Y]
      LDX   [<0,Y]
      LDX   [1,Y]
      LDX   [$00BA,Y]
      LDX   [D,Y]
      LDX   [*-64,PCR]
      LDX   [*,PCR]
      LDX   [*+1,PCR]
      LDX   [*+$00C2,PCR]
      LDX   ,U+
      LDX   ,U++
      LDX   ,-U
      LDX   ,--U
      LDX   ,U
      LDX   B,U
      LDX   A,U
      LDX   -55,U
      LDX   <-16,U
      LDX   <0,U
      LDX   16,U
      LDX   $00CA,U
      LDX   D,U
      LDX   *-48,PCR
      LDX   *,PCR
      LDX   *+1,PCR
      LDX   *+$00D2,PCR
      LDX   [,U++]
      LDX   [,--U]
      LDX   [,U]
      LDX   [B,U]
      LDX   [A,U]
      LDX   [-39,U]
      LDX   [<0,U]
      LDX   [1,U]
      LDX   [$00DA,U]
      LDX   [D,U]
      LDX   ,S+
      LDX   ,S++
      LDX   ,-S
      LDX   ,--S
      LDX   ,S
      LDX   B,S
      LDX   A,S
      LDX   -23,S
      LDX   <-16,S
      LDX   <0,S
      LDX   16,S
      LDX   $00EA,S
      LDX   D,S
      LDX   [,S++]
      LDX   [,--S]
      LDX   [,S]
      LDX   [B,S]
      LDX   [A,S]
      LDX   [-7,S]
      LDX   [<0,S]
      LDX   [1,S]
      LDX   [$00FA,S]
      LDX   [D,S]
      LDX   <<0,X
      LDX   1,X
      LDX   -16,X
      LDX   <<0,Y
      LDX   1,Y
      LDX   -16,Y
      LDX   <<0,U
      LDX   1,U
      LDX   -16,U
      LDX   <<0,S
      LDX   1,S
      LDX   -16,S
      LDX   ,X+
      LDX   ,X++
      LDX   ,-X
      LDX   ,--X
      LDX   ,X
      LDX   B,X
      LDX   A,X
      LDX   -119,X
      LDX   <-16,X
      LDX   <0,X
      LDX   16,X
      LDX   $018A,X
      LDX   D,X
      LDX   [,X++]
      LDX   [,--X]
      LDX   [,X]
      LDX   [B,X]
      LDX   [A,X]
      LDX   [-103,X]
      LDX   [<0,X]
      LDX   [1,X]
      LDX   [$019A,X]
      LDX   [D,X]
      LDX   [$01A0]
      LDX   ,Y+
      LDX   ,Y++
      LDX   ,-Y
      LDX   ,--Y
      LDX   ,Y
      LDX   B,Y
      LDX   A,Y
      LDX   -87,Y
      LDX   <-16,Y
      LDX   <0,Y
      LDX   16,Y
      LDX   $01AA,Y
      LDX   D,Y
      STX   [,Y++]
      STX   [,--Y]
      STX   [,Y]
      STX   [B,Y]
      STX   [A,Y]
      STX   [-71,Y]
      STX   [<0,Y]
      STX   [1,Y]
      STX   [$00BA,Y]
      STX   [D,Y]
      STX   [*-64,PCR]
      STX   [*,PCR]
      STX   [*+1,PCR]
      STX   [*+$00C2,PCR]
      STX   ,U+
      STX   ,U++
      STX   ,-U
      STX   ,--U
      STX   ,U
      STX   B,U
      STX   A,U
      STX   -55,U
      STX   <-16,U
      STX   <0,U
      STX   16,U
      STX   $00CA,U
      STX   D,U
      STX   *-48,PCR
      STX   *,PCR
      STX   *+1,PCR
      STX   *+$00D2,PCR
      STX   [,U++]
      STX   [,--U]
      STX   [,U]
      STX   [B,U]
      STX   [A,U]
      STX   [-39,U]
      STX   [<0,U]
      STX   [1,U]
      STX   [$00DA,U]
      STX   [D,U]
      STX   ,S+
      STX   ,S++
      STX   ,-S
      STX   ,--S
      STX   ,S
      STX   B,S
      STX   A,S
      STX   -23,S
      STX   <-16,S
      STX   <0,S
      STX   16,S
      STX   $00EA,S
      STX   D,S
      STX   [,S++]
      STX   [,--S]
      STX   [,S]
      STX   [B,S]
      STX   [A,S]
      STX   [-7,S]
      STX   [<0,S]
      STX   [1,S]
      STX   [$00FA,S]
      STX   [D,S]
      STX   <<0,X
      STX   1,X
      STX   -16,X
      STX   <<0,Y
      STX   1,Y
      STX   -16,Y
      STX   <<0,U
      STX   1,U
      STX   -16,U
      STX   <<0,S
      STX   1,S
      STX   -16,S
      STX   ,X+
      STX   ,X++
      STX   ,-X
      STX   ,--X
      STX   ,X
      STX   B,X
      STX   A,X
      STX   -119,X
      STX   <-16,X
      STX   <0,X
      STX   16,X
      STX   $018A,X
      STX   D,X
      STX   [,X++]
      STX   [,--X]
      STX   [,X]
      STX   [B,X]
      STX   [A,X]
      STX   [-103,X]
      STX   [<0,X]
      STX   [1,X]
      STX   [$019A,X]
      STX   [D,X]
      STX   [$01A0]
      STX   ,Y+
      STX   ,Y++
      STX   ,-Y
      STX   ,--Y
      STX   ,Y
      STX   B,Y
      STX   A,Y
      STX   -87,Y
      STX   <-16,Y
      STX   <0,Y
      STX   16,Y
      STX   $01AA,Y
      STX   D,Y
      SUBA  >$00B1
      SUBA  $0100
      CMPA  >$00B2
      CMPA  $0100
      SBCA  >$00B3
      SBCA  $0100
      SUBD  >$00B4
      SUBD  $0100
      ANDA  >$00B5
      ANDA  $0100
      BITA  >$00B6
      BITA  $0100
      LDA   >$00B7
      LDA   $0100
      STA   >$00B8
      STA   $0100
      EORA  >$00B9
      EORA  $0100
      ADCA  >$00BA
      ADCA  $0100
      ORA   >$00BB
      ORA   $0100
      ADDA  >$00BC
      ADDA  $0100
      CMPX  >$00BD
      CMPX  $0100
      JSR   >$00BE
      JSR   $0100
      LDX   >$00BF
      LDX   $0100
      STX   >$00C0
      STX   $0100
      SUBB  #$C1
      CMPB  #$C2
      SBCB  #$C3
      ADDD  #$00C4
      ANDB  #$C5
      BITB  #$C6
      LDB   #$C7
      EORB  #$C9
      ADCB  #$CA
      ORB   #$CB
      ADDB  #$CC
      LDD   #$00CD
      LDU   #$00CF
      SUBB  $D1
      CMPB  $D2
      SBCB  $D3
      ADDD  $D4
      ANDB  $D5
      BITB  $D6
      LDB   $D7
      STB   $D8
      EORB  $D9
      ADCB  $DA
      ORB   $DB
      ADDB  $DC
      LDD   $DD
      STD   $DE
      LDU   $DF
      STU   $E0
      SUBB  ,S++
      SUBB  ,-S
      SUBB  ,--S
      SUBB  ,S
      SUBB  B,S
      SUBB  A,S
      SUBB  -23,S
      SUBB  <-16,S
      SUBB  <0,S
      SUBB  16,S
      SUBB  $00EA,S
      SUBB  D,S
      SUBB  *-16,PCR
      SUBB  *,PCR
      SUBB  *+1,PCR
      SUBB  *+$00F2,PCR
      SUBB  [,S++]
      SUBB  [,--S]
      SUBB  [,S]
      SUBB  [B,S]
      SUBB  [A,S]
      SUBB  [-7,S]
      SUBB  [<0,S]
      SUBB  [1,S]
      SUBB  [$00FA,S]
      SUBB  [D,S]
      SUBB  [*,PCR]
      SUBB  [*+1,PCR]
      SUBB  [*-125,PCR]
      SUBB  [*+$0102,PCR]
      SUBB  <<0,X
      SUBB  1,X
      SUBB  -16,X
      SUBB  <<0,Y
      SUBB  1,Y
      SUBB  -16,Y
      SUBB  <<0,U
      SUBB  1,U
      SUBB  -16,U
      SUBB  <<0,S
      SUBB  1,S
      SUBB  -16,S
      SUBB  ,X+
      SUBB  ,X++
      SUBB  ,-X
      SUBB  ,--X
      SUBB  ,X
      SUBB  B,X
      SUBB  A,X
      SUBB  -119,X
      SUBB  <-16,X
      SUBB  <0,X
      SUBB  16,X
      SUBB  $018A,X
      SUBB  D,X
      SUBB  [,X++]
      SUBB  [,--X]
      SUBB  [,X]
      SUBB  [B,X]
      SUBB  [A,X]
      SUBB  [-103,X]
      SUBB  [<0,X]
      SUBB  [1,X]
      SUBB  [$019A,X]
      SUBB  [D,X]
      SUBB  [$01A0]
      SUBB  ,Y+
      SUBB  ,Y++
      SUBB  ,-Y
      SUBB  ,--Y
      SUBB  ,Y
      SUBB  B,Y
      SUBB  A,Y
      SUBB  -87,Y
      SUBB  <-16,Y
      SUBB  <0,Y
      SUBB  16,Y
      SUBB  $01AA,Y
      SUBB  D,Y
      SUBB  [,Y++]
      SUBB  [,--Y]
      SUBB  [,Y]
      SUBB  [B,Y]
      SUBB  [A,Y]
      SUBB  [-71,Y]
      SUBB  [<0,Y]
      SUBB  [1,Y]
      SUBB  [$01BA,Y]
      SUBB  [D,Y]
      SUBB  ,U+
      SUBB  ,U++
      SUBB  ,-U
      SUBB  ,--U
      SUBB  ,U
      SUBB  B,U
      SUBB  A,U
      SUBB  -55,U
      SUBB  <-16,U
      SUBB  <0,U
      SUBB  16,U
      SUBB  $01CA,U
      SUBB  D,U
      SUBB  [,U++]
      SUBB  [,--U]
      SUBB  [,U]
      SUBB  [B,U]
      SUBB  [A,U]
      SUBB  [-39,U]
      SUBB  [<0,U]
      SUBB  [1,U]
      SUBB  [$01DA,U]
      SUBB  [D,U]
      SUBB  ,S+
      CMPB  ,-S
      CMPB  ,--S
      CMPB  ,S
      CMPB  B,S
      CMPB  A,S
      CMPB  -23,S
      CMPB  <-16,S
      CMPB  <0,S
      CMPB  16,S
      CMPB  $00EA,S
      CMPB  D,S
      CMPB  *-16,PCR
      CMPB  *,PCR
      CMPB  *+1,PCR
      CMPB  *+$00F2,PCR
      CMPB  [,S++]
      CMPB  [,--S]
      CMPB  [,S]
      CMPB  [B,S]
      CMPB  [A,S]
      CMPB  [-7,S]
      CMPB  [<0,S]
      CMPB  [1,S]
      CMPB  [$00FA,S]
      CMPB  [D,S]
      CMPB  [*,PCR]
      CMPB  [*+1,PCR]
      CMPB  [*-125,PCR]
      CMPB  [*+$0102,PCR]
      CMPB  <<0,X
      CMPB  1,X
      CMPB  -16,X
      CMPB  <<0,Y
      CMPB  1,Y
      CMPB  -16,Y
      CMPB  <<0,U
      CMPB  1,U
      CMPB  -16,U
      CMPB  <<0,S
      CMPB  1,S
      CMPB  -16,S
      CMPB  ,X+
      CMPB  ,X++
      CMPB  ,-X
      CMPB  ,--X
      CMPB  ,X
      CMPB  B,X
      CMPB  A,X
      CMPB  -119,X
      CMPB  <-16,X
      CMPB  <0,X
      CMPB  16,X
      CMPB  $018A,X
      CMPB  D,X
      CMPB  [,X++]
      CMPB  [,--X]
      CMPB  [,X]
      CMPB  [B,X]
      CMPB  [A,X]
      CMPB  [-103,X]
      CMPB  [<0,X]
      CMPB  [1,X]
      CMPB  [$019A,X]
      CMPB  [D,X]
      CMPB  [$01A0]
      CMPB  ,Y+
      CMPB  ,Y++
      CMPB  ,-Y
      CMPB  ,--Y
      CMPB  ,Y
      CMPB  B,Y
      CMPB  A,Y
      CMPB  -87,Y
      CMPB  <-16,Y
      CMPB  <0,Y
      CMPB  16,Y
      CMPB  $01AA,Y
      CMPB  D,Y
      CMPB  [,Y++]
      CMPB  [,--Y]
      CMPB  [,Y]
      CMPB  [B,Y]
      CMPB  [A,Y]
      CMPB  [-71,Y]
      CMPB  [<0,Y]
      CMPB  [1,Y]
      CMPB  [$01BA,Y]
      CMPB  [D,Y]
      CMPB  ,U+
      CMPB  ,U++
      CMPB  ,-U
      CMPB  ,--U
      CMPB  ,U
      CMPB  B,U
      CMPB  A,U
      CMPB  -55,U
      CMPB  <-16,U
      CMPB  <0,U
      CMPB  16,U
      CMPB  $01CA,U
      CMPB  D,U
      CMPB  [,U++]
      CMPB  [,--U]
      CMPB  [,U]
      CMPB  [B,U]
      CMPB  [A,U]
      CMPB  [-39,U]
      CMPB  [<0,U]
      CMPB  [1,U]
      CMPB  [$01DA,U]
      CMPB  [D,U]
      CMPB  ,S+
      CMPB  ,S++
      SBCB  ,--S
      SBCB  ,S
      SBCB  B,S
      SBCB  A,S
      SBCB  -23,S
      SBCB  <-16,S
      SBCB  <0,S
      SBCB  16,S
      SBCB  $00EA,S
      SBCB  D,S
      SBCB  *-16,PCR
      SBCB  *,PCR
      SBCB  *+1,PCR
      SBCB  *+$00F2,PCR
      SBCB  [,S++]
      SBCB  [,--S]
      SBCB  [,S]
      SBCB  [B,S]
      SBCB  [A,S]
      SBCB  [-7,S]
      SBCB  [<0,S]
      SBCB  [1,S]
      SBCB  [$00FA,S]
      SBCB  [D,S]
      SBCB  [*,PCR]
      SBCB  [*+1,PCR]
      SBCB  [*-125,PCR]
      SBCB  [*+$0102,PCR]
      SBCB  <<0,X
      SBCB  1,X
      SBCB  -16,X
      SBCB  <<0,Y
      SBCB  1,Y
      SBCB  -16,Y
      SBCB  <<0,U
      SBCB  1,U
      SBCB  -16,U
      SBCB  <<0,S
      SBCB  1,S
      SBCB  -16,S
      SBCB  ,X+
      SBCB  ,X++
      SBCB  ,-X
      SBCB  ,--X
      SBCB  ,X
      SBCB  B,X
      SBCB  A,X
      SBCB  -119,X
      SBCB  <-16,X
      SBCB  <0,X
      SBCB  16,X
      SBCB  $018A,X
      SBCB  D,X
      SBCB  [,X++]
      SBCB  [,--X]
      SBCB  [,X]
      SBCB  [B,X]
      SBCB  [A,X]
      SBCB  [-103,X]
      SBCB  [<0,X]
      SBCB  [1,X]
      SBCB  [$019A,X]
      SBCB  [D,X]
      SBCB  [$01A0]
      SBCB  ,Y+
      SBCB  ,Y++
      SBCB  ,-Y
      SBCB  ,--Y
      SBCB  ,Y
      SBCB  B,Y
      SBCB  A,Y
      SBCB  -87,Y
      SBCB  <-16,Y
      SBCB  <0,Y
      SBCB  16,Y
      SBCB  $01AA,Y
      SBCB  D,Y
      SBCB  [,Y++]
      SBCB  [,--Y]
      SBCB  [,Y]
      SBCB  [B,Y]
      SBCB  [A,Y]
      SBCB  [-71,Y]
      SBCB  [<0,Y]
      SBCB  [1,Y]
      SBCB  [$01BA,Y]
      SBCB  [D,Y]
      SBCB  ,U+
      SBCB  ,U++
      SBCB  ,-U
      SBCB  ,--U
      SBCB  ,U
      SBCB  B,U
      SBCB  A,U
      SBCB  -55,U
      SBCB  <-16,U
      SBCB  <0,U
      SBCB  16,U
      SBCB  $01CA,U
      SBCB  D,U
      SBCB  [,U++]
      SBCB  [,--U]
      SBCB  [,U]
      SBCB  [B,U]
      SBCB  [A,U]
      SBCB  [-39,U]
      SBCB  [<0,U]
      SBCB  [1,U]
      SBCB  [$01DA,U]
      SBCB  [D,U]
      SBCB  ,S+
      SBCB  ,S++
      SBCB  ,-S
      ADDD  ,S
      ADDD  B,S
      ADDD  A,S
      ADDD  -23,S
      ADDD  <-16,S
      ADDD  <0,S
      ADDD  16,S
      ADDD  $00EA,S
      ADDD  D,S
      ADDD  *-16,PCR
      ADDD  *,PCR
      ADDD  *+1,PCR
      ADDD  *+$00F2,PCR
      ADDD  [,S++]
      ADDD  [,--S]
      ADDD  [,S]
      ADDD  [B,S]
      ADDD  [A,S]
      ADDD  [-7,S]
      ADDD  [<0,S]
      ADDD  [1,S]
      ADDD  [$00FA,S]
      ADDD  [D,S]
      ADDD  [*,PCR]
      ADDD  [*+1,PCR]
      ADDD  [*-125,PCR]
      ADDD  [*+$0102,PCR]
      ADDD  <<0,X
      ADDD  1,X
      ADDD  -16,X
      ADDD  <<0,Y
      ADDD  1,Y
      ADDD  -16,Y
      ADDD  <<0,U
      ADDD  1,U
      ADDD  -16,U
      ADDD  <<0,S
      ADDD  1,S
      ADDD  -16,S
      ADDD  ,X+
      ADDD  ,X++
      ADDD  ,-X
      ADDD  ,--X
      ADDD  ,X
      ADDD  B,X
      ADDD  A,X
      ADDD  -119,X
      ADDD  <-16,X
      ADDD  <0,X
      ADDD  16,X
      ADDD  $018A,X
      ADDD  D,X
      ADDD  [,X++]
      ADDD  [,--X]
      ADDD  [,X]
      ADDD  [B,X]
      ADDD  [A,X]
      ADDD  [-103,X]
      ADDD  [<0,X]
      ADDD  [1,X]
      ADDD  [$019A,X]
      ADDD  [D,X]
      ADDD  [$01A0]
      ADDD  ,Y+
      ADDD  ,Y++
      ADDD  ,-Y
      ADDD  ,--Y
      ADDD  ,Y
      ADDD  B,Y
      ADDD  A,Y
      ADDD  -87,Y
      ADDD  <-16,Y
      ADDD  <0,Y
      ADDD  16,Y
      ADDD  $01AA,Y
      ADDD  D,Y
      ADDD  [,Y++]
      ADDD  [,--Y]
      ADDD  [,Y]
      ADDD  [B,Y]
      ADDD  [A,Y]
      ADDD  [-71,Y]
      ADDD  [<0,Y]
      ADDD  [1,Y]
      ADDD  [$01BA,Y]
      ADDD  [D,Y]
      ADDD  ,U+
      ADDD  ,U++
      ADDD  ,-U
      ADDD  ,--U
      ADDD  ,U
      ADDD  B,U
      ADDD  A,U
      ADDD  -55,U
      ADDD  <-16,U
      ADDD  <0,U
      ADDD  16,U
      ADDD  $01CA,U
      ADDD  D,U
      ADDD  [,U++]
      ADDD  [,--U]
      ADDD  [,U]
      ADDD  [B,U]
      ADDD  [A,U]
      ADDD  [-39,U]
      ADDD  [<0,U]
      ADDD  [1,U]
      ADDD  [$01DA,U]
      ADDD  [D,U]
      ADDD  ,S+
      ADDD  ,S++
      ADDD  ,-S
      ADDD  ,--S
      ANDB  B,S
      ANDB  A,S
      ANDB  -23,S
      ANDB  <-16,S
      ANDB  <0,S
      ANDB  16,S
      ANDB  $00EA,S
      ANDB  D,S
      ANDB  *-16,PCR
      ANDB  *,PCR
      ANDB  *+1,PCR
      ANDB  *+$00F2,PCR
      ANDB  [,S++]
      ANDB  [,--S]
      ANDB  [,S]
      ANDB  [B,S]
      ANDB  [A,S]
      ANDB  [-7,S]
      ANDB  [<0,S]
      ANDB  [1,S]
      ANDB  [$00FA,S]
      ANDB  [D,S]
      ANDB  [*,PCR]
      ANDB  [*+1,PCR]
      ANDB  [*-125,PCR]
      ANDB  [*+$0102,PCR]
      ANDB  <<0,X
      ANDB  1,X
      ANDB  -16,X
      ANDB  <<0,Y
      ANDB  1,Y
      ANDB  -16,Y
      ANDB  <<0,U
      ANDB  1,U
      ANDB  -16,U
      ANDB  <<0,S
      ANDB  1,S
      ANDB  -16,S
      ANDB  ,X+
      ANDB  ,X++
      ANDB  ,-X
      ANDB  ,--X
      ANDB  ,X
      ANDB  B,X
      ANDB  A,X
      ANDB  -119,X
      ANDB  <-16,X
      ANDB  <0,X
      ANDB  16,X
      ANDB  $018A,X
      ANDB  D,X
      ANDB  [,X++]
      ANDB  [,--X]
      ANDB  [,X]
      ANDB  [B,X]
      ANDB  [A,X]
      ANDB  [-103,X]
      ANDB  [<0,X]
      ANDB  [1,X]
      ANDB  [$019A,X]
      ANDB  [D,X]
      ANDB  [$01A0]
      ANDB  ,Y+
      ANDB  ,Y++
      ANDB  ,-Y
      ANDB  ,--Y
      ANDB  ,Y
      ANDB  B,Y
      ANDB  A,Y
      ANDB  -87,Y
      ANDB  <-16,Y
      ANDB  <0,Y
      ANDB  16,Y
      ANDB  $01AA,Y
      ANDB  D,Y
      ANDB  [,Y++]
      ANDB  [,--Y]
      ANDB  [,Y]
      ANDB  [B,Y]
      ANDB  [A,Y]
      ANDB  [-71,Y]
      ANDB  [<0,Y]
      ANDB  [1,Y]
      ANDB  [$01BA,Y]
      ANDB  [D,Y]
      ANDB  ,U+
      ANDB  ,U++
      ANDB  ,-U
      ANDB  ,--U
      ANDB  ,U
      ANDB  B,U
      ANDB  A,U
      ANDB  -55,U
      ANDB  <-16,U
      ANDB  <0,U
      ANDB  16,U
      ANDB  $01CA,U
      ANDB  D,U
      ANDB  [,U++]
      ANDB  [,--U]
      ANDB  [,U]
      ANDB  [B,U]
      ANDB  [A,U]
      ANDB  [-39,U]
      ANDB  [<0,U]
      ANDB  [1,U]
      ANDB  [$01DA,U]
      ANDB  [D,U]
      ANDB  ,S+
      ANDB  ,S++
      ANDB  ,-S
      ANDB  ,--S
      ANDB  ,S
      BITB  A,S
      BITB  -23,S
      BITB  <-16,S
      BITB  <0,S
      BITB  16,S
      BITB  $00EA,S
      BITB  D,S
      BITB  *-16,PCR
      BITB  *,PCR
      BITB  *+1,PCR
      BITB  *+$00F2,PCR
      BITB  [,S++]
      BITB  [,--S]
      BITB  [,S]
      BITB  [B,S]
      BITB  [A,S]
      BITB  [-7,S]
      BITB  [<0,S]
      BITB  [1,S]
      BITB  [$00FA,S]
      BITB  [D,S]
      BITB  [*,PCR]
      BITB  [*+1,PCR]
      BITB  [*-125,PCR]
      BITB  [*+$0102,PCR]
      BITB  <<0,X
      BITB  1,X
      BITB  -16,X
      BITB  <<0,Y
      BITB  1,Y
      BITB  -16,Y
      BITB  <<0,U
      BITB  1,U
      BITB  -16,U
      BITB  <<0,S
      BITB  1,S
      BITB  -16,S
      BITB  ,X+
      BITB  ,X++
      BITB  ,-X
      BITB  ,--X
      BITB  ,X
      BITB  B,X
      BITB  A,X
      BITB  -119,X
      BITB  <-16,X
      BITB  <0,X
      BITB  16,X
      BITB  $018A,X
      BITB  D,X
      BITB  [,X++]
      BITB  [,--X]
      BITB  [,X]
      BITB  [B,X]
      BITB  [A,X]
      BITB  [-103,X]
      BITB  [<0,X]
      BITB  [1,X]
      BITB  [$019A,X]
      BITB  [D,X]
      BITB  [$01A0]
      BITB  ,Y+
      BITB  ,Y++
      BITB  ,-Y
      BITB  ,--Y
      BITB  ,Y
      BITB  B,Y
      BITB  A,Y
      BITB  -87,Y
      BITB  <-16,Y
      BITB  <0,Y
      BITB  16,Y
      BITB  $01AA,Y
      BITB  D,Y
      BITB  [,Y++]
      BITB  [,--Y]
      BITB  [,Y]
      BITB  [B,Y]
      BITB  [A,Y]
      BITB  [-71,Y]
      BITB  [<0,Y]
      BITB  [1,Y]
      BITB  [$01BA,Y]
      BITB  [D,Y]
      BITB  ,U+
      BITB  ,U++
      BITB  ,-U
      BITB  ,--U
      BITB  ,U
      BITB  B,U
      BITB  A,U
      BITB  -55,U
      BITB  <-16,U
      BITB  <0,U
      BITB  16,U
      BITB  $01CA,U
      BITB  D,U
      BITB  [,U++]
      BITB  [,--U]
      BITB  [,U]
      BITB  [B,U]
      BITB  [A,U]
      BITB  [-39,U]
      BITB  [<0,U]
      BITB  [1,U]
      BITB  [$01DA,U]
      BITB  [D,U]
      BITB  ,S+
      BITB  ,S++
      BITB  ,-S
      BITB  ,--S
      BITB  ,S
      BITB  B,S
      LDB   -23,S
      LDB   <-16,S
      LDB   <0,S
      LDB   16,S
      LDB   $00EA,S
      LDB   D,S
      LDB   *-16,PCR
      LDB   *,PCR
      LDB   *+1,PCR
      LDB   *+$00F2,PCR
      LDB   [,S++]
      LDB   [,--S]
      LDB   [,S]
      LDB   [B,S]
      LDB   [A,S]
      LDB   [-7,S]
      LDB   [<0,S]
      LDB   [1,S]
      LDB   [$00FA,S]
      LDB   [D,S]
      LDB   [*,PCR]
      LDB   [*+1,PCR]
      LDB   [*-125,PCR]
      LDB   [*+$0102,PCR]
      LDB   <<0,X
      LDB   1,X
      LDB   -16,X
      LDB   <<0,Y
      LDB   1,Y
      LDB   -16,Y
      LDB   <<0,U
      LDB   1,U
      LDB   -16,U
      LDB   <<0,S
      LDB   1,S
      LDB   -16,S
      LDB   ,X+
      LDB   ,X++
      LDB   ,-X
      LDB   ,--X
      LDB   ,X
      LDB   B,X
      LDB   A,X
      LDB   -119,X
      LDB   <-16,X
      LDB   <0,X
      LDB   16,X
      LDB   $018A,X
      LDB   D,X
      LDB   [,X++]
      LDB   [,--X]
      LDB   [,X]
      LDB   [B,X]
      LDB   [A,X]
      LDB   [-103,X]
      LDB   [<0,X]
      LDB   [1,X]
      LDB   [$019A,X]
      LDB   [D,X]
      LDB   [$01A0]
      LDB   ,Y+
      LDB   ,Y++
      LDB   ,-Y
      LDB   ,--Y
      LDB   ,Y
      LDB   B,Y
      LDB   A,Y
      LDB   -87,Y
      LDB   <-16,Y
      LDB   <0,Y
      LDB   16,Y
      LDB   $01AA,Y
      LDB   D,Y
      LDB   [,Y++]
      LDB   [,--Y]
      LDB   [,Y]
      LDB   [B,Y]
      LDB   [A,Y]
      LDB   [-71,Y]
      LDB   [<0,Y]
      LDB   [1,Y]
      LDB   [$01BA,Y]
      LDB   [D,Y]
      LDB   ,U+
      LDB   ,U++
      LDB   ,-U
      LDB   ,--U
      LDB   ,U
      LDB   B,U
      LDB   A,U
      LDB   -55,U
      LDB   <-16,U
      LDB   <0,U
      LDB   16,U
      LDB   $01CA,U
      LDB   D,U
      LDB   [,U++]
      LDB   [,--U]
      LDB   [,U]
      LDB   [B,U]
      LDB   [A,U]
      LDB   [-39,U]
      LDB   [<0,U]
      LDB   [1,U]
      LDB   [$01DA,U]
      LDB   [D,U]
      LDB   ,S+
      LDB   ,S++
      LDB   ,-S
      LDB   ,--S
      LDB   ,S
      LDB   B,S
      LDB   A,S
      STB   -23,S
      STB   <-16,S
      STB   <0,S
      STB   16,S
      STB   $00EA,S
      STB   D,S
      STB   *-16,PCR
      STB   *,PCR
      STB   *+1,PCR
      STB   *+$00F2,PCR
      STB   [,S++]
      STB   [,--S]
      STB   [,S]
      STB   [B,S]
      STB   [A,S]
      STB   [-7,S]
      STB   [<0,S]
      STB   [1,S]
      STB   [$00FA,S]
      STB   [D,S]
      STB   [*,PCR]
      STB   [*+1,PCR]
      STB   [*-125,PCR]
      STB   [*+$0102,PCR]
      STB   <<0,X
      STB   1,X
      STB   -16,X
      STB   <<0,Y
      STB   1,Y
      STB   -16,Y
      STB   <<0,U
      STB   1,U
      STB   -16,U
      STB   <<0,S
      STB   1,S
      STB   -16,S
      STB   ,X+
      STB   ,X++
      STB   ,-X
      STB   ,--X
      STB   ,X
      STB   B,X
      STB   A,X
      STB   -119,X
      STB   <-16,X
      STB   <0,X
      STB   16,X
      STB   $018A,X
      STB   D,X
      STB   [,X++]
      STB   [,--X]
      STB   [,X]
      STB   [B,X]
      STB   [A,X]
      STB   [-103,X]
      STB   [<0,X]
      STB   [1,X]
      STB   [$019A,X]
      STB   [D,X]
      STB   [$01A0]
      STB   ,Y+
      STB   ,Y++
      STB   ,-Y
      STB   ,--Y
      STB   ,Y
      STB   B,Y
      STB   A,Y
      STB   -87,Y
      STB   <-16,Y
      STB   <0,Y
      STB   16,Y
      STB   $01AA,Y
      STB   D,Y
      STB   [,Y++]
      STB   [,--Y]
      STB   [,Y]
      STB   [B,Y]
      STB   [A,Y]
      STB   [-71,Y]
      STB   [<0,Y]
      STB   [1,Y]
      STB   [$01BA,Y]
      STB   [D,Y]
      STB   ,U+
      STB   ,U++
      STB   ,-U
      STB   ,--U
      STB   ,U
      STB   B,U
      STB   A,U
      STB   -55,U
      STB   <-16,U
      STB   <0,U
      STB   16,U
      STB   $01CA,U
      STB   D,U
      STB   [,U++]
      STB   [,--U]
      STB   [,U]
      STB   [B,U]
      STB   [A,U]
      STB   [-39,U]
      STB   [<0,U]
      STB   [1,U]
      STB   [$01DA,U]
      STB   [D,U]
      STB   ,S+
      STB   ,S++
      STB   ,-S
      STB   ,--S
      STB   ,S
      STB   B,S
      STB   A,S
      EORB  $00EA,S
      EORB  D,S
      EORB  *-16,PCR
      EORB  *,PCR
      EORB  *+1,PCR
      EORB  *+$00F2,PCR
      EORB  [,S++]
      EORB  [,--S]
      EORB  [,S]
      EORB  [B,S]
      EORB  [A,S]
      EORB  [-7,S]
      EORB  [<0,S]
      EORB  [1,S]
      EORB  [$00FA,S]
      EORB  [D,S]
      EORB  [*,PCR]
      EORB  [*+1,PCR]
      EORB  [*-125,PCR]
      EORB  [*+$0102,PCR]
      EORB  <<0,X
      EORB  1,X
      EORB  -16,X
      EORB  <<0,Y
      EORB  1,Y
      EORB  -16,Y
      EORB  <<0,U
      EORB  1,U
      EORB  -16,U
      EORB  <<0,S
      EORB  1,S
      EORB  -16,S
      EORB  ,X+
      EORB  ,X++
      EORB  ,-X
      EORB  ,--X
      EORB  ,X
      EORB  B,X
      EORB  A,X
      EORB  -119,X
      EORB  <-16,X
      EORB  <0,X
      EORB  16,X
      EORB  $018A,X
      EORB  D,X
      EORB  [,X++]
      EORB  [,--X]
      EORB  [,X]
      EORB  [B,X]
      EORB  [A,X]
      EORB  [-103,X]
      EORB  [<0,X]
      EORB  [1,X]
      EORB  [$019A,X]
      EORB  [D,X]
      EORB  [$01A0]
      EORB  ,Y+
      EORB  ,Y++
      EORB  ,-Y
      EORB  ,--Y
      EORB  ,Y
      EORB  B,Y
      EORB  A,Y
      EORB  -87,Y
      EORB  <-16,Y
      EORB  <0,Y
      EORB  16,Y
      EORB  $01AA,Y
      EORB  D,Y
      EORB  [,Y++]
      EORB  [,--Y]
      EORB  [,Y]
      EORB  [B,Y]
      EORB  [A,Y]
      EORB  [-71,Y]
      EORB  [<0,Y]
      EORB  [1,Y]
      EORB  [$01BA,Y]
      EORB  [D,Y]
      EORB  ,U+
      EORB  ,U++
      EORB  ,-U
      EORB  ,--U
      EORB  ,U
      EORB  B,U
      EORB  A,U
      EORB  -55,U
      EORB  <-16,U
      EORB  <0,U
      EORB  16,U
      EORB  $01CA,U
      EORB  D,U
      EORB  [,U++]
      EORB  [,--U]
      EORB  [,U]
      EORB  [B,U]
      EORB  [A,U]
      EORB  [-39,U]
      EORB  [<0,U]
      EORB  [1,U]
      EORB  [$01DA,U]
      EORB  [D,U]
      EORB  ,S+
      EORB  ,S++
      EORB  ,-S
      EORB  ,--S
      EORB  ,S
      EORB  B,S
      EORB  A,S
      EORB  -23,S
      EORB  <-16,S
      EORB  <0,S
      EORB  16,S
      ADCB  D,S
      ADCB  *-16,PCR
      ADCB  *,PCR
      ADCB  *+1,PCR
      ADCB  *+$00F2,PCR
      ADCB  [,S++]
      ADCB  [,--S]
      ADCB  [,S]
      ADCB  [B,S]
      ADCB  [A,S]
      ADCB  [-7,S]
      ADCB  [<0,S]
      ADCB  [1,S]
      ADCB  [$00FA,S]
      ADCB  [D,S]
      ADCB  [*,PCR]
      ADCB  [*+1,PCR]
      ADCB  [*-125,PCR]
      ADCB  [*+$0102,PCR]
      ADCB  <<0,X
      ADCB  1,X
      ADCB  -16,X
      ADCB  <<0,Y
      ADCB  1,Y
      ADCB  -16,Y
      ADCB  <<0,U
      ADCB  1,U
      ADCB  -16,U
      ADCB  <<0,S
      ADCB  1,S
      ADCB  -16,S
      ADCB  ,X+
      ADCB  ,X++
      ADCB  ,-X
      ADCB  ,--X
      ADCB  ,X
      ADCB  B,X
      ADCB  A,X
      ADCB  -119,X
      ADCB  <-16,X
      ADCB  <0,X
      ADCB  16,X
      ADCB  $018A,X
      ADCB  D,X
      ADCB  [,X++]
      ADCB  [,--X]
      ADCB  [,X]
      ADCB  [B,X]
      ADCB  [A,X]
      ADCB  [-103,X]
      ADCB  [<0,X]
      ADCB  [1,X]
      ADCB  [$019A,X]
      ADCB  [D,X]
      ADCB  [$01A0]
      ADCB  ,Y+
      ADCB  ,Y++
      ADCB  ,-Y
      ADCB  ,--Y
      ADCB  ,Y
      ADCB  B,Y
      ADCB  A,Y
      ADCB  -87,Y
      ADCB  <-16,Y
      ADCB  <0,Y
      ADCB  16,Y
      ADCB  $01AA,Y
      ADCB  D,Y
      ADCB  [,Y++]
      ADCB  [,--Y]
      ADCB  [,Y]
      ADCB  [B,Y]
      ADCB  [A,Y]
      ADCB  [-71,Y]
      ADCB  [<0,Y]
      ADCB  [1,Y]
      ADCB  [$01BA,Y]
      ADCB  [D,Y]
      ADCB  ,U+
      ADCB  ,U++
      ADCB  ,-U
      ADCB  ,--U
      ADCB  ,U
      ADCB  B,U
      ADCB  A,U
      ADCB  -55,U
      ADCB  <-16,U
      ADCB  <0,U
      ADCB  16,U
      ADCB  $01CA,U
      ADCB  D,U
      ADCB  [,U++]
      ADCB  [,--U]
      ADCB  [,U]
      ADCB  [B,U]
      ADCB  [A,U]
      ADCB  [-39,U]
      ADCB  [<0,U]
      ADCB  [1,U]
      ADCB  [$01DA,U]
      ADCB  [D,U]
      ADCB  ,S+
      ADCB  ,S++
      ADCB  ,-S
      ADCB  ,--S
      ADCB  ,S
      ADCB  B,S
      ADCB  A,S
      ADCB  -23,S
      ADCB  <-16,S
      ADCB  <0,S
      ADCB  16,S
      ADCB  $01EA,S
      ORB   D,S
      ORB   *-16,PCR
      ORB   *,PCR
      ORB   *+1,PCR
      ORB   *+$00F2,PCR
      ORB   [,S++]
      ORB   [,--S]
      ORB   [,S]
      ORB   [B,S]
      ORB   [A,S]
      ORB   [-7,S]
      ORB   [<0,S]
      ORB   [1,S]
      ORB   [$00FA,S]
      ORB   [D,S]
      ORB   [*,PCR]
      ORB   [*+1,PCR]
      ORB   [*-125,PCR]
      ORB   [*+$0102,PCR]
      ORB   <<0,X
      ORB   1,X
      ORB   -16,X
      ORB   <<0,Y
      ORB   1,Y
      ORB   -16,Y
      ORB   <<0,U
      ORB   1,U
      ORB   -16,U
      ORB   <<0,S
      ORB   1,S
      ORB   -16,S
      ORB   ,X+
      ORB   ,X++
      ORB   ,-X
      ORB   ,--X
      ORB   ,X
      ORB   B,X
      ORB   A,X
      ORB   -119,X
      ORB   <-16,X
      ORB   <0,X
      ORB   16,X
      ORB   $018A,X
      ORB   D,X
      ORB   [,X++]
      ORB   [,--X]
      ORB   [,X]
      ORB   [B,X]
      ORB   [A,X]
      ORB   [-103,X]
      ORB   [<0,X]
      ORB   [1,X]
      ORB   [$019A,X]
      ORB   [D,X]
      ORB   [$01A0]
      ORB   ,Y+
      ORB   ,Y++
      ORB   ,-Y
      ORB   ,--Y
      ORB   ,Y
      ORB   B,Y
      ORB   A,Y
      ORB   -87,Y
      ORB   <-16,Y
      ORB   <0,Y
      ORB   16,Y
      ORB   $01AA,Y
      ORB   D,Y
      ORB   [,Y++]
      ORB   [,--Y]
      ORB   [,Y]
      ORB   [B,Y]
      ORB   [A,Y]
      ORB   [-71,Y]
      ORB   [<0,Y]
      ORB   [1,Y]
      ORB   [$01BA,Y]
      ORB   [D,Y]
      ORB   ,U+
      ORB   ,U++
      ORB   ,-U
      ORB   ,--U
      ORB   ,U
      ORB   B,U
      ORB   A,U
      ORB   -55,U
      ORB   <-16,U
      ORB   <0,U
      ORB   16,U
      ORB   $01CA,U
      ORB   D,U
      ORB   [,U++]
      ORB   [,--U]
      ORB   [,U]
      ORB   [B,U]
      ORB   [A,U]
      ORB   [-39,U]
      ORB   [<0,U]
      ORB   [1,U]
      ORB   [$01DA,U]
      ORB   [D,U]
      ORB   ,S+
      ORB   ,S++
      ORB   ,-S
      ORB   ,--S
      ORB   ,S
      ORB   B,S
      ORB   A,S
      ORB   -23,S
      ORB   <-16,S
      ORB   <0,S
      ORB   16,S
      ORB   $01EA,S
      ADDB  *-16,PCR
      ADDB  *,PCR
      ADDB  *+1,PCR
      ADDB  *+$00F2,PCR
      ADDB  [,S++]
      ADDB  [,--S]
      ADDB  [,S]
      ADDB  [B,S]
      ADDB  [A,S]
      ADDB  [-7,S]
      ADDB  [<0,S]
      ADDB  [1,S]
      ADDB  [$00FA,S]
      ADDB  [D,S]
      ADDB  [*,PCR]
      ADDB  [*+1,PCR]
      ADDB  [*-125,PCR]
      ADDB  [*+$0102,PCR]
      ADDB  <<0,X
      ADDB  1,X
      ADDB  -16,X
      ADDB  <<0,Y
      ADDB  1,Y
      ADDB  -16,Y
      ADDB  <<0,U
      ADDB  1,U
      ADDB  -16,U
      ADDB  <<0,S
      ADDB  1,S
      ADDB  -16,S
      ADDB  ,X+
      ADDB  ,X++
      ADDB  ,-X
      ADDB  ,--X
      ADDB  ,X
      ADDB  B,X
      ADDB  A,X
      ADDB  -119,X
      ADDB  <-16,X
      ADDB  <0,X
      ADDB  16,X
      ADDB  $018A,X
      ADDB  D,X
      ADDB  [,X++]
      ADDB  [,--X]
      ADDB  [,X]
      ADDB  [B,X]
      ADDB  [A,X]
      ADDB  [-103,X]
      ADDB  [<0,X]
      ADDB  [1,X]
      ADDB  [$019A,X]
      ADDB  [D,X]
      ADDB  [$01A0]
      ADDB  ,Y+
      ADDB  ,Y++
      ADDB  ,-Y
      ADDB  ,--Y
      ADDB  ,Y
      ADDB  B,Y
      ADDB  A,Y
      ADDB  -87,Y
      ADDB  <-16,Y
      ADDB  <0,Y
      ADDB  16,Y
      ADDB  $01AA,Y
      ADDB  D,Y
      ADDB  [,Y++]
      ADDB  [,--Y]
      ADDB  [,Y]
      ADDB  [B,Y]
      ADDB  [A,Y]
      ADDB  [-71,Y]
      ADDB  [<0,Y]
      ADDB  [1,Y]
      ADDB  [$01BA,Y]
      ADDB  [D,Y]
      ADDB  ,U+
      ADDB  ,U++
      ADDB  ,-U
      ADDB  ,--U
      ADDB  ,U
      ADDB  B,U
      ADDB  A,U
      ADDB  -55,U
      ADDB  <-16,U
      ADDB  <0,U
      ADDB  16,U
      ADDB  $01CA,U
      ADDB  D,U
      ADDB  [,U++]
      ADDB  [,--U]
      ADDB  [,U]
      ADDB  [B,U]
      ADDB  [A,U]
      ADDB  [-39,U]
      ADDB  [<0,U]
      ADDB  [1,U]
      ADDB  [$01DA,U]
      ADDB  [D,U]
      ADDB  ,S+
      ADDB  ,S++
      ADDB  ,-S
      ADDB  ,--S
      ADDB  ,S
      ADDB  B,S
      ADDB  A,S
      ADDB  -23,S
      ADDB  <-16,S
      ADDB  <0,S
      ADDB  16,S
      ADDB  $01EA,S
      ADDB  D,S
      LDD   *+$00F2,PCR
      LDD   [,S++]
      LDD   [,--S]
      LDD   [,S]
      LDD   [B,S]
      LDD   [A,S]
      LDD   [-7,S]
      LDD   [<0,S]
      LDD   [1,S]
      LDD   [$00FA,S]
      LDD   [D,S]
      LDD   [*,PCR]
      LDD   [*+1,PCR]
      LDD   [*-125,PCR]
      LDD   [*+$0102,PCR]
      LDD   <<0,X
      LDD   1,X
      LDD   -16,X
      LDD   <<0,Y
      LDD   1,Y
      LDD   -16,Y
      LDD   <<0,U
      LDD   1,U
      LDD   -16,U
      LDD   <<0,S
      LDD   1,S
      LDD   -16,S
      LDD   ,X+
      LDD   ,X++
      LDD   ,-X
      LDD   ,--X
      LDD   ,X
      LDD   B,X
      LDD   A,X
      LDD   -119,X
      LDD   <-16,X
      LDD   <0,X
      LDD   16,X
      LDD   $018A,X
      LDD   D,X
      LDD   *-112,PCR
      LDD   *,PCR
      LDD   *+1,PCR
      LDD   [,X++]
      LDD   [,--X]
      LDD   [,X]
      LDD   [B,X]
      LDD   [A,X]
      LDD   [-103,X]
      LDD   [<0,X]
      LDD   [1,X]
      LDD   [$019A,X]
      LDD   [D,X]
      LDD   [$01A0]
      LDD   ,Y+
      LDD   ,Y++
      LDD   ,-Y
      LDD   ,--Y
      LDD   ,Y
      LDD   B,Y
      LDD   A,Y
      LDD   -87,Y
      LDD   <-16,Y
      LDD   <0,Y
      LDD   16,Y
      LDD   $01AA,Y
      LDD   D,Y
      LDD   [,Y++]
      LDD   [,--Y]
      LDD   [,Y]
      LDD   [B,Y]
      LDD   [A,Y]
      LDD   [-71,Y]
      LDD   [<0,Y]
      LDD   [1,Y]
      LDD   [$01BA,Y]
      LDD   [D,Y]
      LDD   ,U+
      LDD   ,U++
      LDD   ,-U
      LDD   ,--U
      LDD   ,U
      LDD   B,U
      LDD   A,U
      LDD   -55,U
      LDD   <-16,U
      LDD   <0,U
      LDD   16,U
      LDD   $01CA,U
      LDD   D,U
      LDD   [,U++]
      LDD   [,--U]
      LDD   [,U]
      LDD   [B,U]
      LDD   [A,U]
      LDD   [-39,U]
      LDD   [<0,U]
      LDD   [1,U]
      LDD   [$01DA,U]
      LDD   [D,U]
      LDD   ,S+
      LDD   ,S++
      LDD   ,-S
      LDD   ,--S
      LDD   ,S
      LDD   B,S
      LDD   A,S
      LDD   -23,S
      LDD   <-16,S
      LDD   <0,S
      LDD   16,S
      LDD   $01EA,S
      LDD   D,S
      STD   [,S++]
      STD   [,--S]
      STD   [,S]
      STD   [B,S]
      STD   [A,S]
      STD   [-7,S]
      STD   [<0,S]
      STD   [1,S]
      STD   [$00FA,S]
      STD   [D,S]
      STD   [*,PCR]
      STD   [*+1,PCR]
      STD   [*-125,PCR]
      STD   [*+$0102,PCR]
      STD   <<0,X
      STD   1,X
      STD   -16,X
      STD   <<0,Y
      STD   1,Y
      STD   -16,Y
      STD   <<0,U
      STD   1,U
      STD   -16,U
      STD   <<0,S
      STD   1,S
      STD   -16,S
      STD   ,X+
      STD   ,X++
      STD   ,-X
      STD   ,--X
      STD   ,X
      STD   B,X
      STD   A,X
      STD   -119,X
      STD   <-16,X
      STD   <0,X
      STD   16,X
      STD   $018A,X
      STD   D,X
      STD   *-112,PCR
      STD   *,PCR
      STD   *+1,PCR
      STD   *+$0192,PCR
      STD   [,X++]
      STD   [,--X]
      STD   [,X]
      STD   [B,X]
      STD   [A,X]
      STD   [-103,X]
      STD   [<0,X]
      STD   [1,X]
      STD   [$019A,X]
      STD   [D,X]
      STD   [$01A0]
      STD   ,Y+
      STD   ,Y++
      STD   ,-Y
      STD   ,--Y
      STD   ,Y
      STD   B,Y
      STD   A,Y
      STD   -87,Y
      STD   <-16,Y
      STD   <0,Y
      STD   16,Y
      STD   $01AA,Y
      STD   D,Y
      STD   [,Y++]
      STD   [,--Y]
      STD   [,Y]
      STD   [B,Y]
      STD   [A,Y]
      STD   [-71,Y]
      STD   [<0,Y]
      STD   [1,Y]
      STD   [$01BA,Y]
      STD   [D,Y]
      STD   ,U+
      STD   ,U++
      STD   ,-U
      STD   ,--U
      STD   ,U
      STD   B,U
      STD   A,U
      STD   -55,U
      STD   <-16,U
      STD   <0,U
      STD   16,U
      STD   $01CA,U
      STD   D,U
      STD   [,U++]
      STD   [,--U]
      STD   [,U]
      STD   [B,U]
      STD   [A,U]
      STD   [-39,U]
      STD   [<0,U]
      STD   [1,U]
      STD   [$01DA,U]
      STD   [D,U]
      STD   ,S+
      STD   ,S++
      STD   ,-S
      STD   ,--S
      STD   ,S
      STD   B,S
      STD   A,S
      STD   -23,S
      STD   <-16,S
      STD   <0,S
      STD   16,S
      STD   $01EA,S
      STD   D,S
      LDU   [,S++]
      LDU   [,--S]
      LDU   [,S]
      LDU   [B,S]
      LDU   [A,S]
      LDU   [-7,S]
      LDU   [<0,S]
      LDU   [1,S]
      LDU   [$00FA,S]
      LDU   [D,S]
      LDU   [*,PCR]
      LDU   [*+1,PCR]
      LDU   [*-125,PCR]
      LDU   [*+$0102,PCR]
      LDU   <<0,X
      LDU   1,X
      LDU   -16,X
      LDU   <<0,Y
      LDU   1,Y
      LDU   -16,Y
      LDU   <<0,U
      LDU   1,U
      LDU   -16,U
      LDU   <<0,S
      LDU   1,S
      LDU   -16,S
      LDU   ,X+
      LDU   ,X++
      LDU   ,-X
      LDU   ,--X
      LDU   ,X
      LDU   B,X
      LDU   A,X
      LDU   -119,X
      LDU   <-16,X
      LDU   <0,X
      LDU   16,X
      LDU   $018A,X
      LDU   D,X
      LDU   *-112,PCR
      LDU   *,PCR
      LDU   *+1,PCR
      LDU   *+$0192,PCR
      LDU   [,X++]
      LDU   [,--X]
      LDU   [,X]
      LDU   [B,X]
      LDU   [A,X]
      LDU   [-103,X]
      LDU   [<0,X]
      LDU   [1,X]
      LDU   [$019A,X]
      LDU   [D,X]
      LDU   [$01A0]
      LDU   ,Y+
      LDU   ,Y++
      LDU   ,-Y
      LDU   ,--Y
      LDU   ,Y
      LDU   B,Y
      LDU   A,Y
      LDU   -87,Y
      LDU   <-16,Y
      LDU   <0,Y
      LDU   16,Y
      LDU   $01AA,Y
      LDU   D,Y
      LDU   [,Y++]
      LDU   [,--Y]
      LDU   [,Y]
      LDU   [B,Y]
      LDU   [A,Y]
      LDU   [-71,Y]
      LDU   [<0,Y]
      LDU   [1,Y]
      LDU   [$01BA,Y]
      LDU   [D,Y]
      LDU   ,U+
      LDU   ,U++
      LDU   ,-U
      LDU   ,--U
      LDU   ,U
      LDU   B,U
      LDU   A,U
      LDU   -55,U
      LDU   <-16,U
      LDU   <0,U
      LDU   16,U
      LDU   $01CA,U
      LDU   D,U
      LDU   [,U++]
      LDU   [,--U]
      LDU   [,U]
      LDU   [B,U]
      LDU   [A,U]
      LDU   [-39,U]
      LDU   [<0,U]
      LDU   [1,U]
      LDU   [$01DA,U]
      LDU   [D,U]
      LDU   ,S+
      LDU   ,S++
      LDU   ,-S
      LDU   ,--S
      LDU   ,S
      LDU   B,S
      LDU   A,S
      LDU   -23,S
      LDU   <-16,S
      LDU   <0,S
      LDU   16,S
      LDU   $01EA,S
      LDU   D,S
      STU   [,S++]
      STU   [,--S]
      STU   [,S]
      STU   [B,S]
      STU   [A,S]
      STU   [-7,S]
      STU   [<0,S]
      STU   [1,S]
      STU   [$00FA,S]
      STU   [D,S]
      STU   [*,PCR]
      STU   [*+1,PCR]
      STU   [*-125,PCR]
      STU   [*+$0102,PCR]
      STU   <<0,X
      STU   1,X
      STU   -16,X
      STU   <<0,Y
      STU   1,Y
      STU   -16,Y
      STU   <<0,U
      STU   1,U
      STU   -16,U
      STU   <<0,S
      STU   1,S
      STU   -16,S
      STU   ,X+
      STU   ,X++
      STU   ,-X
      STU   ,--X
      STU   ,X
      STU   B,X
      STU   A,X
      STU   -119,X
      STU   <-16,X
      STU   <0,X
      STU   16,X
      STU   $018A,X
      STU   D,X
      STU   *-112,PCR
      STU   *,PCR
      STU   *+1,PCR
      STU   *+$0192,PCR
      STU   [,X++]
      STU   [,--X]
      STU   [,X]
      STU   [B,X]
      STU   [A,X]
      STU   [-103,X]
      STU   [<0,X]
      STU   [1,X]
      STU   [$019A,X]
      STU   [D,X]
      STU   [$01A0]
      STU   ,Y+
      STU   ,Y++
      STU   ,-Y
      STU   ,--Y
      STU   ,Y
      STU   B,Y
      STU   A,Y
      STU   -87,Y
      STU   <-16,Y
      STU   <0,Y
      STU   16,Y
      STU   $01AA,Y
      STU   D,Y
      STU   [,Y++]
      STU   [,--Y]
      STU   [,Y]
      STU   [B,Y]
      STU   [A,Y]
      STU   [-71,Y]
      STU   [<0,Y]
      STU   [1,Y]
      STU   [$01BA,Y]
      STU   [D,Y]
      STU   ,U+
      STU   ,U++
      STU   ,-U
      STU   ,--U
      STU   ,U
      STU   B,U
      STU   A,U
      STU   -55,U
      STU   <-16,U
      STU   <0,U
      STU   16,U
      STU   $01CA,U
      STU   D,U
      STU   [,U++]
      STU   [,--U]
      STU   [,U]
      STU   [B,U]
      STU   [A,U]
      STU   [-39,U]
      STU   [<0,U]
      STU   [1,U]
      STU   [$01DA,U]
      STU   [D,U]
      STU   ,S+
      STU   ,S++
      STU   ,-S
      STU   ,--S
      STU   ,S
      STU   B,S
      STU   A,S
      STU   -23,S
      STU   <-16,S
      STU   <0,S
      STU   16,S
      STU   $01EA,S
      STU   D,S
      SUBB  >$00F1
      SUBB  $0100
      CMPB  >$00F2
      CMPB  $0100
      SBCB  >$00F3
      SBCB  $0100
      ADDD  >$00F4
      ADDD  $0100
      ANDB  >$00F5
      ANDB  $0100
      BITB  >$00F6
      BITB  $0100
      LDB   >$00F7
      LDB   $0100
      STB   >$00F8
      STB   $0100
      EORB  >$00F9
      EORB  $0100
      ADCB  >$00FA
      ADCB  $0100
      ORB   >$00FB
      ORB   $0100
      ADDB  >$00FC
      ADDB  $0100
      LDD   >$00FD
      LDD   $0100
      STD   >$00FE
      STD   $0100
      LDU   >$00FF
      LDU   $0100
      STU   $0100
      LBRN  *+$0026
      LBHI  *+$0027
      LBLS  *+$0028
      LBHS  *+$0029
      LBLO  *+$002A
      LBNE  *+$002B
      LBEQ  *+$002C
      LBVC  *+$002D
      LBVS  *+$002E
      LBPL  *+$002F
      LBMI  *+$0030
      LBGE  *+$0031
      LBLT  *+$0032
      LBGT  *+$0033
      LBLE  *+$0034
      SWI2
      CMPD  #$0084
      CMPY  #$008D
      LDY   #$008F
      CMPD  $94
      CMPY  $9D
      LDY   $9F
      STY   $A0
      CMPD  ,Y
      CMPD  B,Y
      CMPD  A,Y
      CMPD  -87,Y
      CMPD  <-16,Y
      CMPD  <0,Y
      CMPD  16,Y
      CMPD  $00AA,Y
      CMPD  D,Y
      CMPD  *-79,PCR
      CMPD  *,PCR
      CMPD  *+1,PCR
      CMPD  *+$00B3,PCR
      CMPD  [,Y++]
      CMPD  [,--Y]
      CMPD  [,Y]
      CMPD  [B,Y]
      CMPD  [A,Y]
      CMPD  [-71,Y]
      CMPD  [<0,Y]
      CMPD  [1,Y]
      CMPD  [$00BA,Y]
      CMPD  [D,Y]
      CMPD  [*-63,PCR]
      CMPD  [*,PCR]
      CMPD  [*+1,PCR]
      CMPD  [*+$00C3,PCR]
      CMPD  ,U+
      CMPD  ,U++
      CMPD  ,-U
      CMPD  ,--U
      CMPD  ,U
      CMPD  B,U
      CMPD  A,U
      CMPD  -55,U
      CMPD  <-16,U
      CMPD  <0,U
      CMPD  16,U
      CMPD  $00CA,U
      CMPD  D,U
      CMPD  [,U++]
      CMPD  [,--U]
      CMPD  [,U]
      CMPD  [B,U]
      CMPD  [A,U]
      CMPD  [-39,U]
      CMPD  [<0,U]
      CMPD  [1,U]
      CMPD  [$00DA,U]
      CMPD  [D,U]
      CMPD  ,S+
      CMPD  ,S++
      CMPD  ,-S
      CMPD  ,--S
      CMPD  ,S
      CMPD  B,S
      CMPD  A,S
      CMPD  -23,S
      CMPD  <-16,S
      CMPD  <0,S
      CMPD  16,S
      CMPD  $00EA,S
      CMPD  D,S
      CMPD  [,S++]
      CMPD  [,--S]
      CMPD  [,S]
      CMPD  [B,S]
      CMPD  [A,S]
      CMPD  [-7,S]
      CMPD  [<0,S]
      CMPD  [1,S]
      CMPD  [$00FA,S]
      CMPD  [D,S]
      CMPD  <<0,X
      CMPD  1,X
      CMPD  -16,X
      CMPD  <<0,Y
      CMPD  1,Y
      CMPD  -16,Y
      CMPD  <<0,U
      CMPD  1,U
      CMPD  -16,U
      CMPD  <<0,S
      CMPD  1,S
      CMPD  -16,S
      CMPD  ,X+
      CMPD  ,X++
      CMPD  ,-X
      CMPD  ,--X
      CMPD  ,X
      CMPD  B,X
      CMPD  A,X
      CMPD  -119,X
      CMPD  <-16,X
      CMPD  <0,X
      CMPD  16,X
      CMPD  $018A,X
      CMPD  D,X
      CMPD  [,X++]
      CMPD  [,--X]
      CMPD  [,X]
      CMPD  [B,X]
      CMPD  [A,X]
      CMPD  [-103,X]
      CMPD  [<0,X]
      CMPD  [1,X]
      CMPD  [$019A,X]
      CMPD  [D,X]
      CMPD  [$01A0]
      CMPD  ,Y+
      CMPD  ,Y++
      CMPD  ,-Y
      CMPD  ,--Y
      CMPY  *+$00B3,PCR
      CMPY  [,Y++]
      CMPY  [,--Y]
      CMPY  [,Y]
      CMPY  [B,Y]
      CMPY  [A,Y]
      CMPY  [-71,Y]
      CMPY  [<0,Y]
      CMPY  [1,Y]
      CMPY  [$00BA,Y]
      CMPY  [D,Y]
      CMPY  [*-63,PCR]
      CMPY  [*,PCR]
      CMPY  [*+1,PCR]
      CMPY  [*+$00C3,PCR]
      CMPY  ,U+
      CMPY  ,U++
      CMPY  ,-U
      CMPY  ,--U
      CMPY  ,U
      CMPY  B,U
      CMPY  A,U
      CMPY  -55,U
      CMPY  <-16,U
      CMPY  <0,U
      CMPY  16,U
      CMPY  $00CA,U
      CMPY  D,U
      CMPY  *-47,PCR
      CMPY  *,PCR
      CMPY  *+1,PCR
      CMPY  [,U++]
      CMPY  [,--U]
      CMPY  [,U]
      CMPY  [B,U]
      CMPY  [A,U]
      CMPY  [-39,U]
      CMPY  [<0,U]
      CMPY  [1,U]
      CMPY  [$00DA,U]
      CMPY  [D,U]
      CMPY  ,S+
      CMPY  ,S++
      CMPY  ,-S
      CMPY  ,--S
      CMPY  ,S
      CMPY  B,S
      CMPY  A,S
      CMPY  -23,S
      CMPY  <-16,S
      CMPY  <0,S
      CMPY  16,S
      CMPY  $00EA,S
      CMPY  D,S
      CMPY  [,S++]
      CMPY  [,--S]
      CMPY  [,S]
      CMPY  [B,S]
      CMPY  [A,S]
      CMPY  [-7,S]
      CMPY  [<0,S]
      CMPY  [1,S]
      CMPY  [$00FA,S]
      CMPY  [D,S]
      CMPY  <<0,X
      CMPY  1,X
      CMPY  -16,X
      CMPY  <<0,Y
      CMPY  1,Y
      CMPY  -16,Y
      CMPY  <<0,U
      CMPY  1,U
      CMPY  -16,U
      CMPY  <<0,S
      CMPY  1,S
      CMPY  -16,S
      CMPY  ,X+
      CMPY  ,X++
      CMPY  ,-X
      CMPY  ,--X
      CMPY  ,X
      CMPY  B,X
      CMPY  A,X
      CMPY  -119,X
      CMPY  <-16,X
      CMPY  <0,X
      CMPY  16,X
      CMPY  $018A,X
      CMPY  D,X
      CMPY  [,X++]
      CMPY  [,--X]
      CMPY  [,X]
      CMPY  [B,X]
      CMPY  [A,X]
      CMPY  [-103,X]
      CMPY  [<0,X]
      CMPY  [1,X]
      CMPY  [$019A,X]
      CMPY  [D,X]
      CMPY  [$01A0]
      CMPY  ,Y+
      CMPY  ,Y++
      CMPY  ,-Y
      CMPY  ,--Y
      CMPY  ,Y
      CMPY  B,Y
      CMPY  A,Y
      CMPY  -87,Y
      CMPY  <-16,Y
      CMPY  <0,Y
      CMPY  16,Y
      CMPY  $01AA,Y
      CMPY  D,Y
      LDY   [,Y++]
      LDY   [,--Y]
      LDY   [,Y]
      LDY   [B,Y]
      LDY   [A,Y]
      LDY   [-71,Y]
      LDY   [<0,Y]
      LDY   [1,Y]
      LDY   [$00BA,Y]
      LDY   [D,Y]
      LDY   [*-63,PCR]
      LDY   [*,PCR]
      LDY   [*+1,PCR]
      LDY   [*+$00C3,PCR]
      LDY   ,U+
      LDY   ,U++
      LDY   ,-U
      LDY   ,--U
      LDY   ,U
      LDY   B,U
      LDY   A,U
      LDY   -55,U
      LDY   <-16,U
      LDY   <0,U
      LDY   16,U
      LDY   $00CA,U
      LDY   D,U
      LDY   *-47,PCR
      LDY   *,PCR
      LDY   *+1,PCR
      LDY   *+$00D3,PCR
      LDY   [,U++]
      LDY   [,--U]
      LDY   [,U]
      LDY   [B,U]
      LDY   [A,U]
      LDY   [-39,U]
      LDY   [<0,U]
      LDY   [1,U]
      LDY   [$00DA,U]
      LDY   [D,U]
      LDY   ,S+
      LDY   ,S++
      LDY   ,-S
      LDY   ,--S
      LDY   ,S
      LDY   B,S
      LDY   A,S
      LDY   -23,S
      LDY   <-16,S
      LDY   <0,S
      LDY   16,S
      LDY   $00EA,S
      LDY   D,S
      LDY   [,S++]
      LDY   [,--S]
      LDY   [,S]
      LDY   [B,S]
      LDY   [A,S]
      LDY   [-7,S]
      LDY   [<0,S]
      LDY   [1,S]
      LDY   [$00FA,S]
      LDY   [D,S]
      LDY   <<0,X
      LDY   1,X
      LDY   -16,X
      LDY   <<0,Y
      LDY   1,Y
      LDY   -16,Y
      LDY   <<0,U
      LDY   1,U
      LDY   -16,U
      LDY   <<0,S
      LDY   1,S
      LDY   -16,S
      LDY   ,X+
      LDY   ,X++
      LDY   ,-X
      LDY   ,--X
      LDY   ,X
      LDY   B,X
      LDY   A,X
      LDY   -119,X
      LDY   <-16,X
      LDY   <0,X
      LDY   16,X
      LDY   $018A,X
      LDY   D,X
      LDY   [,X++]
      LDY   [,--X]
      LDY   [,X]
      LDY   [B,X]
      LDY   [A,X]
      LDY   [-103,X]
      LDY   [<0,X]
      LDY   [1,X]
      LDY   [$019A,X]
      LDY   [D,X]
      LDY   [$01A0]
      LDY   ,Y+
      LDY   ,Y++
      LDY   ,-Y
      LDY   ,--Y
      LDY   ,Y
      LDY   B,Y
      LDY   A,Y
      LDY   -87,Y
      LDY   <-16,Y
      LDY   <0,Y
      LDY   16,Y
      LDY   $01AA,Y
      LDY   D,Y
      STY   [,Y++]
      STY   [,--Y]
      STY   [,Y]
      STY   [B,Y]
      STY   [A,Y]
      STY   [-71,Y]
      STY   [<0,Y]
      STY   [1,Y]
      STY   [$00BA,Y]
      STY   [D,Y]
      STY   [*-63,PCR]
      STY   [*,PCR]
      STY   [*+1,PCR]
      STY   [*+$00C3,PCR]
      STY   ,U+
      STY   ,U++
      STY   ,-U
      STY   ,--U
      STY   ,U
      STY   B,U
      STY   A,U
      STY   -55,U
      STY   <-16,U
      STY   <0,U
      STY   16,U
      STY   $00CA,U
      STY   D,U
      STY   *-47,PCR
      STY   *,PCR
      STY   *+1,PCR
      STY   *+$00D3,PCR
      STY   [,U++]
      STY   [,--U]
      STY   [,U]
      STY   [B,U]
      STY   [A,U]
      STY   [-39,U]
      STY   [<0,U]
      STY   [1,U]
      STY   [$00DA,U]
      STY   [D,U]
      STY   ,S+
      STY   ,S++
      STY   ,-S
      STY   ,--S
      STY   ,S
      STY   B,S
      STY   A,S
      STY   -23,S
      STY   <-16,S
      STY   <0,S
      STY   16,S
      STY   $00EA,S
      STY   D,S
      STY   [,S++]
      STY   [,--S]
      STY   [,S]
      STY   [B,S]
      STY   [A,S]
      STY   [-7,S]
      STY   [<0,S]
      STY   [1,S]
      STY   [$00FA,S]
      STY   [D,S]
      STY   <<0,X
      STY   1,X
      STY   -16,X
      STY   <<0,Y
      STY   1,Y
      STY   -16,Y
      STY   <<0,U
      STY   1,U
      STY   -16,U
      STY   <<0,S
      STY   1,S
      STY   -16,S
      STY   ,X+
      STY   ,X++
      STY   ,-X
      STY   ,--X
      STY   ,X
      STY   B,X
      STY   A,X
      STY   -119,X
      STY   <-16,X
      STY   <0,X
      STY   16,X
      STY   $018A,X
      STY   D,X
      STY   [,X++]
      STY   [,--X]
      STY   [,X]
      STY   [B,X]
      STY   [A,X]
      STY   [-103,X]
      STY   [<0,X]
      STY   [1,X]
      STY   [$019A,X]
      STY   [D,X]
      STY   [$01A0]
      STY   ,Y+
      STY   ,Y++
      STY   ,-Y
      STY   ,--Y
      STY   ,Y
      STY   B,Y
      STY   A,Y
      STY   -87,Y
      STY   <-16,Y
      STY   <0,Y
      STY   16,Y
      STY   $01AA,Y
      STY   D,Y
      CMPD  >$00B4
      CMPD  $0100
      CMPY  >$00BD
      CMPY  $0100
      LDY   >$00BF
      LDY   $0100
      STY   >$00C0
      STY   $0100
      LDS   #$00CF
      LDS   $DF
      STS   $E0
      LDS   [,S++]
      LDS   [,--S]
      LDS   [,S]
      LDS   [B,S]
      LDS   [A,S]
      LDS   [-7,S]
      LDS   [<0,S]
      LDS   [1,S]
      LDS   [$00FA,S]
      LDS   [D,S]
      LDS   [*+1,PCR]
      LDS   [*-124,PCR]
      LDS   [*,PCR]
      LDS   [*+$0103,PCR]
      LDS   <<0,X
      LDS   1,X
      LDS   -16,X
      LDS   <<0,Y
      LDS   1,Y
      LDS   -16,Y
      LDS   <<0,U
      LDS   1,U
      LDS   -16,U
      LDS   <<0,S
      LDS   1,S
      LDS   -16,S
      LDS   ,X+
      LDS   ,X++
      LDS   ,-X
      LDS   ,--X
      LDS   ,X
      LDS   B,X
      LDS   A,X
      LDS   -119,X
      LDS   <-16,X
      LDS   <0,X
      LDS   16,X
      LDS   $018A,X
      LDS   D,X
      LDS   *-111,PCR
      LDS   *,PCR
      LDS   *+1,PCR
      LDS   *+$0193,PCR
      LDS   [,X++]
      LDS   [,--X]
      LDS   [,X]
      LDS   [B,X]
      LDS   [A,X]
      LDS   [-103,X]
      LDS   [<0,X]
      LDS   [1,X]
      LDS   [$019A,X]
      LDS   [D,X]
      LDS   [$01A0]
      LDS   ,Y+
      LDS   ,Y++
      LDS   ,-Y
      LDS   ,--Y
      LDS   ,Y
      LDS   B,Y
      LDS   A,Y
      LDS   -87,Y
      LDS   <-16,Y
      LDS   <0,Y
      LDS   16,Y
      LDS   $01AA,Y
      LDS   D,Y
      LDS   [,Y++]
      LDS   [,--Y]
      LDS   [,Y]
      LDS   [B,Y]
      LDS   [A,Y]
      LDS   [-71,Y]
      LDS   [<0,Y]
      LDS   [1,Y]
      LDS   [$01BA,Y]
      LDS   [D,Y]
      LDS   ,U+
      LDS   ,U++
      LDS   ,-U
      LDS   ,--U
      LDS   ,U
      LDS   B,U
      LDS   A,U
      LDS   -55,U
      LDS   <-16,U
      LDS   <0,U
      LDS   16,U
      LDS   $01CA,U
      LDS   D,U
      LDS   [,U++]
      LDS   [,--U]
      LDS   [,U]
      LDS   [B,U]
      LDS   [A,U]
      LDS   [-39,U]
      LDS   [<0,U]
      LDS   [1,U]
      LDS   [$01DA,U]
      LDS   [D,U]
      LDS   ,S+
      LDS   ,S++
      LDS   ,-S
      LDS   ,--S
      LDS   ,S
      LDS   B,S
      LDS   A,S
      LDS   -23,S
      LDS   <-16,S
      LDS   <0,S
      LDS   16,S
      LDS   $01EA,S
      LDS   D,S
      STS   [,S++]
      STS   [,--S]
      STS   [,S]
      STS   [B,S]
      STS   [A,S]
      STS   [-7,S]
      STS   [<0,S]
      STS   [1,S]
      STS   [$00FA,S]
      STS   [D,S]
      STS   [*+1,PCR]
      STS   [*-124,PCR]
      STS   [*,PCR]
      STS   [*+$0103,PCR]
      STS   <<0,X
      STS   1,X
      STS   -16,X
      STS   <<0,Y
      STS   1,Y
      STS   -16,Y
      STS   <<0,U
      STS   1,U
      STS   -16,U
      STS   <<0,S
      STS   1,S
      STS   -16,S
      STS   ,X+
      STS   ,X++
      STS   ,-X
      STS   ,--X
      STS   ,X
      STS   B,X
      STS   A,X
      STS   -119,X
      STS   <-16,X
      STS   <0,X
      STS   16,X
      STS   $018A,X
      STS   D,X
      STS   *-111,PCR
      STS   *,PCR
      STS   *+1,PCR
      STS   *+$0193,PCR
      STS   [,X++]
      STS   [,--X]
      STS   [,X]
      STS   [B,X]
      STS   [A,X]
      STS   [-103,X]
      STS   [<0,X]
      STS   [1,X]
      STS   [$019A,X]
      STS   [D,X]
      STS   [$01A0]
      STS   ,Y+
      STS   ,Y++
      STS   ,-Y
      STS   ,--Y
      STS   ,Y
      STS   B,Y
      STS   A,Y
      STS   -87,Y
      STS   <-16,Y
      STS   <0,Y
      STS   16,Y
      STS   $01AA,Y
      STS   D,Y
      STS   [,Y++]
      STS   [,--Y]
      STS   [,Y]
      STS   [B,Y]
      STS   [A,Y]
      STS   [-71,Y]
      STS   [<0,Y]
      STS   [1,Y]
      STS   [$01BA,Y]
      STS   [D,Y]
      STS   ,U+
      STS   ,U++
      STS   ,-U
      STS   ,--U
      STS   ,U
      STS   B,U
      STS   A,U
      STS   -55,U
      STS   <-16,U
      STS   <0,U
      STS   16,U
      STS   $01CA,U
      STS   D,U
      STS   [,U++]
      STS   [,--U]
      STS   [,U]
      STS   [B,U]
      STS   [A,U]
      STS   [-39,U]
      STS   [<0,U]
      STS   [1,U]
      STS   [$01DA,U]
      STS   [D,U]
      STS   ,S+
      STS   ,S++
      STS   ,-S
      STS   ,--S
      STS   ,S
      STS   B,S
      STS   A,S
      STS   -23,S
      STS   <-16,S
      STS   <0,S
      STS   16,S
      STS   $01EA,S
      STS   D,S
      LDS   >$00FF
      LDS   $0100
      STS   $0100
      SWI3
      CMPU  #$0084
      CMPS  #$008D
      CMPU  $94
      CMPS  $9D
      CMPU  ,Y
      CMPU  B,Y
      CMPU  A,Y
      CMPU  -87,Y
      CMPU  <-16,Y
      CMPU  <0,Y
      CMPU  16,Y
      CMPU  $00AA,Y
      CMPU  D,Y
      CMPU  *-79,PCR
      CMPU  *,PCR
      CMPU  *+1,PCR
      CMPU  *+$00B3,PCR
      CMPU  [,Y++]
      CMPU  [,--Y]
      CMPU  [,Y]
      CMPU  [B,Y]
      CMPU  [A,Y]
      CMPU  [-71,Y]
      CMPU  [<0,Y]
      CMPU  [1,Y]
      CMPU  [$00BA,Y]
      CMPU  [D,Y]
      CMPU  [*-63,PCR]
      CMPU  [*,PCR]
      CMPU  [*+1,PCR]
      CMPU  [*+$00C3,PCR]
      CMPU  ,U+
      CMPU  ,U++
      CMPU  ,-U
      CMPU  ,--U
      CMPU  ,U
      CMPU  B,U
      CMPU  A,U
      CMPU  -55,U
      CMPU  <-16,U
      CMPU  <0,U
      CMPU  16,U
      CMPU  $00CA,U
      CMPU  D,U
      CMPU  [,U++]
      CMPU  [,--U]
      CMPU  [,U]
      CMPU  [B,U]
      CMPU  [A,U]
      CMPU  [-39,U]
      CMPU  [<0,U]
      CMPU  [1,U]
      CMPU  [$00DA,U]
      CMPU  [D,U]
      CMPU  ,S+
      CMPU  ,S++
      CMPU  ,-S
      CMPU  ,--S
      CMPU  ,S
      CMPU  B,S
      CMPU  A,S
      CMPU  -23,S
      CMPU  <-16,S
      CMPU  <0,S
      CMPU  16,S
      CMPU  $00EA,S
      CMPU  D,S
      CMPU  [,S++]
      CMPU  [,--S]
      CMPU  [,S]
      CMPU  [B,S]
      CMPU  [A,S]
      CMPU  [-7,S]
      CMPU  [<0,S]
      CMPU  [1,S]
      CMPU  [$00FA,S]
      CMPU  [D,S]
      CMPU  <<0,X
      CMPU  1,X
      CMPU  -16,X
      CMPU  <<0,Y
      CMPU  1,Y
      CMPU  -16,Y
      CMPU  <<0,U
      CMPU  1,U
      CMPU  -16,U
      CMPU  <<0,S
      CMPU  1,S
      CMPU  -16,S
      CMPU  ,X+
      CMPU  ,X++
      CMPU  ,-X
      CMPU  ,--X
      CMPU  ,X
      CMPU  B,X
      CMPU  A,X
      CMPU  -119,X
      CMPU  <-16,X
      CMPU  <0,X
      CMPU  16,X
      CMPU  $018A,X
      CMPU  D,X
      CMPU  [,X++]
      CMPU  [,--X]
      CMPU  [,X]
      CMPU  [B,X]
      CMPU  [A,X]
      CMPU  [-103,X]
      CMPU  [<0,X]
      CMPU  [1,X]
      CMPU  [$019A,X]
      CMPU  [D,X]
      CMPU  [$01A0]
      CMPU  ,Y+
      CMPU  ,Y++
      CMPU  ,-Y
      CMPU  ,--Y
      CMPS  *+$00B3,PCR
      CMPS  [,Y++]
      CMPS  [,--Y]
      CMPS  [,Y]
      CMPS  [B,Y]
      CMPS  [A,Y]
      CMPS  [-71,Y]
      CMPS  [<0,Y]
      CMPS  [1,Y]
      CMPS  [$00BA,Y]
      CMPS  [D,Y]
      CMPS  [*-63,PCR]
      CMPS  [*,PCR]
      CMPS  [*+1,PCR]
      CMPS  [*+$00C3,PCR]
      CMPS  ,U+
      CMPS  ,U++
      CMPS  ,-U
      CMPS  ,--U
      CMPS  ,U
      CMPS  B,U
      CMPS  A,U
      CMPS  -55,U
      CMPS  <-16,U
      CMPS  <0,U
      CMPS  16,U
      CMPS  $00CA,U
      CMPS  D,U
      CMPS  *-47,PCR
      CMPS  *,PCR
      CMPS  *+1,PCR
      CMPS  [,U++]
      CMPS  [,--U]
      CMPS  [,U]
      CMPS  [B,U]
      CMPS  [A,U]
      CMPS  [-39,U]
      CMPS  [<0,U]
      CMPS  [1,U]
      CMPS  [$00DA,U]
      CMPS  [D,U]
      CMPS  ,S+
      CMPS  ,S++
      CMPS  ,-S
      CMPS  ,--S
      CMPS  ,S
      CMPS  B,S
      CMPS  A,S
      CMPS  -23,S
      CMPS  <-16,S
      CMPS  <0,S
      CMPS  16,S
      CMPS  $00EA,S
      CMPS  D,S
      CMPS  [,S++]
      CMPS  [,--S]
      CMPS  [,S]
      CMPS  [B,S]
      CMPS  [A,S]
      CMPS  [-7,S]
      CMPS  [<0,S]
      CMPS  [1,S]
      CMPS  [$00FA,S]
      CMPS  [D,S]
      CMPS  <<0,X
      CMPS  1,X
      CMPS  -16,X
      CMPS  <<0,Y
      CMPS  1,Y
      CMPS  -16,Y
      CMPS  <<0,U
      CMPS  1,U
      CMPS  -16,U
      CMPS  <<0,S
      CMPS  1,S
      CMPS  -16,S
      CMPS  ,X+
      CMPS  ,X++
      CMPS  ,-X
      CMPS  ,--X
      CMPS  ,X
      CMPS  B,X
      CMPS  A,X
      CMPS  -119,X
      CMPS  <-16,X
      CMPS  <0,X
      CMPS  16,X
      CMPS  $018A,X
      CMPS  D,X
      CMPS  [,X++]
      CMPS  [,--X]
      CMPS  [,X]
      CMPS  [B,X]
      CMPS  [A,X]
      CMPS  [-103,X]
      CMPS  [<0,X]
      CMPS  [1,X]
      CMPS  [$019A,X]
      CMPS  [D,X]
      CMPS  [$01A0]
      CMPS  ,Y+
      CMPS  ,Y++
      CMPS  ,-Y
      CMPS  ,--Y
      CMPS  ,Y
      CMPS  B,Y
      CMPS  A,Y
      CMPS  -87,Y
      CMPS  <-16,Y
      CMPS  <0,Y
      CMPS  16,Y
      CMPS  $01AA,Y
      CMPS  D,Y
      CMPU  >$00B4
      CMPU  $0100
      CMPS  >$00BD
      CMPS  $0100
