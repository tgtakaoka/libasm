### AUTO GENERATED FILE
### generated by: gen_z8000 -c -C z8002 -o gen_z8002.inc -l gen_z8002.lst
      addb   rh1,#3
      addb   rl0,#10
      addb   rh0,@r1
      addb   rl0,@r1
      add    r0,#0x0102
      add    r0,@r1
      subb   rh0,#2
      subb   rl0,#10
      subb   rh0,@r1
      subb   rl0,@r1
      sub    r0,#0x0102
      sub    r0,@r1
      orb    rh0,#2
      orb    rl0,#10
      orb    rh0,@r1
      orb    rl0,@r1
      or     r0,#0x0102
      or     r0,@r1
      andb   rh0,#2
      andb   rl0,#10
      andb   rh0,@r1
      andb   rl0,@r1
      and    r0,#0x0102
      and    r0,@r1
      xorb   rh0,#2
      xorb   rl0,#10
      xorb   rh0,@r1
      xorb   rl0,@r1
      xor    r0,#0x0102
      xor    r0,@r1
      cpb    rh0,#2
      cpb    rl0,#10
      cpb    rh0,@r1
      cpb    rl0,@r1
      cp     r0,#0x0102
      cp     r0,@r1
      comb   @r1
      cpb    @r1,#19
      negb   @r1
      testb  @r1
      ldb    @r1,#23
      tsetb  @r1
      clrb   @r1
      com    @r1
      cp     @r1,#0x1213
      neg    @r1
      test   @r1
      ld     @r1,#0x1617
      tset   @r1
      clr    @r1
      push   @r1,#0x1a1b
      cpl    rr0,#0x01020304
      cpl    rr0,@r1
      pushl  @r1,@r1
      subl   rr0,#0x01020304
      subl   rr0,@r1
      push   @r1,@r1
      ldl    rr0,#0x01020304
      ldl    rr0,@r1
      popl   @r1,@r1
      addl   rr0,#0x01020304
      addl   rr0,@r1
      pop    @r1,@r1
      multl  rq0,#0x01020304
      multl  rq0,@r1
      mult   rr0,#0x0102
      mult   rr0,@r1
      divl   rq0,#0x01020304
      divl   rq0,@r1
      div    rr0,#0x0102
      div    rr0,@r1
      testl  @r1
      ldl    @r1,rr0
      jp     f,@r1
      jp     lt,@r1
      jp     le,@r1
      jp     ule,@r1
      jp     ov,@r1
      jp     mi,@r1
      jp     z,@r1
      jp     c,@r1
      jp     @r1
      jp     ge,@r1
      jp     gt,@r1
      jp     ugt,@r1
      jp     nov,@r1
      jp     pl,@r1
      jp     nz,@r1
      jp     nc,@r1
      call   @r1
      ldb    rh0,#2
      ldb    rl0,#10
      ldb    rh0,@r1
      ldb    rl0,@r1
      ld     r0,#0x0102
      ld     r0,@r1
      resb   @r1,#0
      res    @r1,#0
      setb   @r1,#0
      set    @r1,#0
      bitb   @r1,#0
      bit    @r1,#0
      incb   @r1,#1
      inc    @r1,#1
      decb   @r1,#1
      dec    @r1,#1
      exb    rh0,@r1
      exb    rl0,@r1
      ex     r0,@r1
      ldb    @r1,rh0
      ldb    @r1,rl0
      ld     @r1,r0
      ldrb   rh0,.+0x0106
      ldrb   rh0,.-0x7ffa
      ldrb   rl0,.+0x090e
      ldrb   rl0,.-0x7ff2
      ldb    rh0,r1(#0x1112)
      ldb    rh0,r1(#-0x7fee)
      ldb    rl0,r1(#0x191a)
      ldb    rl0,r1(#-0x7fe6)
      ldr    r0,.+0x0106
      ldr    r0,.-0x7ffa
      ld     r0,r1(#0x1112)
      ld     r0,r1(#-0x7fee)
      ldrb   .+0x0106,rh0
      ldrb   .-0x7ffa,rh0
      ldrb   .+0x090e,rl0
      ldrb   .-0x7ff2,rl0
      ldb    r1(#0x1112),rh0
      ldb    r1(#-0x7fee),rh0
      ldb    r1(#0x191a),rl0
      ldb    r1(#-0x7fe6),rl0
      ldr    .+0x0106,r0
      ldr    .-0x7ffa,r0
      ld     r1(#0x1112),r0
      ld     r1(#-0x7fee),r0
      ldar   r0,.+0x0106
      ldar   r0,.-0x7ffa
      lda    r0,r1(#0x1112)
      lda    r0,r1(#-0x7fee)
      ldrl   rr0,.+0x0106
      ldrl   rr0,.-0x7ffa
      ldl    rr0,r1(#0x1112)
      ldl    rr0,r1(#-0x7fee)
      ldrl   .+0x0106,rr0
      ldrl   .-0x7ffa,rr0
      ldl    r1(#0x1112),rr0
      ldl    r1(#-0x7fee),rr0
      ldps   @r1
      inb    rh0,#0x0506
      sinb   rh0,#0x0607
      outb   #0x0708,rh0
      soutb  #0x0809,rh0
      inb    rl0,#0x8586
      sinb   rl0,#0x8687
      outb   #0x8788,rl0
      soutb  #0x8889,rl0
      in     r0,#0x0506
      sin    r0,#0x0607
      out    #0x0708,r0
      sout   #0x0809,r0
      inb    rh0,@r1
      inb    rl0,@r1
      in     r0,@r1
      outb   @r1,rh0
      outb   @r1,rl0
      out    @r1,r0
      addb   rh0,0x0102
      addb   rl0,0x090a
      addb   rh0,0x1112(r1)
      addb   rl0,0x191a(r1)
      add    r0,0x0102
      add    r0,0x1112(r1)
      subb   rh0,0x0102
      subb   rl0,0x090a
      subb   rh0,0x1112(r1)
      subb   rl0,0x191a(r1)
      sub    r0,0x0102
      sub    r0,0x1112(r1)
      orb    rh0,0x0102
      orb    rl0,0x090a
      orb    rh0,0x1112(r1)
      orb    rl0,0x191a(r1)
      or     r0,0x0102
      or     r0,0x1112(r1)
      andb   rh0,0x0102
      andb   rl0,0x090a
      andb   rh0,0x1112(r1)
      andb   rl0,0x191a(r1)
      and    r0,0x0102
      and    r0,0x1112(r1)
      xorb   rh0,0x0102
      xorb   rl0,0x090a
      xorb   rh0,0x1112(r1)
      xorb   rl0,0x191a(r1)
      xor    r0,0x0102
      xor    r0,0x1112(r1)
      cpb    rh0,0x0102
      cpb    rl0,0x090a
      cpb    rh0,0x1112(r1)
      cpb    rl0,0x191a(r1)
      cp     r0,0x0102
      cp     r0,0x1112(r1)
      comb   0x0102
      cpb    0x0203,#5
      negb   0x0304
      testb  0x0506
      ldb    0x0607,#9
      tsetb  0x0708
      clrb   0x090a
      comb   0x1112(r1)
      cpb    0x1213(r1),#21
      negb   0x1314(r1)
      testb  0x1516(r1)
      ldb    0x1617(r1),#25
      tsetb  0x1718(r1)
      clrb   0x191a(r1)
      com    0x0102
      cp     0x0203,#0x0405
      neg    0x0304
      test   0x0506
      ld     0x0607,#0x0809
      tset   0x0708
      clr    0x090a
      com    0x1112(r1)
      cp     0x1213(r1),#0x1415
      neg    0x1314(r1)
      test   0x1516(r1)
      ld     0x1617(r1),#0x1819
      tset   0x1718(r1)
      clr    0x191a(r1)
      cpl    rr0,0x0102
      cpl    rr0,0x1112(r1)
      pushl  @r1,0x1112
      pushl  @r1,0x1213(r1)
      subl   rr0,0x0102
      subl   rr0,0x1112(r1)
      push   @r1,0x1112
      push   @r1,0x1213(r1)
      ldl    rr0,0x0102
      ldl    rr0,0x1112(r1)
      popl   0x1112,@r1
      popl   0x1213(r1),@r1
      addl   rr0,0x0102
      addl   rr0,0x1112(r1)
      pop    0x1112,@r1
      pop    0x1213(r1),@r1
      multl  rq0,0x0102
      multl  rq0,0x1112(r1)
      mult   rr0,0x0102
      mult   rr0,0x1112(r1)
      divl   rq0,0x0102
      divl   rq0,0x1112(r1)
      div    rr0,0x0102
      div    rr0,0x1112(r1)
      ldm    r2,0x0405,#4
      testl  0x090a
      ldm    0x0c0d,r10,#12
      testl  0x191a(r1)
      ldl    0x0102,rr0
      ldl    0x1112(r1),rr0
      jp     f,0x0102
      jp     lt,0x0203
      jp     le,0x0304
      jp     ule,0x0405
      jp     ov,0x0506
      jp     mi,0x0607
      jp     z,0x0708
      jp     c,0x0809
      jp     0x090a
      jp     ge,0x0a0b
      jp     gt,0x0b0c
      jp     ugt,0x0c0d
      jp     nov,0x0d0e
      jp     pl,0x0e0f
      jp     nz,0x0f10
      jp     nc,0x1011
      jp     f,0x1112(r1)
      jp     lt,0x1213(r1)
      jp     le,0x1314(r1)
      jp     ule,0x1415(r1)
      jp     ov,0x1516(r1)
      jp     mi,0x1617(r1)
      jp     z,0x1718(r1)
      jp     c,0x1819(r1)
      jp     0x191a(r1)
      jp     ge,0x1a1b(r1)
      jp     gt,0x1b1c(r1)
      jp     ugt,0x1c1d(r1)
      jp     nov,0x1d1e(r1)
      jp     pl,0x1e1f(r1)
      jp     nz,0x1f20(r1)
      jp     nc,0x2021(r1)
      call   0x0102
      call   0x1112(r1)
      ldb    rh0,0x0102
      ldb    rl0,0x090a
      ldb    rh0,0x1112(r1)
      ldb    rl0,0x191a(r1)
      ld     r0,0x0102
      ld     r0,0x1112(r1)
      resb   0x0102,#0
      resb   0x1112(r1),#0
      res    0x0102,#0
      res    0x1112(r1),#0
      setb   0x0102,#0
      setb   0x1112(r1),#0
      set    0x0102,#0
      set    0x1112(r1),#0
      bitb   0x0102,#0
      bitb   0x1112(r1),#0
      bit    0x0102,#0
      bit    0x1112(r1),#0
      incb   0x0102,#1
      incb   0x1112(r1),#1
      inc    0x0102,#1
      inc    0x1112(r1),#1
      decb   0x0102,#1
      decb   0x1112(r1),#1
      dec    0x0102,#1
      dec    0x1112(r1),#1
      exb    rh0,0x0102
      exb    rl0,0x090a
      exb    rh0,0x1112(r1)
      exb    rl0,0x191a(r1)
      ex     r0,0x0102
      ex     r0,0x1112(r1)
      ldb    0x0102,rh0
      ldb    0x090a,rl0
      ldb    0x1112(r1),rh0
      ldb    0x191a(r1),rl0
      ld     0x0102,r0
      ld     0x1112(r1),r0
      lda    r0,0x0102
      lda    r0,0x1112(r1)
      ldps   0x0102
      ldps   0x1112(r1)
      halt
      iret
      mset
      mres
      mbit
      mreq   r0
      di     vi,nvi
      di     vi
      di     nvi
      ei     vi,nvi
      ei     vi
      ei     nvi
      ldctl  r0,fcw
      ldctl  r0,refresh
      ldctl  r0,psapseg
      ldctl  r0,psapoff
      ldctl  r0,nspseg
      ldctl  r0,nspoff
      ldctl  fcw,r0
      ldctl  refresh,r0
      ldctl  psapseg,r0
      ldctl  psapoff,r0
      ldctl  nspseg,r0
      ldctl  nspoff,r0
      sc     #0
      addb   rh0,rh1
      addb   rl0,rh1
      addb   rh0,rl0
      addb   rl0,rl0
      add    r0,r1
      subb   rh0,rh1
      subb   rl0,rh1
      subb   rh0,rl0
      subb   rl0,rl0
      sub    r0,r1
      orb    rh0,rh1
      orb    rl0,rh1
      orb    rh0,rl0
      orb    rl0,rl0
      or     r0,r1
      andb   rh0,rh1
      andb   rl0,rh1
      andb   rh0,rl0
      andb   rl0,rl0
      and    r0,r1
      xorb   rh0,rh1
      xorb   rl0,rh1
      xorb   rh0,rl0
      xorb   rl0,rl0
      xor    r0,r1
      cpb    rh0,rh1
      cpb    rl0,rh1
      cpb    rh0,rl0
      cpb    rl0,rl0
      cp     r0,r1
      ldctlb rh0,flags
      ldctlb flags,rh0
      comb   rh1
      negb   rh1
      testb  rh1
      tsetb  rh1
      clrb   rh1
      comb   rl0
      ldctlb rl0,flags
      negb   rl0
      testb  rl0
      tsetb  rl0
      clrb   rl0
      ldctlb flags,rl0
      nop
      com    r1
      setflg p
      neg    r1
      resflg p
      test   r1
      comflg p
      tset   r1
      clr    r1
      setflg s
      resflg s
      comflg s
      setflg s,p
      resflg s,p
      comflg s,p
      setflg z
      resflg z
      comflg z
      setflg z,p
      resflg z,p
      comflg z,p
      setflg z,s
      resflg z,s
      comflg z,s
      setflg z,s,p
      resflg z,s,p
      comflg z,s,p
      setflg c
      resflg c
      comflg c
      setflg c,p
      resflg c,p
      comflg c,p
      setflg c,s
      resflg c,s
      comflg c,s
      setflg c,s,p
      resflg c,s,p
      comflg c,s,p
      setflg c,z
      resflg c,z
      comflg c,z
      setflg c,z,p
      resflg c,z,p
      comflg c,z,p
      setflg c,z,s
      resflg c,z,s
      comflg c,z,s
      setflg c,z,s,p
      resflg c,z,s,p
      comflg c,z,s,p
      cpl    rr0,rr2
      pushl  @r1,rr2
      subl   rr0,rr2
      push   @r1,r1
      ldl    rr0,rr2
      popl   rr2,@r1
      addl   rr0,rr2
      pop    r1,@r1
      multl  rq0,rr2
      mult   rr0,r1
      divl   rq0,rr2
      div    rr0,r1
      testl  rr2
      ret    f
      ret    lt
      ret    le
      ret    ule
      ret    ov
      ret    mi
      ret    z
      ret    c
      ret
      ret    ge
      ret    gt
      ret    ugt
      ret    nov
      ret    pl
      ret    nz
      ret    nc
      ldb    rh0,rh1
      ldb    rl0,rh1
      ldb    rh0,rl0
      ldb    rl0,rl0
      ld     r0,r1
      resb   rh1,#0
      resb   rl0,#0
      res    r1,#0
      setb   rh1,#0
      setb   rl0,#0
      set    r1,#0
      bitb   rh1,#0
      bitb   rl0,#0
      bit    r1,#0
      incb   rh1,#1
      incb   rl0,#1
      inc    r1,#1
      decb   rh1,#1
      decb   rl0,#1
      dec    r1,#1
      exb    rh0,rh1
      exb    rl0,rh1
      exb    rh0,rl0
      exb    rl0,rl0
      ex     r0,r1
      tccb   f,rh0
      tccb   lt,rh0
      tccb   le,rh0
      tccb   ule,rh0
      tccb   ov,rh0
      tccb   mi,rh0
      tccb   z,rh0
      tccb   c,rh0
      tccb   rh0
      tccb   ge,rh0
      tccb   gt,rh0
      tccb   ugt,rh0
      tccb   nov,rh0
      tccb   pl,rh0
      tccb   nz,rh0
      tccb   nc,rh0
      tccb   f,rl0
      tccb   lt,rl0
      tccb   le,rl0
      tccb   ule,rl0
      tccb   ov,rl0
      tccb   mi,rl0
      tccb   z,rl0
      tccb   c,rl0
      tccb   rl0
      tccb   ge,rl0
      tccb   gt,rl0
      tccb   ugt,rl0
      tccb   nov,rl0
      tccb   pl,rl0
      tccb   nz,rl0
      tccb   nc,rl0
      tcc    f,r0
      tcc    lt,r0
      tcc    le,r0
      tcc    ule,r0
      tcc    ov,r0
      tcc    mi,r0
      tcc    z,r0
      tcc    c,r0
      tcc    r0
      tcc    ge,r0
      tcc    gt,r0
      tcc    ugt,r0
      tcc    nov,r0
      tcc    pl,r0
      tcc    nz,r0
      tcc    nc,r0
      dab    rh0
      dab    rl0
      extsb  r0
      extsl  rq0
      exts   rr0
      rlb    rh0,#1
      rrb    rh0,#1
      rlcb   rh0,#1
      rrcb   rh0,#1
      rlb    rl0,#1
      rrb    rl0,#1
      rlcb   rl0,#1
      rrcb   rl0,#1
      rl     r0,#1
      rr     r0,#1
      rlc    r0,#1
      rrc    r0,#1
      adcb   rh0,rh0
      adcb   rl0,rh0
      adcb   rh0,rl0
      adcb   rl0,rl0
      adc    r0,r0
      sbcb   rh0,rh0
      sbcb   rl0,rh0
      sbcb   rh0,rl0
      sbcb   rl0,rl0
      sbc    r0,r0
      rrdb   rh0,rh0
      rrdb   rl0,rh0
      rrdb   rh0,rl0
      rrdb   rl0,rl0
      ldk    r0,#0
      rldb   rh0,rh0
      rldb   rl0,rh0
      rldb   rh0,rl0
      rldb   rl0,rl0
      ldb    rh0,#0
      ldb    rl0,#0
      calr   .+2
      calr   .-4094
      calr   .
      jr     f,.+2
      jr     f,.-254
      jr     f,.
      jr     lt,.+2
      jr     lt,.-254
      jr     lt,.
      jr     le,.+2
      jr     le,.-254
      jr     le,.
      jr     ule,.+2
      jr     ule,.-254
      jr     ule,.
      jr     ov,.+2
      jr     ov,.-254
      jr     ov,.
      jr     mi,.+2
      jr     mi,.-254
      jr     mi,.
      jr     z,.+2
      jr     z,.-254
      jr     z,.
      jr     c,.+2
      jr     c,.-254
      jr     c,.
      jr     .+2
      jr     .-254
      jr     .
      jr     ge,.+2
      jr     ge,.-254
      jr     ge,.
      jr     gt,.+2
      jr     gt,.-254
      jr     gt,.
      jr     ugt,.+2
      jr     ugt,.-254
      jr     ugt,.
      jr     nov,.+2
      jr     nov,.-254
      jr     nov,.
      jr     pl,.+2
      jr     pl,.-254
      jr     pl,.
      jr     nz,.+2
      jr     nz,.-254
      jr     nz,.
      jr     nc,.+2
      jr     nc,.-254
      jr     nc,.
      dbjnz  rh0,.+2
      dbjnz  rh0,.
      dbjnz  rh0,.-2
      djnz   r0,.+2
      djnz   r0,.
      djnz   r0,.-2
      dbjnz  rl0,.+2
      dbjnz  rl0,.
      dbjnz  rl0,.-2
